## Documentation/devicetree/bindings/sound/spdif-transmitter.yaml
```yaml
%YAML 1.2
---
version: 1

id: spdif-transmitter

title: Device-Tree bindings for dummy spdif transmitter

maintainer:
    -   name: Marek Belisko <marek.belisko@gmail.com>

description: >
    TODO

inherits:
    -   id: %ids%

properties:
    -   name: "compatible"
        constraint: |
            "linux,spdif-dit"

    #sound-dai-cells:

...

# Device-Tree bindings for dummy spdif transmitter
#
# Required properties:
# 	- compatible: should be "linux,spdif-dit".
#
# Example node:
#
# 	codec: spdif-transmitter {
# 		compatible = "linux,spdif-dit";
# 	};
```

## Documentation/devicetree/bindings/sound/tpa6130a2.yaml
```yaml
%YAML 1.2
---
version: 1

id: tpa6130a2

title: Texas Instruments - tpa6130a2 Codec module

maintainer:
    -   name: Sebastian Reichel <sre@debian.org>

description: >
    TODO

inherits:
    -   id: %ids%

properties:
    -   name: "compatible"
        constraint: |
            "ti,tpa6130a2"

    power-gpio:
    reg:
    Vdd-supply:

...

# Texas Instruments - tpa6130a2 Codec module
#
# The tpa6130a2 serial control bus communicates through I2C protocols
#
# Required properties:
#
# - compatible - "string" - One of:
#     "ti,tpa6130a2" - TPA6130A2
#     "ti,tpa6140a2" - TPA6140A2
#
#
# - reg - <int> -  I2C slave address
#
# - Vdd-supply - <phandle> - power supply regulator
#
# Optional properties:
#
# - power-gpio - gpio pin to power the device
#
# Example:
#
# tpa6130a2: tpa6130a2@60 {
# 	compatible = "ti,tpa6130a2";
# 	reg = <0x60>;
# 	Vdd-supply = <&vmmc2>;
# 	power-gpio = <&gpio4 2 GPIO_ACTIVE_HIGH>;
# };
```

## Documentation/devicetree/bindings/sound/wm8580.yaml
```yaml
%YAML 1.2
---
version: 1

id: wm8580

title: WM8580 audio CODEC

maintainer:
    -   name: Mark Brown <broonie@opensource.wolfsonmicro.com>

description: >
    TODO

inherits:
    -   id: %ids%

properties:
    -   name: "compatible"
        constraint: |
            "wlf,wm8580"

    reg:

...

# WM8580 audio CODEC
#
# This device supports I2C only.
#
# Required properties:
#
#   - compatible : "wlf,wm8580"
#
#   - reg : the I2C address of the device.
#
# Example:
#
# codec: wm8580@1a {
# 	compatible = "wlf,wm8580";
# 	reg = <0x1a>;
# };
```

## Documentation/devicetree/bindings/sound/wm8776.yaml
```yaml
%YAML 1.2
---
version: 1

id: wm8776

title: WM8776 audio CODEC

maintainer:
    -   name: Mark Brown <broonie@opensource.wolfsonmicro.com>

description: >
    TODO

inherits:
    -   id: %ids%

properties:
    -   name: "compatible"
        constraint: |
            "wlf,wm8776"

    reg:

...

# WM8776 audio CODEC
#
# This device supports both I2C and SPI (configured with pin strapping
# on the board).
#
# Required properties:
#
#   - compatible : "wlf,wm8776"
#
#   - reg : the I2C address of the device for I2C, the chip select
#           number for SPI.
#
# Example:
#
# codec: wm8776@1a {
# 	compatible = "wlf,wm8776";
# 	reg = <0x1a>;
# };
```

## Documentation/devicetree/bindings/sound/wm8904.yaml
```yaml
%YAML 1.2
---
version: 1

id: wm8904

title: WM8904 audio CODEC

maintainer:
    -   name: Bo Shen <voice.shen@atmel.com>

description: >
    TODO

inherits:
    -   id: %ids%

properties:
    -   name: "compatible"
        constraint: |
            "wlf,wm8904"

    clock-names:
    clocks:
    reg:

...

# WM8904 audio CODEC
#
# This device supports I2C only.
#
# Required properties:
#   - compatible: "wlf,wm8904" or "wlf,wm8912"
#   - reg: the I2C address of the device.
#   - clock-names: "mclk"
#   - clocks: reference to
#     <Documentation/devicetree/bindings/clock/clock-bindings.txt>
#
# Pins on the device (for linking into audio routes):
#
#   * IN1L
#   * IN1R
#   * IN2L
#   * IN2R
#   * IN3L
#   * IN3R
#   * HPOUTL
#   * HPOUTR
#   * LINEOUTL
#   * LINEOUTR
#   * MICBIAS
#
# Examples:
#
# codec: wm8904@1a {
# 	compatible = "wlf,wm8904";
# 	reg = <0x1a>;
# 	clocks = <&pck0>;
# 	clock-names = "mclk";
# };
```

## Documentation/devicetree/bindings/sound/wm8962.yaml
```yaml
%YAML 1.2
---
version: 1

id: wm8962

title: WM8962 audio CODEC

maintainer:
    -   name: Fabio Estevam <fabio.estevam@freescale.com>

description: >
    TODO

inherits:
    -   id: %ids%

properties:
    -   name: "compatible"
        constraint: |
            "wlf,wm8962"

    AVDD-supply:
    clocks:
    CPVDD-supply:
    DBVDD-supply:
    DCVDD-supply:
    gpio-cfg:
    MICVDD-supply:
    PLLVDD-supply:
    reg:
    SPKVDD1-supply:
    SPKVDD2-supply:

...

# WM8962 audio CODEC
#
# This device supports I2C only.
#
# Required properties:
#
#   - compatible : "wlf,wm8962"
#
#   - reg : the I2C address of the device.
#
# Optional properties:
#   - spk-mono: This is a boolean property. If present, the SPK_MONO bit
#     of R51 (Class D Control 2) gets set, indicating that the speaker is
#     in mono mode.
#
#   - mic-cfg : Default register value for R48 (Additional Control 4).
#     If absent, the default should be the register default.
#
#   - gpio-cfg : A list of GPIO configuration register values. The list must
#     be 6 entries long. If absent, no configuration of these registers is
#     performed. And note that only the value within [0x0, 0xffff] is valid.
#     Any other value is regarded as setting the GPIO register by its reset
#     value 0x0.
#
# Example:
#
# codec: wm8962@1a {
# 	compatible = "wlf,wm8962";
# 	reg = <0x1a>;
#
# 	gpio-cfg = <
# 		0x0000 /* 0:Default */
# 		0x0000 /* 1:Default */
# 		0x0013 /* 2:FN_DMICCLK */
# 		0x0000 /* 3:Default */
# 		0x8014 /* 4:FN_DMICCDAT */
# 		0x0000 /* 5:Default */
# 	>;
# };
```

## Documentation/devicetree/bindings/spi/fsl-imx-cspi.yaml
```yaml
%YAML 1.2
---
version: 1

id: fsl-imx-cspi

title: Freescale (Enhanced) Configurable Serial Peripheral Interface

maintainer:
    -   name: Fabio Estevam <festevam@gmail.com>

description: >
    TODO

inherits:
    -   id: %ids%

properties:
    -   name: "compatible"
        constraint: |
            "fsl,imx6ul-ecspi" && "fsl,imx51-ecspi"
            "fsl,imx6sx-ecspi" && "fsl,imx51-ecspi"
            "fsl,imx6sl-ecspi" && "fsl,imx51-ecspi"
            "fsl,imx6q-ecspi" && "fsl,imx51-ecspi"
            "fsl,imx53-ecspi" && "fsl,imx51-ecspi"
            "fsl,imx53-cspi" && "fsl,imx35-cspi"
            "fsl,imx51-ecspi"
            "fsl,imx51-cspi" && "fsl,imx35-cspi"
            "fsl,imx50-ecspi" && "fsl,imx51-ecspi"
            "fsl,imx50-cspi" && "fsl,imx35-cspi"
            "fsl,imx35-cspi"
            "fsl,imx27-cspi"
            "fsl,imx25-cspi" && "fsl,imx35-cspi"
            "fsl,imx1-cspi"

    #address-cells:
    clock-names:
    clocks:
    cs-gpios:
    fsl,spi-num-chipselects:
    interrupts:
    pinctrl-0:
    reg:
    #size-cells:
    status:

...

# * Freescale (Enhanced) Configurable Serial Peripheral Interface
#   (CSPI/eCSPI) for i.MX
#
# Required properties:
# - compatible :
#   - "fsl,imx1-cspi" for SPI compatible with the one integrated on i.MX1
#   - "fsl,imx21-cspi" for SPI compatible with the one integrated on i.MX21
#   - "fsl,imx27-cspi" for SPI compatible with the one integrated on i.MX27
#   - "fsl,imx31-cspi" for SPI compatible with the one integrated on i.MX31
#   - "fsl,imx35-cspi" for SPI compatible with the one integrated on i.MX35
#   - "fsl,imx51-ecspi" for SPI compatible with the one integrated on i.MX51
# - reg : Offset and length of the register set for the device
# - interrupts : Should contain CSPI/eCSPI interrupt
# - fsl,spi-num-chipselects : Contains the number of the chipselect
# - cs-gpios : Specifies the gpio pins to be used for chipselects.
# - clocks : Clock specifiers for both ipg and per clocks.
# - clock-names : Clock names should include both "ipg" and "per"
# See the clock consumer binding,
# 	Documentation/devicetree/bindings/clock/clock-bindings.txt
# - dmas: DMA specifiers for tx and rx dma. See the DMA client binding,
# 		Documentation/devicetree/bindings/dma/dma.txt
# - dma-names: DMA request names should include "tx" and "rx" if present.
#
# Example:
#
# ecspi@70010000 {
# 	#address-cells = <1>;
# 	#size-cells = <0>;
# 	compatible = "fsl,imx51-ecspi";
# 	reg = <0x70010000 0x4000>;
# 	interrupts = <36>;
# 	fsl,spi-num-chipselects = <2>;
# 	cs-gpios = <&gpio3 24 0>, /* GPIO3_24 */
# 		   <&gpio3 25 0>; /* GPIO3_25 */
# 	dmas = <&sdma 3 7 1>, <&sdma 4 7 2>;
# 	dma-names = "rx", "tx";
# };
```

## Documentation/devicetree/bindings/spi/mxs-spi.yaml
```yaml
%YAML 1.2
---
version: 1

id: mxs-spi

title: Freescale MX233/MX28 SSP/SPI

maintainer:
    -   name: Marek Vasut <marex@denx.de>

description: >
    TODO

inherits:
    -   id: %ids%

properties:
    -   name: "compatible"
        constraint: |
            "fsl,mpc8610-spi" && "fsl,spi"
            "fsl,imx28-spi"
            "fsl,imx23-spi"

    #address-cells:
    clocks:
    dma-names:
    dmas:
    interrupts:
    pinctrl-0:
    pinctrl-names:
    reg:
    #size-cells:
    status:

...

# * Freescale MX233/MX28 SSP/SPI
#
# Required properties:
# - compatible: Should be "fsl,<soc>-spi", where soc is "imx23" or "imx28"
# - reg: Offset and length of the register set for the device
# - interrupts: Should contain SSP ERROR interrupt
# - dmas: DMA specifier, consisting of a phandle to DMA controller node
#   and SSP DMA channel ID.
#   Refer to dma.txt and fsl-mxs-dma.txt for details.
# - dma-names: Must be "rx-tx".
#
# Optional properties:
# - clock-frequency : Input clock frequency to the SPI block in Hz.
# 		    Default is 160000000 Hz.
#
# Example:
#
# ssp0: ssp@80010000 {
# 	#address-cells = <1>;
# 	#size-cells = <0>;
# 	compatible = "fsl,imx28-spi";
# 	reg = <0x80010000 0x2000>;
# 	interrupts = <96>;
# 	dmas = <&dma_apbh 0>;
# 	dma-names = "rx-tx";
# };
```

## Documentation/devicetree/bindings/spi/snps,dw-apb-ssi.yaml
```yaml
%YAML 1.2
---
version: 1

id: snps,dw-apb-ssi

title: Synopsys DesignWare AMBA 2.0 Synchronous Serial Interface.

maintainer:
    -   name: Michael van der Westhuizen <michael@smart-africa.com>

description: >
    TODO

inherits:
    -   id: %ids%

properties:
    -   name: "compatible"
        constraint: |
            "snps,dw-apb-ssi"

    #address-cells:
    clocks:
    interrupts:
    num-cs:
    reg:
    #size-cells:
    status:

...

# Synopsys DesignWare AMBA 2.0 Synchronous Serial Interface.
#
# Required properties:
# - compatible : "snps,dw-apb-ssi"
# - reg : The register base for the controller.
# - interrupts : One interrupt, used by the controller.
# - #address-cells : <1>, as required by generic SPI binding.
# - #size-cells : <0>, also as required by generic SPI binding.
#
# Optional properties:
# - cs-gpios : Specifies the gpio pis to be used for chipselects.
# - num-cs : The number of chipselects. If omitted, this will default to 4.
# - reg-io-width : The I/O register width (in bytes) implemented by this
#   device.  Supported values are 2 or 4 (the default).
#
# Child nodes as per the generic SPI binding.
#
# Example:
#
# 	spi@fff00000 {
# 		compatible = "snps,dw-apb-ssi";
# 		reg = <0xfff00000 0x1000>;
# 		interrupts = <0 154 4>;
# 		#address-cells = <1>;
# 		#size-cells = <0>;
# 		num-cs = <2>;
# 		cs-gpios = <&gpio0 13 0>,
# 			   <&gpio0 14 0>;
# 	};
#
```

## Documentation/devicetree/bindings/spi/spi-gpio.yaml
```yaml
%YAML 1.2
---
version: 1

id: spi-gpio

title: SPI-GPIO devicetree bindings

maintainer:
    -   name: Daniel Mack <zonque@gmail.com>

description: >
    TODO

inherits:
    -   id: %ids%

properties:
    -   name: "compatible"
        constraint: |
            "spi-gpio"

    #address-cells:
    cs-gpios:
    gpio-miso:
    gpio-mosi:
    gpio-sck:
    num-chipselects:
    pinctrl-0:
    pinctrl-names:
    #size-cells:
    status:

...

# SPI-GPIO devicetree bindings
#
# Required properties:
#
#  - compatible: should be set to "spi-gpio"
#  - #address-cells: should be set to <0x1>
#  - ranges
#  - gpio-sck: GPIO spec for the SCK line to use
#  - gpio-miso: GPIO spec for the MISO line to use
#  - gpio-mosi: GPIO spec for the MOSI line to use
#  - cs-gpios: GPIOs to use for chipselect lines.
#              Not needed if num-chipselects = <0>.
#  - num-chipselects: Number of chipselect lines. Should be <0> if a single device
#                     with no chip select is connected.
#
# Example:
#
# 	spi {
# 		compatible = "spi-gpio";
# 		#address-cells = <0x1>;
# 		ranges;
#
# 		gpio-sck = <&gpio 95 0>;
# 		gpio-miso = <&gpio 98 0>;
# 		gpio-mosi = <&gpio 97 0>;
# 		cs-gpios = <&gpio 125 0>;
# 		num-chipselects = <1>;
#
# 		/* clients */
# 	};
#
```

## Documentation/devicetree/bindings/spi/spi-orion.yaml
```yaml
%YAML 1.2
---
version: 1

id: spi-orion

title: Marvell Orion SPI device

maintainer:
    -   name: Andrew Lunn <andrew@lunn.ch>

description: >
    TODO

inherits:
    -   id: %ids%

properties:
    -   name: "compatible"
        constraint: |
            "marvell,orion-spi"
            "marvell,armada-xp-spi" && "marvell,orion-spi"
            "marvell,armada-390-spi" && "marvell,orion-spi"
            "marvell,armada-380-spi" && "marvell,orion-spi"
            "marvell,armada-375-spi" && "marvell,orion-spi"
            "marvell,armada-370-spi" && "marvell,orion-spi"

    #address-cells:
    cell-index:
    clocks:
    interrupts:
    pinctrl-0:
    pinctrl-names:
    reg:
    #size-cells:
    status:

...

# Marvell Orion SPI device
#
# Required properties:
# - compatible : should be on of the following:
#     - "marvell,orion-spi" for the Orion, mv78x00, Kirkwood and Dove SoCs
#     - "marvell,armada-370-spi", for the Armada 370 SoCs
#     - "marvell,armada-375-spi", for the Armada 375 SoCs
#     - "marvell,armada-380-spi", for the Armada 38x SoCs
#     - "marvell,armada-390-spi", for the Armada 39x SoCs
#     - "marvell,armada-xp-spi", for the Armada XP SoCs
# - reg : offset and length of the register set for the device
# - cell-index : Which of multiple SPI controllers is this.
# Optional properties:
# - interrupts : Is currently not used.
#
# Example:
#        spi@10600 {
# 	       compatible = "marvell,orion-spi";
# 	       #address-cells = <1>;
# 	       #size-cells = <0>;
# 	       cell-index = <0>;
# 	       reg = <0x10600 0x28>;
# 	       interrupts = <23>;
# 	       status = "disabled";
#        };
```
