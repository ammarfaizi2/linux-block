## Documentation/devicetree/bindings/sound/gtm601.yaml
```yaml
%YAML 1.2
---
version: 1

id: gtm601

title: GTM601 UMTS modem audio interface CODEC

maintainer:
    -   name: Marek Belisko <marek@goldelico.com>

description: >
    TODO

inherits:
    -   id: %ids%

properties:
    -   name: "compatible"
        constraint: |
            "option,gtm601"

    #sound-dai-cells:

...

# GTM601 UMTS modem audio interface CODEC
#
# This device has no configuration interface. Sample rate is fixed - 8kHz.
#
# Required properties:
#
#   - compatible : "option,gtm601"
#
# Example:
#
# codec: gtm601_codec {
# 	compatible = "option,gtm601";
# };
```

## Documentation/devicetree/bindings/sound/imx-audio-sgtl5000.yaml
```yaml
%YAML 1.2
---
version: 1

id: imx-audio-sgtl5000

title: Freescale i.MX audio complex with SGTL5000 codec

maintainer:
    -   name: Shawn Guo <shawn.guo@linaro.org>

description: >
    TODO

inherits:
    -   id: %ids%

properties:
    -   name: "compatible"
        constraint: |
            "tq,imx53-mba53-sgtl5000" && "fsl,imx-audio-sgtl5000"
            "karo,tx53-audio-sgtl5000" && "fsl,imx-audio-sgtl5000"
            "karo,imx6qdl-tx6qdl-sgtl5000" && "fsl,imx-audio-sgtl5000"
            "fsl,imx-audio-sgtl5000"
            "fsl,imx6-wandboard-sgtl5000" && "fsl,imx-audio-sgtl5000"
            "fsl,imx6-rex-sgtl5000" && "fsl,imx-audio-sgtl5000"
            "fsl,imx6q-ventana-sgtl5000" && "fsl,imx-audio-sgtl5000"
            "fsl,imx6q-sabrelite-sgtl5000" && "fsl,imx-audio-sgtl5000"
            "fsl,imx6q-nitrogen6x-sgtl5000" && "fsl,imx-audio-sgtl5000"
            "fsl,imx6-armadeus-sgtl5000" && "fsl,imx-audio-sgtl5000"
            "fsl,imx53-voipac-sgtl5000" && "fsl,imx-audio-sgtl5000"
            "fsl,imx53-qsb-sgtl5000" && "fsl,imx-audio-sgtl5000"
            "fsl,imx53-m53evk-sgtl5000" && "fsl,imx-audio-sgtl5000"
            "fsl,imx51-babbage-sgtl5000" && "fsl,imx-audio-sgtl5000"
            "fsl,imx25-pdk-sgtl5000" && "fsl,imx-audio-sgtl5000"

    audio-codec:
    audio-routing:
    model:
    mux-ext-port:
    mux-int-port:
    ssi-controller:

...

# Freescale i.MX audio complex with SGTL5000 codec
#
# Required properties:
#
#   - compatible		: "fsl,imx-audio-sgtl5000"
#
#   - model		: The user-visible name of this sound complex
#
#   - ssi-controller	: The phandle of the i.MX SSI controller
#
#   - audio-codec		: The phandle of the SGTL5000 audio codec
#
#   - audio-routing	: A list of the connections between audio components.
# 			  Each entry is a pair of strings, the first being the
# 			  connection's sink, the second being the connection's
# 			  source. Valid names could be power supplies, SGTL5000
# 			  pins, and the jacks on the board:
#
# 			  Power supplies:
# 			   * Mic Bias
#
# 			  SGTL5000 pins:
# 			   * MIC_IN
# 			   * LINE_IN
# 			   * HP_OUT
# 			   * LINE_OUT
#
# 			  Board connectors:
# 			   * Mic Jack
# 			   * Line In Jack
# 			   * Headphone Jack
# 			   * Line Out Jack
# 			   * Ext Spk
#
#   - mux-int-port	: The internal port of the i.MX audio muxer (AUDMUX)
#
#   - mux-ext-port	: The external port of the i.MX audio muxer
#
# Note: The AUDMUX port numbering should start at 1, which is consistent with
# hardware manual.
#
# Example:
#
# sound {
# 	compatible = "fsl,imx51-babbage-sgtl5000",
# 		     "fsl,imx-audio-sgtl5000";
# 	model = "imx51-babbage-sgtl5000";
# 	ssi-controller = <&ssi1>;
# 	audio-codec = <&sgtl5000>;
# 	audio-routing =
# 		"MIC_IN", "Mic Jack",
# 		"Mic Jack", "Mic Bias",
# 		"Headphone Jack", "HP_OUT";
# 	mux-int-port = <1>;
# 	mux-ext-port = <3>;
# };
```

## Documentation/devicetree/bindings/sound/imx-audio-wm8962.yaml
```yaml
%YAML 1.2
---
version: 1

id: imx-audio-wm8962

title: Freescale i.MX audio complex with WM8962 codec

maintainer:
    -   name: Nicolin Chen <nicoleotsuka@gmail.com>

description: >
    TODO

inherits:
    -   id: %ids%

properties:
    -   name: "compatible"
        constraint: |
            "fsl,imx6sx-sdb-wm8962" && "fsl,imx-audio-wm8962"
            "fsl,imx6sl-evk-wm8962" && "fsl,imx-audio-wm8962"
            "fsl,imx6q-sabresd-wm8962" && "fsl,imx-audio-wm8962"

    audio-codec:
    audio-routing:
    model:
    mux-ext-port:
    mux-int-port:
    ssi-controller:

...

# Freescale i.MX audio complex with WM8962 codec
#
# Required properties:
#
#   - compatible		: "fsl,imx-audio-wm8962"
#
#   - model		: The user-visible name of this sound complex
#
#   - ssi-controller	: The phandle of the i.MX SSI controller
#
#   - audio-codec		: The phandle of the WM8962 audio codec
#
#   - audio-routing	: A list of the connections between audio components.
# 			  Each entry is a pair of strings, the first being the
# 			  connection's sink, the second being the connection's
# 			  source. Valid names could be power supplies, WM8962
# 			  pins, and the jacks on the board:
#
# 			  Power supplies:
# 			   * Mic Bias
#
# 			  Board connectors:
# 			   * Mic Jack
# 			   * Headphone Jack
# 			   * Ext Spk
#
#   - mux-int-port	: The internal port of the i.MX audio muxer (AUDMUX)
#
#   - mux-ext-port	: The external port of the i.MX audio muxer
#
# Note: The AUDMUX port numbering should start at 1, which is consistent with
# hardware manual.
#
# Example:
#
# sound {
# 	compatible = "fsl,imx6q-sabresd-wm8962",
# 		     "fsl,imx-audio-wm8962";
# 	model = "wm8962-audio";
# 	ssi-controller = <&ssi2>;
# 	audio-codec = <&codec>;
# 		audio-routing =
# 		"Headphone Jack", "HPOUTL",
# 		"Headphone Jack", "HPOUTR",
# 		"Ext Spk", "SPKOUTL",
# 		"Ext Spk", "SPKOUTR",
# 		"MICBIAS", "AMIC",
# 		"IN3R", "MICBIAS",
# 		"DMIC", "MICBIAS",
# 		"DMICDAT", "DMIC";
# 	mux-int-port = <2>;
# 	mux-ext-port = <3>;
# };
```

## Documentation/devicetree/bindings/sound/imx-audmux.yaml
```yaml
%YAML 1.2
---
version: 1

id: imx-audmux

title: Freescale Digital Audio Mux (AUDMUX) device

maintainer:
    -   name: Markus Pargmann <mpa@pengutronix.de>

description: >
    TODO

inherits:
    -   id: %ids%

properties:
    -   name: "compatible"
        constraint: |
            "fsl,imx6sx-audmux" && "fsl,imx31-audmux"
            "fsl,imx6sl-audmux" && "fsl,imx31-audmux"
            "fsl,imx6q-audmux" && "fsl,imx31-audmux"
            "fsl,imx53-audmux" && "fsl,imx31-audmux"
            "fsl,imx51-audmux" && "fsl,imx31-audmux"
            "fsl,imx50-audmux" && "fsl,imx31-audmux"
            "fsl,imx35-audmux" && "fsl,imx31-audmux"
            "fsl,imx27-audmux" && "fsl,imx21-audmux"
            "fsl,imx25-audmux" && "fsl,imx31-audmux"

    pinctrl-0:
    pinctrl-names:
    reg:
    status:

...

# Freescale Digital Audio Mux (AUDMUX) device
#
# Required properties:
#
#   - compatible		: "fsl,imx21-audmux" for AUDMUX version firstly used
# 			  on i.MX21, or "fsl,imx31-audmux" for the version
# 			  firstly used on i.MX31.
#
#   - reg			: Should contain AUDMUX registers location and length.
#
# An initial configuration can be setup using child nodes.
#
# Required properties of optional child nodes:
#
#   - fsl,audmux-port	: Integer of the audmux port that is configured by this
# 			  child node.
#
#   - fsl,port-config	: List of configuration options for the specific port.
# 			  For imx31-audmux and above, it is a list of tuples
# 			  <ptcr pdcr>. For imx21-audmux it is a list of pcr
# 			  values.
#
# Example:
#
# audmux@021d8000 {
# 	compatible = "fsl,imx6q-audmux", "fsl,imx31-audmux";
# 	reg = <0x021d8000 0x4000>;
# };
```

## Documentation/devicetree/bindings/sound/mxs-audio-sgtl5000.yaml
```yaml
%YAML 1.2
---
version: 1

id: mxs-audio-sgtl5000

title: Freescale MXS audio complex with SGTL5000 codec

maintainer:
    -   name: Shawn Guo <shawn.guo@linaro.org>

description: >
    TODO

inherits:
    -   id: %ids%

properties:
    -   name: "compatible"
        constraint: |
            "fsl,imx28-tx28-sgtl5000" && "fsl,mxs-audio-sgtl5000"
            "fsl,imx28-mbmx28lc-sgtl5000" && "fsl,mxs-audio-sgtl5000"
            "fsl,imx28-evk-sgtl5000" && "fsl,mxs-audio-sgtl5000"
            "denx,m28evk-sgtl5000" && "fsl,mxs-audio-sgtl5000"
            "bluegiga,apx4devkit-sgtl5000" && "fsl,mxs-audio-sgtl5000"

    audio-codec:
    model:
    saif-controllers:

...

# * Freescale MXS audio complex with SGTL5000 codec
#
# Required properties:
# - compatible: "fsl,mxs-audio-sgtl5000"
# - model: The user-visible name of this sound complex
# - saif-controllers: The phandle list of the MXS SAIF controller
# - audio-codec: The phandle of the SGTL5000 audio codec
#
# Example:
#
# sound {
# 	compatible = "fsl,imx28-evk-sgtl5000",
# 		     "fsl,mxs-audio-sgtl5000";
# 	model = "imx28-evk-sgtl5000";
# 	saif-controllers = <&saif0 &saif1>;
# 	audio-codec = <&sgtl5000>;
# };
```

## Documentation/devicetree/bindings/sound/nvidia,tegra20-das.yaml
```yaml
%YAML 1.2
---
version: 1

id: nvidia,tegra20-das

title: NVIDIA Tegra 20 DAS (Digital Audio Switch) controller

maintainer:
    -   name: Stephen Warren <swarren@nvidia.com>

description: >
    TODO

inherits:
    -   id: %ids%

properties:
    -   name: "compatible"
        constraint: |
            "nvidia,tegra20-das"

    reg:

...

# NVIDIA Tegra 20 DAS (Digital Audio Switch) controller
#
# Required properties:
# - compatible : "nvidia,tegra20-das"
# - reg : Should contain DAS registers location and length
#
# Example:
#
# das@70000c00 {
# 	compatible = "nvidia,tegra20-das";
# 	reg = <0x70000c00 0x80>;
# };
```

## Documentation/devicetree/bindings/sound/omap-dmic.yaml
```yaml
%YAML 1.2
---
version: 1

id: omap-dmic

title: Texas Instruments OMAP4+ Digital Microphone Module

maintainer:
    -   name: Peter Ujfalusi <peter.ujfalusi@ti.com>

description: >
    TODO

inherits:
    -   id: %ids%

properties:
    -   name: "compatible"
        constraint: |
            "ti,omap4-dmic"

    dma-names:
    dmas:
    interrupts:
    pinctrl-0:
    pinctrl-names:
    reg:
    reg-names:
    status:
    ti,hwmods:

...

# * Texas Instruments OMAP4+ Digital Microphone Module
#
# Required properties:
# - compatible: "ti,omap4-dmic"
# - reg: Register location and size as an array:
#        <MPU access base address, size>,
#        <L3 interconnect address, size>;
# - interrupts: Interrupt number for DMIC
# - interrupt-parent: The parent interrupt controller
# - ti,hwmods: Name of the hwmod associated with OMAP dmic IP
#
# Example:
#
# dmic: dmic@4012e000 {
# 	compatible = "ti,omap4-dmic";
# 	reg = <0x4012e000 0x7f>, /* MPU private access */
# 	      <0x4902e000 0x7f>; /* L3 Interconnect */
# 	interrupts = <0 114 0x4>;
# 	interrupt-parent = <&gic>;
# 	ti,hwmods = "dmic";
# };
```

## Documentation/devicetree/bindings/sound/omap-mcpdm.yaml
```yaml
%YAML 1.2
---
version: 1

id: omap-mcpdm

title: Texas Instruments OMAP4+ McPDM

maintainer:
    -   name: Peter Ujfalusi <peter.ujfalusi@ti.com>

description: >
    TODO

inherits:
    -   id: %ids%

properties:
    -   name: "compatible"
        constraint: |
            "ti,omap4-mcpdm"

    dma-names:
    dmas:
    interrupts:
    pinctrl-0:
    pinctrl-names:
    reg:
    reg-names:
    status:
    ti,hwmods:

...

# * Texas Instruments OMAP4+ McPDM
#
# Required properties:
# - compatible: "ti,omap4-mcpdm"
# - reg: Register location and size as an array:
#        <MPU access base address, size>,
#        <L3 interconnect address, size>;
# - interrupts: Interrupt number for McPDM
# - interrupt-parent: The parent interrupt controller
# - ti,hwmods: Name of the hwmod associated to the McPDM
#
# Example:
#
# mcpdm: mcpdm@40132000 {
# 	compatible = "ti,omap4-mcpdm";
# 	reg = <0x40132000 0x7f>, /* MPU private access */
# 	      <0x49032000 0x7f>; /* L3 Interconnect */
# 	interrupts = <0 112 0x4>;
# 	interrupt-parent = <&gic>;
# 	ti,hwmods = "mcpdm";
# };
```

## Documentation/devicetree/bindings/sound/renesas,fsi.yaml
```yaml
%YAML 1.2
---
version: 1

id: renesas,fsi

title: Renesas FSI

maintainer:
    -   name: Geert Uytterhoeven <geert+renesas@glider.be>

description: >
    TODO

inherits:
    -   id: %ids%

properties:
    -   name: "compatible"
        constraint: |
            "renesas,fsi2-sh73a0" && "renesas,sh"_"fsi2"
            "renesas,fsi2-r8a7740" && "renesas,sh"_"fsi2"

    clocks:
    interrupts:
    pinctrl-0:
    pinctrl-names:
    power-domains:
    reg:
    #sound-dai-cells:
    status:

...

# Renesas FSI
#
# Required properties:
# - compatible			: "renesas,fsi2-<soctype>",
# 				  "renesas,sh_fsi2" or "renesas,sh_fsi" as
# 				  fallback.
# 				  Examples with soctypes are:
# 				    - "renesas,fsi2-r8a7740" (R-Mobile A1)
# 				    - "renesas,fsi2-sh73a0" (SH-Mobile AG5)
# - reg				: Should contain the register physical address and length
# - interrupts			: Should contain FSI interrupt
#
# - fsia,spdif-connection		: FSI is connected by S/PDIF
# - fsia,stream-mode-support	: FSI supports 16bit stream mode.
# - fsia,use-internal-clock	: FSI uses internal clock when master mode.
#
# - fsib,spdif-connection		: same as fsia
# - fsib,stream-mode-support	: same as fsia
# - fsib,use-internal-clock	: same as fsia
#
# Example:
#
# sh_fsi2: sh_fsi2@0xec230000 {
# 	compatible = "renesas,sh_fsi2";
# 	reg = <0xec230000 0x400>;
# 	interrupts = <0 146 0x4>;
#
# 	fsia,spdif-connection;
# 	fsia,stream-mode-support;
# 	fsia,use-internal-clock;
# };
```

## Documentation/devicetree/bindings/sound/samsung,smdk-wm8994.yaml
```yaml
%YAML 1.2
---
version: 1

id: samsung,smdk-wm8994

title: Samsung SMDK audio complex

maintainer:
    -   name: Padmavathi Venna <padma.v@samsung.com>

description: >
    TODO

inherits:
    -   id: %ids%

properties:
    -   name: "compatible"
        constraint: |
            "samsung,smdk-wm8994"

    samsung,audio-codec:
    samsung,i2s-controller:

...

# Samsung SMDK audio complex
#
# Required properties:
# - compatible : "samsung,smdk-wm8994"
# - samsung,i2s-controller: The phandle of the Samsung I2S0 controller
# - samsung,audio-codec: The phandle of the WM8994 audio codec
# Example:
#
# sound {
# 		compatible = "samsung,smdk-wm8994";
#
# 		samsung,i2s-controller = <&i2s0>;
# 		samsung,audio-codec = <&wm8994>;
# };
```

## Documentation/devicetree/bindings/sound/snow.yaml
```yaml
%YAML 1.2
---
version: 1

id: snow

title: Audio Binding for Snow boards

maintainer:
    -   name: Tushar Behera <tushar.b@samsung.com>

description: >
    TODO

inherits:
    -   id: %ids%

properties:
    -   name: "compatible"
        constraint: |
            "google,snow" && "samsung,exynos5250" && "samsung,exynos5"
            "google,snow-audio-max98095"
            "google,snow-audio-max98091"
            "google,snow-audio-max98090"

    samsung,audio-codec:
    samsung,i2s-controller:
    samsung,model:

...

# Audio Binding for Snow boards
#
# Required properties:
# - compatible : Can be one of the following,
# 			"google,snow-audio-max98090" or
# 			"google,snow-audio-max98091" or
# 			"google,snow-audio-max98095"
# - samsung,i2s-controller: The phandle of the Samsung I2S controller
# - samsung,audio-codec: The phandle of the audio codec
#
# Optional:
# - samsung,model: The name of the sound-card
#
# Example:
#
# sound {
# 		compatible = "google,snow-audio-max98095";
#
# 		samsung,model = "Snow-I2S-MAX98095";
# 		samsung,i2s-controller = <&i2s0>;
# 		samsung,audio-codec = <&max98095>;
# };
```

## Documentation/devicetree/bindings/sound/spdif-receiver.yaml
```yaml
%YAML 1.2
---
version: 1

id: spdif-receiver

title: Device-Tree bindings for dummy spdif receiver

maintainer:
    -   name: Marek Belisko <marek.belisko@gmail.com>

description: >
    TODO

inherits:
    -   id: %ids%

properties:
    -   name: "compatible"
        constraint: |
            "linux,spdif-dir"

    #sound-dai-cells:

...

# Device-Tree bindings for dummy spdif receiver
#
# Required properties:
# 	- compatible: should be "linux,spdif-dir".
#
# Example node:
#
# 	codec: spdif-receiver {
# 		compatible = "linux,spdif-dir";
# 	};
```
