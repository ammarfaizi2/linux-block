## Documentation/devicetree/bindings/spi/spi-sirf.yaml
```yaml
%YAML 1.2
---
version: 1

id: spi-sirf

title: CSR SiRFprimaII Serial Peripheral Interface

maintainer:
    -   name: Barry Song <Baohua.Song@csr.com>

description: >
    TODO

inherits:
    -   id: %ids%

properties:
    -   name: "compatible"
        constraint: |
            "sirf,prima2-usp"
            "sirf,prima2-spi"

    #address-cells:
    cell-index:
    clocks:
    dma-names:
    dmas:
    interrupts:
    pinctrl-0:
    pinctrl-names:
    reg:
    resets:
    sirf,spi-num-chipselects:
    #size-cells:
    status:

...

# * CSR SiRFprimaII Serial Peripheral Interface
#
# Required properties:
# - compatible : Should be "sirf,prima2-spi", "sirf,prima2-usp"
#                or "sirf,atlas7-usp"
# - reg : Offset and length of the register set for the device
# - interrupts : Should contain SPI interrupt
# - resets: phandle to the reset controller asserting this device in
#           reset
#   See ../reset/reset.txt for details.
# - dmas : Must contain an entry for each entry in clock-names.
#   See ../dma/dma.txt for details.
# - dma-names : Must include the following entries:
#   - rx
#   - tx
# - clocks : Must contain an entry for each entry in clock-names.
#   See ../clocks/clock-bindings.txt for details.
#
# - #address-cells: Number of cells required to define a chip select
#                   address on the SPI bus. Should be set to 1.
# - #size-cells:    Should be zero.
#
# Optional properties:
# - spi-max-frequency: Specifies maximum SPI clock frequency,
#                      Units - Hz. Definition as per
#                      Documentation/devicetree/bindings/spi/spi-bus.txt
# - cs-gpios:     should specify GPIOs used for chipselects.
#
# Example:
#
# spi0: spi@b00d0000 {
# 	compatible = "sirf,prima2-spi";
# 	reg = <0xb00d0000 0x10000>;
# 	interrupts = <15>;
# 	dmas = <&dmac1 9>,
# 		<&dmac1 4>;
# 	dma-names = "rx", "tx";
# 	#address-cells = <1>;
# 	#size-cells = <0>;
# 	clocks = <&clks 19>;
# 	resets = <&rstc 26>;
# };
```

## Documentation/devicetree/bindings/spi/spi-slave.yaml
```yaml
%YAML 1.2
---
version: 1

id: spi-slave

title: SPI Slave Devices

maintainer:
    -   name: Mark Brown <broonie@kernel.org>

description: >
    SPI (Serial Peripheral Interface) slave bus devices are children of
    of a SPI master bus device.
properties:
    -   name: "reg"
        category: required
        type: int
        description: chip select address of device

    -   name: "compatible"
        category: required
        type: string
        description: compatible strings

    -   name: "spi-max-frequency"
        category: required
        type: int
        description: Maximum SPI clocking speed of device in Hz

    -   name: "spi-cpol"
        category: optional
        type: empty
        description: >
            Empty property indicating device requires
            inverse clock polarity (CPOL) mode

    -   name: "spi-cpha"
        category: optional
        type: empty
        description: >
            Empty property indicating device requires
            shifted clock phase (CPHA) mode

    -   name: "spi-cs-high"
        category: optional
        type: empty
        description: >
            Empty property indicating device requires
            chip select active high

    -   name: "spi-3wire"
        category: optional
        type: empty
        description: >
            Empty property indicating device requires
            3-wire mode.

    -   name: "spi-lsb-first"
        category: optional
        type: empty
        description: >
            Empty property indicating device requires
            LSB first mode.

    -   name: "spi-tx-bus-width"
        category: optional
        type: int
        constraint: 1 || 2 || 4
        description: >
            The bus width(number of data wires) that
            used for MOSI. Defaults to 1 if not present.

    -   name: "spi-rx-bus-width"
        category: optional
        type: int
        constraint: 1 || 2 || 4
        description: >
            The bus width(number of data wires) that
            used for MISO. Defaults to 1 if not present.

notes: >
    Some SPI controllers and devices support Dual and Quad SPI transfer mode.
    It allows data in the SPI system to be transferred in 2 wires(DUAL) or
    4 wires(QUAD).
    Now the value that spi-tx-bus-width and spi-rx-bus-width can receive is
    only 1(SINGLE), 2(DUAL) and 4(QUAD). Dual/Quad mode is not allowed when
    3-wire mode is used.
    If a gpio chipselect is used for the SPI slave the gpio number will be
    passed via the SPI master node cs-gpios property.

examples:
    -   dts: |
            spi@f00 {
                ...
                ethernet-switch@0 {
                    compatible = "micrel,ks8995m";
                    spi-max-frequency = <1000000>;
                    reg = <0>;
                };

                codec@1 {
                    compatible = "ti,tlv320aic26";
                    spi-max-frequency = <100000>;
                    reg = <1>;
                };
            };
...
```
