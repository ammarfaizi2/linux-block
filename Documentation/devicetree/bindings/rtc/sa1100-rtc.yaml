## Documentation/devicetree/bindings/rtc/sa1100-rtc.yaml
```yaml
%YAML 1.2
---
version: 1

id: sa1100-rtc

title: Marvell Real Time Clock controller

maintainer:
    -   name: Haojian Zhuang <haojian.zhuang@marvell.com>

description: >
    TODO

inherits:
    -   id: %ids%

properties:
    -   name: "compatible"
        constraint: |
            "mrvl,mmp-rtc"

    clocks:
    interrupt-names:
    interrupt-parent:
    interrupts:
    reg:
    resets:
    status:

...

# * Marvell Real Time Clock controller
#
# Required properties:
# - compatible: should be "mrvl,sa1100-rtc"
# - reg: physical base address of the controller and length of memory mapped
#   region.
# - interrupts: Should be two. The first interrupt number is the rtc alarm
#   interrupt and the second interrupt number is the rtc hz interrupt.
# - interrupt-names: Assign name of irq resource.
#
# Example:
# 	rtc: rtc@d4010000 {
# 		compatible = "mrvl,mmp-rtc";
# 		reg = <0xd4010000 0x1000>;
# 		interrupts = <5>, <6>;
# 		interrupt-name = "rtc 1Hz", "rtc alarm";
# 	};
```

## Documentation/devicetree/bindings/rtc/sunxi-rtc.yaml
```yaml
%YAML 1.2
---
version: 1

id: sunxi-rtc

title: sun4i/sun7i Real Time Clock

maintainer:
    -   name: Carlo Caione <carlo.caione@gmail.com>

description: >
    TODO

inherits:
    -   id: %ids%

properties:
    -   name: "compatible"
        constraint: |
            "allwinner,sun7i-a20-rtc"
            "allwinner,sun4i-a10-rtc"

    interrupts:
    reg:

...

# * sun4i/sun7i Real Time Clock
#
# RTC controller for the Allwinner A10/A20
#
# Required properties:
# - compatible : Should be "allwinner,sun4i-a10-rtc" or "allwinner,sun7i-a20-rtc"
# - reg: physical base address of the controller and length of memory mapped
#   region.
# - interrupts: IRQ line for the RTC.
#
# Example:
#
# rtc: rtc@01c20d00 {
# 	compatible = "allwinner,sun4i-a10-rtc";
# 	reg = <0x01c20d00 0x20>;
# 	interrupts = <24>;
# };
```

## Documentation/devicetree/bindings/rtc/twl-rtc.yaml
```yaml
%YAML 1.2
---
version: 1

id: twl-rtc

title: TI twl RTC

maintainer:
    -   name: Benoit Cousson <b-cousson@ti.com>

description: >
    TODO

inherits:
    -   id: %ids%

properties:
    -   name: "compatible"
        constraint: |
            "ti,twl4030-rtc"

    interrupts:

...

# * TI twl RTC
#
# The TWL family (twl4030/6030) contains a RTC.
#
# Required properties:
# - compatible : Should be twl4030-rtc
#
# Examples:
#
# rtc@0 {
#     compatible = "ti,twl4030-rtc";
# };
```

## Documentation/devicetree/bindings/rtc/via,vt8500-rtc.yaml
```yaml
%YAML 1.2
---
version: 1

id: via,vt8500-rtc

title: VIA/Wondermedia VT8500 Realtime Clock Controller

maintainer:
    -   name: Tony Prisk <linux@prisktech.co.nz>

description: >
    TODO

inherits:
    -   id: %ids%

properties:
    -   name: "compatible"
        constraint: |
            "via,vt8500-rtc"

    interrupts:
    reg:

...

# VIA/Wondermedia VT8500 Realtime Clock Controller
# -----------------------------------------------------
#
# Required properties:
# - compatible : "via,vt8500-rtc"
# - reg : Should contain 1 register ranges(address and length)
# - interrupts : alarm interrupt
#
# Example:
#
# 	rtc@d8100000 {
# 		compatible = "via,vt8500-rtc";
# 		reg = <0xd8100000 0x10000>;
# 		interrupts = <48>;
# 	};
```

## Documentation/devicetree/bindings/serial/altera_jtaguart.yaml
```yaml
%YAML 1.2
---
version: 1

id: altera_jtaguart

title: Altera JTAG UART

maintainer:
    -   name: Dinh Nguyen <dinguyen@altera.com>

description: >
    TODO

inherits:
    -   id: %ids%

properties:
    -   name: "compatible"
        constraint: |
            "altr,juart-1"."0"

    interrupt-parent:
    interrupts:
    reg:

...

# Altera JTAG UART
#
# Required properties:
# - compatible : should be "ALTR,juart-1.0" <DEPRECATED>
# - compatible : should be "altr,juart-1.0"
```

## Documentation/devicetree/bindings/serial/altera_uart.yaml
```yaml
%YAML 1.2
---
version: 1

id: altera_uart

title: Altera UART

maintainer:
    -   name: Dinh Nguyen <dinguyen@altera.com>

description: >
    TODO

inherits:
    -   id: %ids%

properties:
    -   name: "compatible"
        constraint: |
            "altr,uart-1"."0"

    clock-frequency:
    current-speed:
    interrupt-parent:
    interrupts:
    reg:

...

# Altera UART
#
# Required properties:
# - compatible : should be "ALTR,uart-1.0" <DEPRECATED>
# - compatible : should be "altr,uart-1.0"
#
# Optional properties:
# - clock-frequency : frequency of the clock input to the UART
```

## Documentation/devicetree/bindings/serial/brcm,bcm6345-uart.yaml
```yaml
%YAML 1.2
---
version: 1

id: brcm,bcm6345-uart

title: BCM63xx UART

maintainer:
    -   name: Scott Branden <sbranden@broadcom.com>

description: >
    TODO

inherits:
    -   id: %ids%

properties:
    -   name: "compatible"
        constraint: |
            "brcm,bcm6345-uart"

    clock-names:
    clocks:
    interrupt-parent:
    interrupts:
    reg:
    status:

...

# * BCM63xx UART
#
# Required properties:
#
# - compatible: "brcm,bcm6345-uart"
#
# - reg: The base address of the UART register bank.
#
# - interrupts: A single interrupt specifier.
#
# - clocks: Clock driving the hardware; used to figure out the baud rate
#   divisor.
#
# Example:
#
# 	uart0: serial@14e00520 {
# 		compatible = "brcm,bcm6345-uart";
# 		reg = <0x14e00520 0x18>;
# 		interrupt-parent = <&periph_intc>;
# 		interrupts = <2>;
# 		clocks = <&periph_clk>;
# 	};
#
# 	clocks {
# 		periph_clk: periph_clk@0 {
# 			compatible = "fixed-clock";
# 			#clock-cells = <0>;
# 			clock-frequency = <54000000>;
# 		};
# 	};
```

## Documentation/devicetree/bindings/serial/cavium-uart.yaml
```yaml
%YAML 1.2
---
version: 1

id: cavium-uart

title: Universal Asynchronous Receiver/Transmitter (UART)

maintainer:
    -   name: David Daney <david.daney@cavium.com>

description: >
    TODO

inherits:
    -   id: %ids%

properties:
    -   name: "compatible"
        constraint: |
            "xlnx,xps-uart16550-2"."00"."b" && "ns16550"
            "ns16550"

    clock-frequency:
    clocks:
    current-speed:
    device_type:
    interrupt-parent:
    interrupts:
    no-loopback-test:
    reg:
    reg-io-width:
    reg-shift:
    status:
    virtual-reg:

...

# * Universal Asynchronous Receiver/Transmitter (UART)
#
# - compatible: "cavium,octeon-3860-uart"
#
#   Compatibility with all cn3XXX, cn5XXX and cn6XXX SOCs.
#
# - reg: The base address of the UART register bank.
#
# - interrupts: A single interrupt specifier.
#
# - current-speed: Optional, the current bit rate in bits per second.
#
# Example:
# 	uart1: serial@1180000000c00 {
# 		compatible = "cavium,octeon-3860-uart","ns16550";
# 		reg = <0x11800 0x00000c00 0x0 0x400>;
# 		current-speed = <115200>;
# 		interrupts = <0 35>;
# 	};
```

## Documentation/devicetree/bindings/serial/digicolor-usart.yaml
```yaml
%YAML 1.2
---
version: 1

id: digicolor-usart

title: Binding for Conexant Digicolor USART

maintainer:
    -   name: Baruch Siach <baruch@tkos.co.il>

description: >
    TODO

inherits:
    -   id: %ids%

properties:
    -   name: "compatible"
        constraint: |
            "cnxt,cx92755-usart"

    clocks:
    interrupts:
    reg:
    status:

...

# Binding for Conexant Digicolor USART
#
# Note: this binding is only applicable for using the USART peripheral as
# UART. USART also support synchronous serial protocols like SPI and I2S. Use
# the binding that matches the wiring of your system.
#
# Required properties:
# - compatible : should be "cnxt,cx92755-usart".
# - reg: Should contain USART controller registers location and length.
# - interrupts: Should contain a single USART controller interrupt.
# - clocks: Must contain phandles to the USART clock
#   See ../clocks/clock-bindings.txt for details.
#
# Note: Each UART port should have an alias correctly numbered
# in "aliases" node.
#
# Example:
# 	aliases {
# 		serial0 = &uart0;
# 	};
#
# 	uart0: uart@f0000740 {
# 		compatible = "cnxt,cx92755-usart";
# 		reg = <0xf0000740 0x20>;
# 		clocks = <&main_clk>;
# 		interrupts = <44>;
# 	};
```

## Documentation/devicetree/bindings/serial/fsl-imx-uart.yaml
```yaml
%YAML 1.2
---
version: 1

id: fsl-imx-uart

title: Freescale i.MX Universal Asynchronous Receiver/Transmitter (UART)

maintainer:
    -   name: Kumar Gala <galak@codeaurora.org>

description: >
    TODO

inherits:
    -   id: %ids%

properties:
    -   name: "compatible"
        constraint: |
            "fsl,imx7d-uart" && "fsl,imx6q-uart"
            "fsl,imx6ul-uart" && "fsl,imx6q-uart"
            "fsl,imx6sx-uart" && "fsl,imx21-uart"
            "fsl,imx6sl-uart" && "fsl,imx6q-uart" && "fsl,imx21-uart"
            "fsl,imx6q-uart" && "fsl,imx21-uart"
            "fsl,imx53-uart" && "fsl,imx21-uart"
            "fsl,imx51-uart" && "fsl,imx21-uart"
            "fsl,imx50-uart" && "fsl,imx21-uart"
            "fsl,imx35-uart" && "fsl,imx21-uart"
            "fsl,imx31-uart" && "fsl,imx21-uart"
            "fsl,imx27-uart" && "fsl,imx21-uart"
            "fsl,imx25-uart" && "fsl,imx21-uart"
            "fsl,imx1-uart"

    clock-names:
    clocks:
    fsl,uart-has-rtscts:
    interrupts:
    pinctrl-0:
    pinctrl-names:
    reg:
    status:

...

# * Freescale i.MX Universal Asynchronous Receiver/Transmitter (UART)
#
# Required properties:
# - compatible : Should be "fsl,<soc>-uart"
# - reg : Address and length of the register set for the device
# - interrupts : Should contain uart interrupt
#
# Optional properties:
# - fsl,uart-has-rtscts : Indicate the uart has rts and cts
# - fsl,irda-mode : Indicate the uart supports irda mode
# - fsl,dte-mode : Indicate the uart works in DTE mode. The uart works
#                   is DCE mode by default.
#
# Note: Each uart controller should have an alias correctly numbered
# in "aliases" node.
#
# Example:
#
# aliases {
# 	serial0 = &uart1;
# };
#
# uart1: serial@73fbc000 {
# 	compatible = "fsl,imx51-uart", "fsl,imx21-uart";
# 	reg = <0x73fbc000 0x4000>;
# 	interrupts = <31>;
# 	fsl,uart-has-rtscts;
# 	fsl,dte-mode;
# };
```

## Documentation/devicetree/bindings/serial/mrvl-serial.yaml
```yaml
%YAML 1.2
---
version: 1

id: mrvl-serial

title: PXA UART controller

maintainer:
    -   name: Haojian Zhuang <haojian.zhuang@marvell.com>

description: >
    TODO

inherits:
    -   id: %ids%

properties:
    -   name: "compatible"
        constraint: |
            "mrvl,pxa-uart"
            "mrvl,mmp-uart"

    clocks:
    interrupts:
    reg:
    resets:
    status:

...

# PXA UART controller
#
# Required properties:
# - compatible : should be "mrvl,mmp-uart" or "mrvl,pxa-uart".
```

## Documentation/devicetree/bindings/serial/nxp,lpc1850-uart.yaml
```yaml
%YAML 1.2
---
version: 1

id: nxp,lpc1850-uart

title: NXP LPC1850 UART

maintainer:
    -   name: Joachim Eastwood <manabian@gmail.com>

description: >
    TODO

inherits:
    -   id: %ids%

properties:
    -   name: "compatible"
        constraint: |
            "opencores,uart16550-rtlsvn105" && "ns16550a"
            "nxp,lpc1850-uart" && "ns16550a"
            "ns16550a"

    bank-width:
    clock-frequency:
    clocks:
    current-speed:
    device_type:
    gpmc,access-ns:
    gpmc,adv-on-ns:
    gpmc,adv-rd-off-ns:
    gpmc,adv-wr-off-ns:
    gpmc,bus-turnaround-ns:
    gpmc,clk-activation-ns:
    gpmc,cs-on-ns:
    gpmc,cs-rd-off-ns:
    gpmc,cs-wr-off-ns:
    gpmc,cycle2cycle-delay-ns:
    gpmc,cycle2cycle-diffcsen:
    gpmc,cycle2cycle-samecsen:
    gpmc,device-width:
    gpmc,mux-add-data:
    gpmc,oe-off-ns:
    gpmc,oe-on-ns:
    gpmc,page-burst-access-ns:
    gpmc,rd-cycle-ns:
    gpmc,wait-monitoring-ns:
    gpmc,wait-pin:
    gpmc,we-off-ns:
    gpmc,we-on-ns:
    gpmc,wr-access-ns:
    gpmc,wr-cycle-ns:
    gpmc,wr-data-mux-bus-ns:
    interrupt-parent:
    interrupts:
    native-endian:
    no-loopback-test:
    pinctrl-0:
    pinctrl-names:
    reg:
    reg-io-width:
    reg-shift:
    status:
    virtual-reg:

...

# * NXP LPC1850 UART
#
# Required properties:
# - compatible	: "nxp,lpc1850-uart", "ns16550a".
# - reg		: offset and length of the register set for the device.
# - interrupts	: should contain uart interrupt.
# - clocks	: phandle to the input clocks.
# - clock-names	: required elements: "uartclk", "reg".
#
# Optional properties:
# - dmas		: Two or more DMA channel specifiers following the
# 		  convention outlined in bindings/dma/dma.txt
# - dma-names	: Names for the dma channels, if present. There must
# 		  be at least one channel named "tx" for transmit
# 		  and named "rx" for receive.
#
# Since it's also possible to also use the of_serial.c driver all
# parameters from 8250.txt also apply but are optional.
#
# Example:
# uart0: serial@40081000 {
# 	compatible = "nxp,lpc1850-uart", "ns16550a";
# 	reg = <0x40081000 0x1000>;
# 	reg-shift = <2>;
# 	interrupts = <24>;
# 	clocks = <&ccu2 CLK_APB0_UART0>, <&ccu1 CLK_CPU_UART0>;
# 	clock-names = "uartclk", "reg";
# };
```

## Documentation/devicetree/bindings/serial/nxp-lpc32xx-hsuart.yaml
```yaml
%YAML 1.2
---
version: 1

id: nxp-lpc32xx-hsuart

title: NXP LPC32xx SoC High Speed UART

maintainer:
    -   name: Kumar Gala <galak@codeaurora.org>

description: >
    TODO

inherits:
    -   id: %ids%

properties:
    -   name: "compatible"
        constraint: |
            "nxp,lpc3220-hsuart"

    interrupts:
    reg:
    status:

...

# * NXP LPC32xx SoC High Speed UART
#
# Required properties:
# - compatible: Should be "nxp,lpc3220-hsuart"
# - reg: Should contain registers location and length
# - interrupts: Should contain interrupt
#
# Example:
#
# 	uart1: serial@40014000 {
# 		compatible = "nxp,lpc3220-hsuart";
# 		reg = <0x40014000 0x1000>;
# 		interrupts = <26 0>;
# 	};
```
