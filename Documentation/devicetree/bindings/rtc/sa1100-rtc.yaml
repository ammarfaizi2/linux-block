## Documentation/devicetree/bindings/soc/fsl/qman-portals.yaml
```yaml
%YAML 1.2
---
version: 1

id: qman-portals

title: QorIQ DPAA Queue Manager Portals Device Tree Binding

maintainer:
    -   name: Emil Medve <Emilian.Medve@freescale.com>

description: >
    TODO

inherits:
    -   id: %ids%

properties:
    -   name: "compatible"
        constraint: |
            "xlnx,plb-v46-1"."03"."a" && "xlnx,plb-v46-1"."00"."a" && "simple-bus"
            "xlnx,plb-v46-1"."03"."a" && "simple-bus"
            "ti,dm814-scm" && "simple-bus"
            "ti,dm814-pllss" && "simple-bus"
            "ti,dm814-l4ls" && "simple-bus"
            "ti,dm814-l4hs" && "simple-bus"
            "ti,c64x"+"emifa" && "simple-bus"
            "st,stih418-clk" && "simple-bus"
            "st,stih410-clk" && "simple-bus"
            "sirf,prima2-rtciobg" && "sirf-prima2-rtciobg-bus" && "simple-bus"
            "sirf,prima2-pciiobg" && "simple-bus"
            "simple-bus"
            "samsung,s5pv210-audss" && "simple-bus"
            "mrvl,axi-bus" && "simple-bus"
            "mrvl,apb-bus" && "simple-bus"
            "marvell,dove-pmu" && "simple-bus"
            "hawk-bridge" && "simple-bus"
            "fsl,spba-bus" && "simple-bus"
            "fsl,p1021-immr" && "simple-bus"
            "fsl,mpc885-localbus" && "fsl,pq1-localbus" && "simple-bus"
            "fsl,mpc875-immr" && "fsl,pq1-soc" && "simple-bus"
            "fsl,mpc8641-soc" && "simple-bus"
            "fsl,mpc8641-localbus" && "simple-bus"
            "fsl,mpc8610-immr" && "simple-bus"
            "fsl,mpc8610-elbc" && "fsl,elbc" && "simple-bus"
            "fsl,mpc8572-immr" && "simple-bus"
            "fsl,mpc8572-elbc" && "fsl,elbc" && "simple-bus"
            "fsl,mpc8560-localbus" && "simple-bus"
            "fsl,mpc8560-localbus" && "fsl,pq3-localbus" && "simple-bus"
            "fsl,mpc8560-immr" && "simple-bus"
            "fsl,mpc8555-immr" && "simple-bus"
            "fsl,mpc8548-localbus" && "fsl,pq3-localbus" && "simple-bus"
            "fsl,mpc8548-immr" && "simple-bus"
            "fsl,mpc8544-localbus" && "fsl,pq3-localbus" && "simple-bus"
            "fsl,mpc8544-immr" && "simple-bus"
            "fsl,mpc8541-immr" && "simple-bus"
            "fsl,mpc8540-localbus" && "fsl,pq3-localbus" && "simple-bus"
            "fsl,mpc8540-immr" && "simple-bus"
            "fsl,mpc8379-elbc" && "fsl,elbc" && "simple-bus"
            "fsl,mpc8378-elbc" && "fsl,elbc" && "simple-bus"
            "fsl,mpc8377-elbc" && "fsl,elbc" && "simple-bus"
            "fsl,mpc8360-localbus" && "fsl,pq2pro-localbus" && "simple-bus"
            "fsl,mpc8360-immr" && "simple-bus"
            "fsl,mpc8360-immr" && "fsl,immr" && "fsl,soc" && "simple-bus"
            "fsl,mpc8349-localbus" && "simple-bus"
            "fsl,mpc8349e-localbus" && "fsl,pq2pro-localbus" && "simple-bus"
            "fsl,mpc8347e-localbus" && "fsl,pq2pro-localbus" && "simple-bus"
            "fsl,mpc8315-immr" && "simple-bus"
            "fsl,mpc8315-elbc" && "fsl,elbc" && "simple-bus"
            "fsl,mpc8313-elbc" && "fsl,elbc" && "simple-bus"
            "fsl,mpc8308-immr" && "simple-bus"
            "fsl,mpc8248-immr" && "fsl,pq2-soc" && "simple-bus"
            "fsl,mpc8247-immr" && "fsl,pq2-soc" && "simple-bus"
            "fsl,mpc5200-lpb" && "simple-bus"
            "fsl,mpc5200b-lpb" && "simple-bus"
            "fsl,mpc5200b-lpb" && "fsl,mpc5200-lpb" && "simple-bus"
            "fsl,emi" && "simple-bus"
            "fsl,emi-bus" && "simple-bus"
            "fsl,eim-bus" && "simple-bus"
            "fsl,aips" && "simple-bus"
            "fsl,aips-bus" && "simple-bus"
            "fsl,aipi-bus" && "simple-bus"
            "arteris," && "flexnoc" && "simple-bus"
            "arm,vexpress,v2m-p1" && "simple-bus"
            "arm,versatile-fpga" && "simple-bus"
            "arm,amba-bus" && "simple-bus"
            "altr,avalon" && "simple-bus"
            "abilis,tb10x" && "simple-bus"

    #address-cells:
    bus-frequency:
    device_type:
    ranges:
    #size-cells:

...

# QorIQ DPAA Queue Manager Portals Device Tree Binding
#
# Copyright (C) 2008 - 2014 Freescale Semiconductor Inc.
#
# CONTENTS
#
# 	- QMan Portal
# 	- QMan Pool Channel
# 	- Example
#
# QMan Portal Node
#
# Portals are memory mapped interfaces to QMan that allow low-latency, lock-less
# interaction by software running on processor cores, accelerators and network
# interfaces with the QMan
#
# PROPERTIES
#
# - compatible
# 	Usage:		Required
# 	Value type:	<stringlist>
# 	Definition:	Must include "fsl,qman-portal-<hardware revision>"
# 			May include "fsl,<SoC>-qman-portal" or "fsl,qman-portal"
#
# - reg
# 	Usage:		Required
# 	Value type:	<prop-encoded-array>
# 	Definition:	Two regions. The first is the cache-enabled region of
# 			the portal. The second is the cache-inhibited region of
# 			the portal
#
# - interrupts
# 	Usage:		Required
# 	Value type:	<prop-encoded-array>
# 	Definition:	Standard property
#
# - fsl,liodn
# 	Usage:		See pamu.txt
# 	Value type:	<prop-encoded-array>
# 	Definition:	Two LIODN(s). DQRR LIODN (DLIODN) and Frame LIODN
# 			(FLIODN)
#
# - fsl,iommu-parent
# 	Usage:		See pamu.txt
# 	Value type:	<phandle>
# 	Definition:	PAMU property used for dynamic LIODN assignment
#
# 	For additional details about the PAMU/LIODN binding(s) see pamu.txt
#
# - cell-index
# 	Usage:		Required
# 	Value type:	<u32>
# 	Definition:	The hardware index of the channel. This can also be
# 			determined by dividing any of the channel's 8 work queue
# 			IDs by 8
#
# In addition to these properties the qman-portals should have sub-nodes to
# represent the HW devices/portals that are connected to the software portal
# described here
#
# The currently supported sub-nodes are:
# 	* fman0
# 	* fman1
# 	* pme
# 	* crypto
#
# These subnodes should have the following properties:
#
# - fsl,liodn
# 	Usage:		See pamu.txt
# 	Value type:	<prop-encoded-array>
# 	Definition:	PAMU property used for static LIODN assignment
#
# - fsl,iommu-parent
# 	Usage:		See pamu.txt
# 	Value type:	<phandle>
# 	Definition:	PAMU property used for dynamic LIODN assignment
#
# - dev-handle
# 	Usage:		Required
# 	Value type:	<phandle>
# 	Definition:	The phandle to the particular hardware device that this
# 			portal is connected to.
#
# DPAA QMan Pool Channel Nodes
#
# Pool Channels are defined with the following properties.
#
# PROPERTIES
#
# - compatible
# 	Usage:		Required
# 	Value type:	<stringlist>
# 	Definition:	Must include "fsl,qman-pool-channel"
# 			May include "fsl,<SoC>-qman-pool-channel"
#
# - fsl,qman-channel-id
# 	Usage:		Required
# 	Value type:	<u32>
# 	Definition:	The hardware index of the channel. This can also be
# 			determined by dividing any of the channel's 8 work queue
# 			IDs by 8
#
# EXAMPLE
#
# The example below shows a (P4080) QMan portals container/bus node with two portals
#
# 	qman-portals@ff4200000 {
# 		#address-cells = <1>;
# 		#size-cells = <1>;
# 		compatible = "simple-bus";
# 		ranges = <0 0xf 0xf4200000 0x200000>;
#
# 		qman-portal@0 {
# 			compatible = "fsl,qman-portal-1.2.0", "fsl,qman-portal";
# 			reg = <0 0x4000>, <0x100000 0x1000>;
# 			interrupts = <104 2 0 0>;
# 			fsl,liodn = <1 2>;
# 			fsl,qman-channel-id = <0>;
#
# 			fman0 {
# 				fsl,liodn = <0x21>;
# 				dev-handle = <&fman0>;
# 			};
# 			fman1 {
# 				fsl,liodn = <0xa1>;
# 				dev-handle = <&fman1>;
# 			};
# 			crypto {
# 				fsl,liodn = <0x41 0x66>;
# 				dev-handle = <&crypto>;
# 			};
# 		};
# 		qman-portal@4000 {
# 			compatible = "fsl,qman-portal-1.2.0", "fsl,qman-portal";
# 			reg = <0x4000 0x4000>, <0x101000 0x1000>;
# 			interrupts = <106 2 0 0>;
# 			fsl,liodn = <3 4>;
# 			cell-index = <1>;
#
# 			fman0 {
# 				fsl,liodn = <0x22>;
# 				dev-handle = <&fman0>;
# 			};
# 			fman1 {
# 				fsl,liodn = <0xa2>;
# 				dev-handle = <&fman1>;
# 			};
# 			crypto {
# 				fsl,liodn = <0x42 0x67>;
# 				dev-handle = <&crypto>;
# 			};
# 		};
# 	};
```

## Documentation/devicetree/bindings/soc/qcom/qcom,glink.txt
```
Qualcomm RPM GLINK binding

This binding describes the Qualcomm RPM GLINK, a fifo based mechanism for
communication with the Resource Power Management system on various Qualcomm
platforms.

- compatible:
	Usage: required
	Value type: <stringlist>
	Definition: must be "qcom,glink-rpm"

- interrupts:
	Usage: required
	Value type: <prop-encoded-array>
	Definition: should specify the IRQ used by the remote processor to
		    signal this processor about communication related events

- qcom,rpm-msg-ram:
	Usage: required
	Value type: <prop-encoded-array>
	Definition: handle to RPM message memory resource

- qcom,ipc:
	Usage: required
	Value type: <prop-encoded-array>
	Definition: three entries specifying the outgoing ipc bit used for
		    signaling the remote processor:
		    - phandle to a syscon node representing the apcs registers
		    - u32 representing offset to the register within the syscon
		    - u32 representing the ipc bit within the register

= GLINK DEVICES
Each subnode of the GLINK node represent function tied to a virtual
communication channel. The name of the nodes are not important. The properties
of these nodes are defined by the individual bindings for the specific function
- but must contain the following property:

- qcom,glink-channels:
	Usage: required
	Value type: <stringlist>
	Definition: a list of channels tied to this function, used for matching
		    the function to a set of virtual channels

= EXAMPLE
The following example represents the GLINK RPM node on a MSM8996 device, with
the function for the "rpm_request" channel defined, which is used for
regualtors and root clocks.

	apcs: syscon@f9011000 {
		compatible = "syscon";
		reg = <0xf9011000 0x1000>;
	};

	rpm_msg_ram: memory@68000 {
		compatible = "qcom,rpm-msg-ram";
		reg = <0x68000 0x6000>;
	};

        rpm-glink {
		compatible = "qcom,glink-rpm";

		interrupts = <GIC_SPI 168 IRQ_TYPE_EDGE_RISING>;

		qcom,rpm-msg-ram = <&rpm_msg_ram>;
		qcom,ipc = <&apcs 0x10 0>;

		rpm-requests {
			compatible = "qcom,rpm-msm8996";
			qcom,glink-channels = "rpm_requests";

			...
		};
	};
```

## Documentation/devicetree/bindings/sound/ak4642.yaml
```yaml
%YAML 1.2
---
version: 1

id: ak4642

title: AK4642 I2C transmitter

maintainer:
    -   name: Kuninori Morimoto <kuninori.morimoto.gx@renesas.com>

description: >
    TODO

inherits:
    -   id: %ids%

properties:
    -   name: "compatible"
        constraint: |
            "asahi-kasei,ak4643"

    reg:
    #sound-dai-cells:

...

# AK4642 I2C transmitter
#
# This device supports I2C mode only.
#
# Required properties:
#
#   - compatible : "asahi-kasei,ak4642" or "asahi-kasei,ak4643" or "asahi-kasei,ak4648"
#   - reg : The chip select number on the I2C bus
#
# Example:
#
# &i2c {
# 	ak4648: ak4648@0x12 {
# 		compatible = "asahi-kasei,ak4642";
# 		reg = <0x12>;
# 	};
# };
```

## Documentation/devicetree/bindings/sound/atmel-at91sam9g20ek-wm8731-audio.yaml
```yaml
%YAML 1.2
---
version: 1

id: atmel-at91sam9g20ek-wm8731-audio

title: Atmel at91sam9g20ek wm8731 audio complex

maintainer:
    -   name: Bo Shen <voice.shen@atmel.com>

description: >
    TODO

inherits:
    -   id: %ids%

properties:
    -   name: "compatible"
        constraint: |
            "atmel,at91sam9g20ek-wm8731-audio"

    atmel,audio-codec:
    atmel,audio-routing:
    atmel,model:
    atmel,ssc-controller:
    pinctrl-0:
    pinctrl-names:

...

# * Atmel at91sam9g20ek wm8731 audio complex
#
# Required properties:
#   - compatible: "atmel,at91sam9g20ek-wm8731-audio"
#   - atmel,model: The user-visible name of this sound complex.
#   - atmel,audio-routing: A list of the connections between audio components.
#   - atmel,ssc-controller: The phandle of the SSC controller
#   - atmel,audio-codec: The phandle of the WM8731 audio codec
# Optional properties:
#   - pinctrl-names, pinctrl-0: Please refer to pinctrl-bindings.txt
#
# Example:
# sound {
# 	compatible = "atmel,at91sam9g20ek-wm8731-audio";
# 	pinctrl-names = "default";
# 	pinctrl-0 = <&pinctrl_pck0_as_mck>;
#
# 	atmel,model = "wm8731 @ AT91SAMG20EK";
#
# 	atmel,audio-routing =
# 		"Ext Spk", "LHPOUT",
# 		"Int MIC", "MICIN";
#
# 	atmel,ssc-controller = <&ssc0>;
# 	atmel,audio-codec = <&wm8731>;
# };
```

## Documentation/devicetree/bindings/sound/atmel_ac97c.yaml
```yaml
%YAML 1.2
---
version: 1

id: atmel_ac97c

title: Atmel AC97 controller

maintainer:
    -   name: Alexander Stein <alexanders83@web.de>

description: >
    TODO

inherits:
    -   id: %ids%

properties:
    -   name: "compatible"
        constraint: |
            "atmel,at91sam9263-ac97c"

    clock-names:
    clocks:
    interrupts:
    pinctrl-0:
    pinctrl-names:
    reg:
    status:

...

# * Atmel AC97 controller
#
# Required properties:
#   - compatible: "atmel,at91sam9263-ac97c"
#   - reg: Address and length of the register set for the device
#   - interrupts: Should contain AC97 interrupt
#   - ac97-gpios: Please refer to soc-ac97link.txt, only ac97-reset is used
# Optional properties:
#   - pinctrl-names, pinctrl-0: Please refer to pinctrl-bindings.txt
#
# Example:
# sound@fffa0000 {
#        compatible = "atmel,at91sam9263-ac97c";
#        pinctrl-names = "default";
#        pinctrl-0 = <&pinctrl_ac97>;
#        reg = <0xfffa0000 0x4000>;
#        interrupts = <18 IRQ_TYPE_LEVEL_HIGH 5>;
#
#        ac97-gpios = <&pioB 0 0 &pioB 2 0 &pioC 29 GPIO_ACTIVE_LOW>;
# };
```

## Documentation/devicetree/bindings/sound/cs4270.yaml
```yaml
%YAML 1.2
---
version: 1

id: cs4270

title: CS4270 audio CODEC

maintainer:
    -   name: Daniel Mack <zonque@gmail.com>

description: >
    TODO

inherits:
    -   id: %ids%

properties:
    -   name: "compatible"
        constraint: |
            "cirrus,cs4270"

    clock-frequency:
    reg:

...

# CS4270 audio CODEC
#
# The driver for this device currently only supports I2C.
#
# Required properties:
#
#   - compatible : "cirrus,cs4270"
#
#   - reg : the I2C address of the device for I2C
#
# Optional properties:
#
#   - reset-gpio : a GPIO spec for the reset pin. If specified, it will be
# 		 deasserted before communication to the codec starts.
#
# Example:
#
# codec: cs4270@48 {
# 	compatible = "cirrus,cs4270";
# 	reg = <0x48>;
# };
```

## Documentation/devicetree/bindings/sound/designware-i2s.yaml
```yaml
%YAML 1.2
---
version: 1

id: designware-i2s

title: DesignWare I2S controller

maintainer:
    -   name: Andrew Jackson <Andrew.Jackson@arm.com>

description: >
    TODO

inherits:
    -   id: %ids%

properties:
    -   name: "compatible"
        constraint: |
            "snps,designware-i2s"

    channel:
    interrupt-names:
    interrupts:
    play:
    record:
    reg:
    status:

...

# DesignWare I2S controller
#
# Required properties:
#  - compatible : Must be "snps,designware-i2s"
#  - reg : Must contain the I2S core's registers location and length
#  - clocks : Pairs of phandle and specifier referencing the controller's
#    clocks. The controller expects one clock: the clock used as the sampling
#    rate reference clock sample.
#  - clock-names : "i2sclk" for the sample rate reference clock.
#  - dmas: Pairs of phandle and specifier for the DMA channels that are used by
#    the core. The core expects one or two dma channels: one for transmit and
#    one for receive.
#  - dma-names : "tx" for the transmit channel, "rx" for the receive channel.
#
# For more details on the 'dma', 'dma-names', 'clock' and 'clock-names'
# properties please check:
# 	* resource-names.txt
# 	* clock/clock-bindings.txt
# 	* dma/dma.txt
#
# Example:
#
# 	soc_i2s: i2s@7ff90000 {
# 		compatible = "snps,designware-i2s";
# 		reg = <0x0 0x7ff90000 0x0 0x1000>;
# 		clocks = <&scpi_i2sclk 0>;
# 		clock-names = "i2sclk";
# 		#sound-dai-cells = <0>;
# 		dmas = <&dma0 5>;
# 		dma-names = "tx";
# 	};
```
