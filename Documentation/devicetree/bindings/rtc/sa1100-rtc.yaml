## Documentation/devicetree/bindings/serial/omap_serial.yaml
```yaml
%YAML 1.2
---
version: 1

id: omap_serial

title: OMAP UART controller

maintainer:
    -   name: Sekhar Nori <nsekhar@ti.com>

description: >
    TODO

inherits:
    -   id: %ids%

properties:
    -   name: "compatible"
        constraint: |
            "ti,omap4-uart"
            "ti,omap3-uart"
            "ti,omap2-uart"
            "ti,dra742-uart" && "ti,omap4-uart"
            "ti,am4372-uart" && "ti,omap2-uart"
            "ti,am3352-uart" && "ti,omap3-uart"

    clock-frequency:
    cts-gpios:
    dcd-gpios:
    dma-names:
    dmas:
    dsr-gpios:
    dtr-gpios:
    interrupts:
    linux,rs485-enabled-at-boot-time:
    pinctrl-0:
    pinctrl-names:
    reg:
    rng-gpios:
    rs485-rts-active-high:
    rs485-rts-delay:
    rs485-rx-during-tx:
    rts-gpio:
    rts-gpios:
    status:
    ti,hwmods:

...

# OMAP UART controller
#
# Required properties:
# - compatible : should be "ti,omap2-uart" for OMAP2 controllers
# - compatible : should be "ti,omap3-uart" for OMAP3 controllers
# - compatible : should be "ti,omap4-uart" for OMAP4 controllers
# - compatible : should be "ti,am4372-uart" for AM437x controllers
# - compatible : should be "ti,am3352-uart" for AM335x controllers
# - compatible : should be "ti,dra742-uart" for DRA7x controllers
# - reg : address and length of the register space
# - interrupts or interrupts-extended : Should contain the uart interrupt
#                                       specifier or both the interrupt
#                                       controller phandle and interrupt
#                                       specifier.
# - ti,hwmods : Must be "uart<n>", n being the instance number (1-based)
#
# Optional properties:
# - clock-frequency : frequency of the clock input to the UART
# - dmas : DMA specifier, consisting of a phandle to the DMA controller
#          node and a DMA channel number.
# - dma-names : "rx" for receive channel, "tx" for transmit channel.
#
# Example:
#
#                 uart4: serial@49042000 {
#                         compatible = "ti,omap3-uart";
#                         reg = <0x49042000 0x400>;
#                         interrupts = <80>;
#                         dmas = <&sdma 81 &sdma 82>;
#                         dma-names = "tx", "rx";
#                         ti,hwmods = "uart4";
#                         clock-frequency = <48000000>;
#                 };
```

## Documentation/devicetree/bindings/serial/uniphier-uart.yaml
```yaml
%YAML 1.2
---
version: 1

id: uniphier-uart

title: UniPhier UART controller

maintainer:
    -   name: Masahiro Yamada <yamada.masahiro@socionext.com>

description: >
    TODO

inherits:
    -   id: %ids%

properties:
    -   name: "compatible"
        constraint: |
            "socionext,uniphier-uart"

    clocks:
    fifo-size:
    interrupts:
    pinctrl-0:
    pinctrl-names:
    reg:
    status:

...

# UniPhier UART controller
#
# Required properties:
# - compatible: should be "socionext,uniphier-uart".
# - reg: offset and length of the register set for the device.
# - interrupts: a single interrupt specifier.
# - clocks: phandle to the input clock.
#
# Optional properties:
# - fifo-size: the RX/TX FIFO size.  Defaults to 64 if not specified.
#
# Example:
# 	aliases {
# 		serial0 = &serial0;
# 	};
#
# 	serial0: serial@54006800 {
# 		compatible = "socionext,uniphier-uart";
# 		reg = <0x54006800 0x40>;
# 		interrupts = <0 33 4>;
# 		clocks = <&uart_clk>;
# 		fifo-size = <64>;
# 	};
```

## Documentation/devicetree/bindings/serio/snps-arc_ps2.yaml
```yaml
%YAML 1.2
---
version: 1

id: snps-arc_ps2

title: ARC PS/2 driver: PS/2 block used in some ARC FPGA's  %title% nSIM OSCI model

maintainer:
    -   name: Mischa Jonker <Mischa.Jonker@synopsys.com>

description: >
    TODO

inherits:
    -   id: %ids%

properties:
    -   name: "compatible"
        constraint: |
            "snps,arc"_"ps2"

    interrupt-names:
    interrupt-parent:
    interrupts:
    reg:

...

# * ARC PS/2 driver: PS/2 block used in some ARC FPGA's & nSIM OSCI model
#
# Required properties:
# - compatible		: "snps,arc_ps2"
# - reg			: offset and length (always 0x14) of registers
# - interrupts		: interrupt
# - interrupt-names	: name of interrupt, must be "arc_ps2_irq"
#
# Example:
#
# serio@c9000400 {
# 	compatible = "snps,arc_ps2";
# 	reg = <0xc9000400 0x14>;
# 	interrupts = <13>;
# 	interrupt-names = "arc_ps2_irq";
# }
```

## Documentation/devicetree/bindings/skeleton.yaml
```yaml
%YAML 1.2
---
version: 1

id: skel-device

title: Skeleton Device

maintainer:
    -   name: Skeleton Person <skel@kernel.org>

description: >
    The Skeleton Device binding represents the SK11 device produced by
    the Skeleton Corporation. The binding can also support compatible
    clones made by second source vendors.

# This binding inherits property characteristics from the generic
# spi-slave binding

inherits:
    -   id: spi-slave

properties:

# The compatible property is a reserved name. The type is always "string"
# and should not be repeated device binding.

    -   name: "compatible"
        constraint: |
            "skel,sk11" || "faux,fx11" , BASE("skel,sk11")
        description: FX11 is a clone of the original SK11 device

# The reg property is a reserved name. The type is always "int" and
# should not be repeated in a device binding. Constraints are defined
# only in the context of the parent node's address, size, and ranges
# cells. The description is inherited from the spi-slave binding.

    -   name: "reg"

# spi-max-frequency needs the device-specific constraint to be supplied

    -   name: "spi-max-frequency"
        constraint: |
            if (compatible == "skel,sk11") c <= 10000000 else c <= 1000000

# This property overrides the generic binding description with
# a device specific description in order to mention the chip's
# h/w cfg strapping pins.

    -   name: "spi-cs-high"
        description: >
            Set if skeleton device configuration pins are set for chip
            select polarity high

# Device specific properties don't inherit characteristic from a generic
# binding so category, type, constraint, and description must be specified
# if needed.

    -   name: "skel,deprecated1"
        category: deprecated
        type: int
        constraint: |
            (c >= 100000) && (c <= 200000)
        description: >
            First of two deprecated properties.

# There are no constraints for properties of empty type

    -   name: "skel,deprecated2"
        category: deprecated
        type: empty
        description: >
            Second of two deprecated properties.

# This example could be auto-generated rather than explicitly included
# in the yaml source.

example:
    -   dts: |
            sk11@0 {
                compatible = "skel,sk11";
                reg = <0>;
                spi-max-frequency = <1000000>;
                spi-cs-high;
            };
...

---
version: 1

id: skel-mini

title: Skeleton Mini Device

maintainer:
    -   name: Rogue Developer <rogue@gmail.com>

description: >
    The Skeleton Mini Device binding represents the SK47x series devices
    produced by the Skeleton Corporation.

properties:
    -   name: "compatible"
        category: required
        constraint: |
            "skel,sk472" || skel,sk473" || "skel,sk474" , BASE("skel,sk472")
        deprecated: "skel,sk47x"
        description: >
            SK472 is the original part in the family. SK473/4 are later releases
            with minor register changes.

    -   name: "reg"
        category: required
        description: Address and size of Skeleton Mini register range.

    -   name: "skel,sync-mode"
        category: optional
        type: empty
        description: Enable synchronous transfer mode

example:
    -   dts: |
            sk472@beef0000 {
                compatible = "skel,sk472";
                reg = <0xbeef0000 0x100>;
            };
        description: >
            Demonstrates an SK472 in normal mode.

    -   dts: |
            sk474@dead0000 {
                compatible = "skel,sk474", "skel,sk472";
                reg = <0xdead0000 0x100>;
                skel,sync-mode;
            };
        description: >
            Demonstrates an SK474 in synchronous mode.
...
```

## Documentation/devicetree/bindings/soc/apple/apple,nvme-ans.yaml
```yaml
# SPDX-License-Identifier: GPL-2.0 OR BSD-2-Clause
%YAML 1.2
---
$id: http://devicetree.org/schemas/soc/apple/apple,nvme-ans.yaml#
$schema: http://devicetree.org/meta-schemas/core.yaml#

title: Apple ANS NVM Express host controller

maintainers:
  - Sven Peter <sven@svenpeter.dev>

properties:
  compatible:
    items:
      - enum:
          - apple,t8103-nvme-ans2
          - apple,t6000-nvme-ans2
      - const: apple,nvme-ans2

  reg:
    items:
      - description: NVMe and NVMMU registers
      - description: ANS2 co-processor control registers

  reg-names:
    items:
      - const: nvme
      - const: ans

  resets:
    maxItems: 1

  power-domains:
    maxItems: 1

  mboxes:
    maxItems: 1
    description: Mailbox of the ANS2 co-processor

  interrupts:
    maxItems: 1

  apple,sart:
    maxItems: 1
    $ref: /schemas/types.yaml#/definitions/phandle
    description: |
      Reference to the SART address filter.

      The SART address filter is documented in apple,sart.yaml.

required:
  - compatible
  - reg
  - reg-names
  - resets
  - mboxes
  - interrupts
  - apple,sart

additionalProperties: false

examples:
  - |
    #include <dt-bindings/interrupt-controller/apple-aic.h>
    #include <dt-bindings/interrupt-controller/irq.h>

    nvme@7bcc0000 {
      compatible = "apple,t8103-nvme-ans2", "apple,nvme-ans2";
      reg = <0x7bcc0000 0x40000>, <0x77400000 0x4000>;
      reg-names = "nvme", "ans";
      interrupts = <AIC_IRQ 590 IRQ_TYPE_LEVEL_HIGH>;
      mboxes = <&ans>;
      apple,sart = <&sart>;
      power-domains = <&ps_ans2>;
      resets = <&ps_ans2>;
     };
```
