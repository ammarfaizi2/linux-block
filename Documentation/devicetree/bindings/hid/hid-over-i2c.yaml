## Documentation/devicetree/bindings/i2c/i2c-omap.yaml
```yaml
%YAML 1.2
---
version: 1

id: i2c-omap

title: I2C for OMAP platforms

maintainer:
    -   name: Tony Lindgren <tony@atomide.com>

description: >
    TODO

inherits:
    -   id: %ids%

properties:
    -   name: "compatible"
        constraint: |
            "ti,omap4-i2c"
            "ti,omap3-i2c"
            "ti,omap2430-i2c"
            "ti,omap2420-i2c"
            "ti,am4372-i2c" && "ti,omap4-i2c"

    #address-cells:
    clock-frequency:
    interrupts:
    pinctrl-0:
    pinctrl-1:
    pinctrl-names:
    reg:
    #size-cells:
    status:
    ti,hwmods:

...

# I2C for OMAP platforms
#
# Required properties :
# - compatible : Must be "ti,omap2420-i2c", "ti,omap2430-i2c", "ti,omap3-i2c"
#   or "ti,omap4-i2c"
# - ti,hwmods : Must be "i2c<n>", n being the instance number (1-based)
# - #address-cells = <1>;
# - #size-cells = <0>;
#
# Recommended properties :
# - clock-frequency : Desired I2C bus clock frequency in Hz. Otherwise
#   the default 100 kHz frequency will be used.
#
# Optional properties:
# - Child nodes conforming to i2c bus binding
#
# Note: Current implementation will fetch base address, irq and dma
# from omap hwmod data base during device registration.
# Future plan is to migrate hwmod data base contents into device tree
# blob so that, all the required data will be used from device tree dts
# file.
#
# Examples :
#
# i2c1: i2c@0 {
#     compatible = "ti,omap3-i2c";
#     #address-cells = <1>;
#     #size-cells = <0>;
#     ti,hwmods = "i2c1";
#     clock-frequency = <400000>;
# };
```

## Documentation/devicetree/bindings/i2c/i2c-pnx.yaml
```yaml
%YAML 1.2
---
version: 1

id: i2c-pnx

title: NXP PNX I2C Controller

maintainer:
    -   name: Wolfram Sang <wolfram@the-dreams.de>

description: >
    TODO

inherits:
    -   id: %ids%

properties:
    -   name: "compatible"
        constraint: |
            "nxp,pnx-i2c"

    #address-cells:
    clock-frequency:
    interrupts:
    pnx,timeout:
    reg:
    #size-cells:

...

# * NXP PNX I2C Controller
#
# Required properties:
#
#  - reg: Offset and length of the register set for the device
#  - compatible: should be "nxp,pnx-i2c"
#  - interrupts: configure one interrupt line
#  - #address-cells: always 1 (for i2c addresses)
#  - #size-cells: always 0
#  - interrupt-parent: the phandle for the interrupt controller that
#    services interrupts for this device.
#
# Optional properties:
#
#  - clock-frequency: desired I2C bus clock frequency in Hz, Default: 100000 Hz
#
# Examples:
#
# 	i2c1: i2c@400a0000 {
# 		compatible = "nxp,pnx-i2c";
# 		reg = <0x400a0000 0x100>;
# 		interrupt-parent = <&mic>;
# 		interrupts = <51 0>;
# 		#address-cells = <1>;
# 		#size-cells = <0>;
# 	};
#
# 	i2c2: i2c@400a8000 {
# 		compatible = "nxp,pnx-i2c";
# 		reg = <0x400a8000 0x100>;
# 		interrupt-parent = <&mic>;
# 		interrupts = <50 0>;
# 		#address-cells = <1>;
# 		#size-cells = <0>;
# 		clock-frequency = <100000>;
# 	};
```

## Documentation/devicetree/bindings/i2c/i2c-sirf.yaml
```yaml
%YAML 1.2
---
version: 1

id: i2c-sirf

title: I2C for SiRFprimaII platforms

maintainer:
    -   name: Wolfram Sang <wolfram@the-dreams.de>

description: >
    TODO

inherits:
    -   id: %ids%

properties:
    -   name: "compatible"
        constraint: |
            "sirf,prima2-i2c"

    #address-cells:
    cell-index:
    clocks:
    interrupts:
    pinctrl-0:
    pinctrl-names:
    reg:
    #size-cells:
    status:

...

# I2C for SiRFprimaII platforms
#
# Required properties :
# - compatible : Must be "sirf,prima2-i2c"
# - reg: physical base address of the controller and length of memory mapped
#      region.
# - interrupts: interrupt number to the cpu.
#
# Optional properties:
# - clock-frequency : Constains desired I2C/HS-I2C bus clock frequency in Hz.
#   The absence of the propoerty indicates the default frequency 100 kHz.
#
# Examples :
#
# i2c0: i2c@b00e0000 {
#     compatible = "sirf,prima2-i2c";
#     reg = <0xb00e0000 0x10000>;
#     interrupts = <24>;
# };
```

## Documentation/devicetree/bindings/i2c/i2c-st-ddci2c.yaml
```yaml
%YAML 1.2
---
version: 1

id: i2c-st-ddci2c

title: ST Microelectronics DDC I2C

maintainer:
    -   name: Linus Walleij <linus.walleij@linaro.org>

description: >
    TODO

inherits:
    -   id: %ids%

properties:
    -   name: "compatible"
        constraint: |
            "st,ddci2c"

    #address-cells:
    clocks:
    interrupt-parent:
    interrupts:
    reg:
    #size-cells:

...

# ST Microelectronics DDC I2C
#
# Required properties :
# - compatible : Must be "st,ddci2c"
# - reg: physical base address of the controller and length of memory mapped
#      region.
# - interrupts: interrupt number to the cpu.
# - #address-cells = <1>;
# - #size-cells = <0>;
#
# Optional properties:
# - Child nodes conforming to i2c bus binding
#
# Examples :
#
```

## Documentation/devicetree/bindings/i2c/i2c-versatile.yaml
```yaml
%YAML 1.2
---
version: 1

id: i2c-versatile

title: i2c Controller on ARM Versatile platform:

maintainer:
    -   name: Wolfram Sang <wolfram@the-dreams.de>

description: >
    TODO

inherits:
    -   id: %ids%

properties:
    -   name: "compatible"
        constraint: |
            "arm,versatile-i2c"

    #address-cells:
    reg:
    #size-cells:

...

# i2c Controller on ARM Versatile platform:
#
# Required properties:
# - compatible : Must be "arm,versatile-i2c";
# - reg
# - #address-cells = <1>;
# - #size-cells = <0>;
#
# Optional properties:
# - Child nodes conforming to i2c bus binding
```

## Documentation/devicetree/bindings/i2c/i2c-xiic.yaml
```yaml
%YAML 1.2
---
version: 1

id: i2c-xiic

title: Xilinx IIC controller:

maintainer:
    -   name: Wolfram Sang <wolfram@the-dreams.de>

description: >
    TODO

inherits:
    -   id: %ids%

properties:
    -   name: "compatible"
        constraint: |
            "xlnx,xps-iic-2"."00"."a"

    interrupt-parent:
    interrupts:
    reg:
    xlnx,clk-freq:
    xlnx,family:
    xlnx,gpo-width:
    xlnx,iic-freq:
    xlnx,scl-inertial-delay:
    xlnx,sda-inertial-delay:
    xlnx,ten-bit-adr:

...

# Xilinx IIC controller:
#
# Required properties:
# - compatible : Must be "xlnx,xps-iic-2.00.a"
# - reg : IIC register location and length
# - interrupts : IIC controller unterrupt
# - #address-cells = <1>
# - #size-cells = <0>
#
# Optional properties:
# - Child nodes conforming to i2c bus binding
#
# Example:
#
# 	axi_iic_0: i2c@40800000 {
# 		compatible = "xlnx,xps-iic-2.00.a";
# 		interrupts = < 1 2 >;
# 		reg = < 0x40800000 0x10000 >;
#
# 		#size-cells = <0>;
# 		#address-cells = <1>;
# 	};
```

## Documentation/devicetree/bindings/iio/adc/berlin2_adc.yaml
```yaml
%YAML 1.2
---
version: 1

id: berlin2_adc

title: Berlin Analog to Digital Converter (ADC)

maintainer:
    -   name: Antoine Tenart <antoine.tenart@free-electrons.com>

description: >
    TODO

inherits:
    -   id: %ids%

properties:
    -   name: "compatible"
        constraint: |
            "marvell,berlin2-adc"

    interrupt-names:
    interrupts:

...

# * Berlin Analog to Digital Converter (ADC)
#
# The Berlin ADC has 8 channels, with one connected to a temperature sensor.
# It is part of the system controller register set. The ADC node should be a
# sub-node of the system controller node.
#
# Required properties:
# - compatible: must be "marvell,berlin2-adc"
# - interrupts: the interrupts for the ADC and the temperature sensor
# - interrupt-names: should be "adc" and "tsen"
#
# Example:
#
# adc: adc {
# 	compatible = "marvell,berlin2-adc";
# 	interrupt-parent = <&sic>;
# 	interrupts = <12>, <14>;
# 	interrupt-names = "adc", "tsen";
# };
```

## Documentation/devicetree/bindings/iio/adc/nuvoton-nau7802.yaml
```yaml
%YAML 1.2
---
version: 1

id: nuvoton-nau7802

title: Nuvoton NAU7802 Analog to Digital Converter (ADC)

maintainer:
    -   name: Alexandre Belloni <alexandre.belloni@free-electrons.com>

description: >
    TODO

inherits:
    -   id: %ids%

properties:
    -   name: "compatible"
        constraint: |
            "nuvoton,nau7802"

    nuvoton,vldo:
    reg:

...

# * Nuvoton NAU7802 Analog to Digital Converter (ADC)
#
# Required properties:
#   - compatible: Should be "nuvoton,nau7802"
#   - reg: Should contain the ADC I2C address
#
# Optional properties:
#   - nuvoton,vldo: Internal reference voltage in millivolts to be
#     configured valid values are between 2400 mV and 4500 mV.
#   - interrupts: IRQ line for the ADC. If not used the driver will use
#     polling.
#
# Example:
# adc2: nau7802@2a {
# 	compatible = "nuvoton,nau7802";
# 	reg = <0x2a>;
# 	nuvoton,vldo = <3000>;
# };
```

## Documentation/devicetree/bindings/iio/dac/max5821.yaml
```yaml
%YAML 1.2
---
version: 1

id: max5821

title: Maxim max5821 DAC device driver

maintainer:
    -   name: Philippe Reynes <tremyfr@yahoo.fr>

description: >
    TODO

inherits:
    -   id: %ids%

properties:
    -   name: "compatible"
        constraint: |
            "maxim,max5821"

    reg:
    vref-supply:

...

# Maxim max5821 DAC device driver
#
# Required properties:
# 	- compatible: Must be "maxim,max5821"
# 	- reg: Should contain the DAC I2C address
# 	- vref-supply: Phandle to the vref power supply
#
# Example:
#
# 	max5821@38 {
# 		compatible = "maxim,max5821";
# 		reg = <0x38>;
# 		vref-supply = <&reg_max5821>;
# 	};
```

## Documentation/devicetree/bindings/iio/light/cm36651.yaml
```yaml
%YAML 1.2
---
version: 1

id: cm36651

title: Capella CM36651 I2C Proximity and Color Light sensor

maintainer:
    -   name: Beomho Seo <beomho.seo@samsung.com>

description: >
    TODO

inherits:
    -   id: %ids%

properties:
    -   name: "compatible"
        constraint: |
            "capella,cm36651"

    interrupt-parent:
    interrupts:
    reg:
    vled-supply:

...

# * Capella CM36651 I2C Proximity and Color Light sensor
#
# Required properties:
# - compatible: must be "capella,cm36651"
# - reg: the I2C address of the device
# - interrupts: interrupt-specifier for the sole interrupt
# 	      generated by the device
# - vled-supply: regulator for the IR LED. IR_LED is a part
# 	      of the cm36651 for proximity detection.
# 	      As covered in ../../regulator/regulator.txt
#
# Example:
#
# 	i2c_cm36651: i2c-gpio {
# 		/* ... */
#
# 		cm36651@18 {
# 			compatible = "capella,cm36651";
# 			reg = <0x18>;
# 			interrupt-parent = <&gpx0>;
# 			interrupts = <2 0>;
# 			vled-supply = <&ps_als_reg>;
# 		};
#
# 		/* ... */
# 	};
```

## Documentation/devicetree/bindings/iio/light/tsl2563.yaml
```yaml
%YAML 1.2
---
version: 1

id: tsl2563

title: AMS TAOS TSL2563 ambient light sensor

maintainer:
    -   name: Sebastian Reichel <sre@debian.org>

description: >
    TODO

inherits:
    -   id: %ids%

properties:
    -   name: "compatible"
        constraint: |
            "amstaos,tsl2563"

    amstaos,cover-comp-gain:
    reg:

...

# * AMS TAOS TSL2563 ambient light sensor
#
# Required properties:
#
#   - compatible : should be "amstaos,tsl2563"
#   - reg : the I2C address of the sensor
#
# Optional properties:
#
#   - amstaos,cover-comp-gain : integer used as multiplier for gain
#                               compensation (default = 1)
#
# Example:
#
# tsl2563@29 {
# 	compatible = "amstaos,tsl2563";
# 	reg = <0x29>;
# 	amstaos,cover-comp-gain = <16>;
# };
```

## Documentation/devicetree/bindings/input/atmel,maxtouch.yaml
```yaml
%YAML 1.2
---
version: 1

id: atmel,maxtouch

title: Atmel maXTouch touchscreen/touchpad

maintainer:
    -   name: Nick Dyer <nick.dyer@itdev.co.uk>

description: >
    TODO

inherits:
    -   id: %ids%

properties:
    -   name: "compatible"
        constraint: |
            "atmel,maxtouch"

    atmel,burst-length:
    atmel,orientation:
    atmel,threshold:
    atmel,x-line:
    atmel,x-size:
    atmel,y-line:
    atmel,y-size:
    interrupt-parent:
    interrupts:
    linux,gpio-keymap:
    pinctrl-0:
    pinctrl-names:
    reg:
    vdd-supply:
    wakeup-source:

...

# Atmel maXTouch touchscreen/touchpad
#
# Required properties:
# - compatible:
#     atmel,maxtouch
#
# - reg: The I2C address of the device
#
# - interrupts: The sink for the touchpad's IRQ output
#     See ../interrupt-controller/interrupts.txt
#
# Optional properties for main touchpad device:
#
# - linux,gpio-keymap: When enabled, the SPT_GPIOPWN_T19 object sends messages
#     on GPIO bit changes. An array of up to 8 entries can be provided
#     indicating the Linux keycode mapped to each bit of the status byte,
#     starting at the LSB. Linux keycodes are defined in
#     <dt-bindings/input/input.h>.
#
#     Note: the numbering of the GPIOs and the bit they start at varies between
#     maXTouch devices. You must either refer to the documentation, or
#     experiment to determine which bit corresponds to which input. Use
#     KEY_RESERVED for unused padding values.
#
# Example:
#
# 	touch@4b {
# 		compatible = "atmel,maxtouch";
# 		reg = <0x4b>;
# 		interrupt-parent = <&gpio>;
# 		interrupts = <TEGRA_GPIO(W, 3) IRQ_TYPE_LEVEL_LOW>;
# 	};
```
