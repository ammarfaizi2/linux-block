## Documentation/devicetree/bindings/hid/hid-over-i2c.yaml
```yaml
%YAML 1.2
---
version: 1

id: hid-over-i2c

title: HID over I2C Device-Tree bindings

maintainer:
    -   name: Benjamin Tissoires <benjamin.tissoires@redhat.com>

description: >
    TODO

inherits:
    -   id: %ids%

properties:
    -   name: "compatible"
        constraint: |
            "hid-over-i2c"

    hid-descr-addr:
    interrupt-parent:
    interrupts:
    reg:
    vcc-supply:
    wakeup-source:

...

# * HID over I2C Device-Tree bindings
#
# HID over I2C provides support for various Human Interface Devices over the
# I2C bus. These devices can be for example touchpads, keyboards, touch screens
# or sensors.
#
# The specification has been written by Microsoft and is currently available here:
# http://msdn.microsoft.com/en-us/library/windows/hardware/hh852380.aspx
#
# If this binding is used, the kernel module i2c-hid will handle the communication
# with the device and the generic hid core layer will handle the protocol.
#
# Required properties:
# - compatible: must be "hid-over-i2c"
# - reg: i2c slave address
# - hid-descr-addr: HID descriptor address
# - interrupt-parent: the phandle for the interrupt controller
# - interrupts: interrupt line
#
# Example:
#
# 	i2c-hid-dev@2c {
# 		compatible = "hid-over-i2c";
# 		reg = <0x2c>;
# 		hid-descr-addr = <0x0020>;
# 		interrupt-parent = <&gpx3>;
# 		interrupts = <3 2>;
# 	};
```

## Documentation/devicetree/bindings/hwlock/sirf,hwspinlock.yaml
```yaml
%YAML 1.2
---
version: 1

id: sirf,hwspinlock

title: SIRF Hardware spinlock device Binding

maintainer:
    -   name: Wei Chen <wei.chen@csr.com>

description: >
    TODO

inherits:
    -   id: %ids%

properties:
    -   name: "compatible"
        constraint: |
            "sirf,hwspinlock"

    num-spinlocks:
    reg:

...

# SIRF Hardware spinlock device Binding
# -----------------------------------------------
#
# Required properties :
# - compatible : shall contain only one of the following:
# 	"sirf,hwspinlock"
#
# - reg : the register address of hwspinlock
#
# - #hwlock-cells : hwlock users only use the hwlock id to represent a specific
# 	hwlock, so the number of cells should be <1> here.
#
# Please look at the generic hwlock binding for usage information for consumers,
# "Documentation/devicetree/bindings/hwlock/hwlock.txt"
#
# Example of hwlock provider:
# 	hwlock {
# 		compatible = "sirf,hwspinlock";
# 		reg = <0x13240000 0x00010000>;
# 		#hwlock-cells = <1>;
# 	};
#
# Example of hwlock users:
# 	node {
# 		...
# 		hwlocks = <&hwlock 2>;
# 		...
# 	};
```

## Documentation/devicetree/bindings/hwmon/ina2xx.yaml
```yaml
%YAML 1.2
---
version: 1

id: ina2xx

title: ina2xx properties

maintainer:
    -   name: Wolfram Sang <wsa@the-dreams.de>

description: >
    TODO

inherits:
    -   id: %ids%

properties:
    -   name: "compatible"
        constraint: |
            "ti,ina220"

    reg:
    shunt-resistor:

...

# ina2xx properties
#
# Required properties:
# - compatible: Must be one of the following:
# 	- "ti,ina219" for ina219
# 	- "ti,ina220" for ina220
# 	- "ti,ina226" for ina226
# 	- "ti,ina230" for ina230
# - reg: I2C address
#
# Optional properties:
#
# - shunt-resistor
# 	Shunt resistor value in micro-Ohm
#
# Example:
#
# ina220@44 {
# 	compatible = "ti,ina220";
# 	reg = <0x44>;
# 	shunt-resistor = <1000>;
# };
```

## Documentation/devicetree/bindings/hwmon/pwm-fan.yaml
```yaml
%YAML 1.2
---
version: 1

id: pwm-fan

title: Bindings for a fan connected to the PWM lines

maintainer:
    -   name: Kamil Debski <k.debski@samsung.com>

description: >
    TODO

inherits:
    -   id: %ids%

properties:
    -   name: "compatible"
        constraint: |
            "pwm-fan"

    #cooling-cells:
    cooling-levels:
    cooling-max-state:
    cooling-min-state:
    pwms:

...

# Bindings for a fan connected to the PWM lines
#
# Required properties:
# - compatible	: "pwm-fan"
# - pwms		: the PWM that is used to control the PWM fan
#
# Example:
# 	pwm-fan {
# 		compatible = "pwm-fan";
# 		status = "okay";
# 		pwms = <&pwm 0 10000 0>;
# 	};
```

## Documentation/devicetree/bindings/hwmon/vexpress.yaml
```yaml
%YAML 1.2
---
version: 1

id: vexpress

title: Versatile Express hwmon sensors

maintainer:
    -   name: Pawel Moll <pawel.moll@arm.com>

description: >
    TODO

inherits:
    -   id: %ids%

properties:
    -   name: "compatible"
        constraint: |
            "arm,vexpress-temp"
            "arm,vexpress-power"
            "arm,vexpress-energy"
            "arm,vexpress-amp"

    arm,vexpress-sysreg,func:
    label:

...

# Versatile Express hwmon sensors
# -------------------------------
#
# Requires node properties:
# - "compatible" value : one of
# 	"arm,vexpress-volt"
# 	"arm,vexpress-amp"
# 	"arm,vexpress-temp"
# 	"arm,vexpress-power"
# 	"arm,vexpress-energy"
# - "arm,vexpress-sysreg,func" when controlled via vexpress-sysreg
#   (see Documentation/devicetree/bindings/arm/vexpress-sysreg.txt
#   for more details)
#
# Optional node properties:
# - label : string describing the monitored value
#
# Example:
# 	energy@0 {
# 		compatible = "arm,vexpress-energy";
# 		arm,vexpress-sysreg,func = <13 0>;
# 		label = "A15 Jcore";
# 	};
```

## Documentation/devicetree/bindings/hwrng/atmel-trng.yaml
```yaml
%YAML 1.2
---
version: 1

id: atmel-trng

title: Atmel TRNG (True Random Number Generator) block

maintainer:
    -   name: Boris Brezillon <boris.brezillon@free-electrons.com>

description: >
    TODO

inherits:
    -   id: %ids%

properties:
    -   name: "compatible"
        constraint: |
            "atmel,at91sam9g45-trng"

    clocks:
    interrupts:
    reg:

...

# Atmel TRNG (True Random Number Generator) block
#
# Required properties:
# - compatible : Should be "atmel,at91sam9g45-trng"
# - reg : Offset and length of the register set of this block
# - interrupts : the interrupt number for the TRNG block
# - clocks: should contain the TRNG clk source
#
# Example:
#
# trng@fffcc000 {
# 	compatible = "atmel,at91sam9g45-trng";
# 	reg = <0xfffcc000 0x4000>;
# 	interrupts = <6 IRQ_TYPE_LEVEL_HIGH 0>;
# 	clocks = <&trng_clk>;
# };
```

## Documentation/devicetree/bindings/i2c/brcm,kona-i2c.yaml
```yaml
%YAML 1.2
---
version: 1

id: brcm,kona-i2c

title: Broadcom Kona Family I2C

maintainer:
    -   name: Scott Branden <sbranden@broadcom.com>

description: >
    TODO

inherits:
    -   id: %ids%

properties:
    -   name: "compatible"
        constraint: |
            "brcm,bcm21664-i2c" && "brcm,kona-i2c"
            "brcm,bcm11351-i2c" && "brcm,kona-i2c"

    #address-cells:
    clock-frequency:
    clocks:
    interrupts:
    reg:
    #size-cells:
    status:

...

# Broadcom Kona Family I2C
# =========================
#
# This I2C controller is used in the following Broadcom SoCs:
#
#   BCM11130
#   BCM11140
#   BCM11351
#   BCM28145
#   BCM28155
#
# Required Properties
# -------------------
# - compatible: "brcm,bcm11351-i2c", "brcm,kona-i2c"
# - reg: Physical base address and length of controller registers
# - interrupts: The interrupt number used by the controller
# - clocks: clock specifier for the kona i2c external clock
# - clock-frequency: The I2C bus frequency in Hz
# - #address-cells: Should be <1>
# - #size-cells: Should be <0>
#
# Refer to clocks/clock-bindings.txt for generic clock consumer
# properties.
#
# Example:
#
# i2c@3e016000 {
# 	compatible = "brcm,bcm11351-i2c","brcm,kona-i2c";
# 	reg = <0x3e016000 0x80>;
# 	interrupts = <GIC_SPI 103 IRQ_TYPE_LEVEL_HIGH>;
# 	clocks = <&bsc1_clk>;
# 	clock-frequency = <400000>;
# 	#address-cells = <1>;
# 	#size-cells = <0>;
# };
```

## Documentation/devicetree/bindings/i2c/i2c-cbus-gpio.yaml
```yaml
%YAML 1.2
---
version: 1

id: i2c-cbus-gpio

title: Device tree bindings for i2c-cbus-gpio driver

maintainer:
    -   name: Aaro Koskinen <aaro.koskinen@iki.fi>

description: >
    TODO

inherits:
    -   id: %ids%

properties:
    -   name: "compatible"
        constraint: |
            "retu-mfd"
            "i2c-cbus-gpio"

    #address-cells:
    gpios:
    #size-cells:

...

# Device tree bindings for i2c-cbus-gpio driver
#
# Required properties:
# 	- compatible = "i2c-cbus-gpio";
# 	- gpios: clk, dat, sel
# 	- #address-cells = <1>;
# 	- #size-cells = <0>;
#
# Optional properties:
# 	- child nodes conforming to i2c bus binding
#
# Example:
#
# i2c@0 {
# 	compatible = "i2c-cbus-gpio";
# 	gpios = <&gpio 66 0 /* clk */
# 		 &gpio 65 0 /* dat */
# 		 &gpio 64 0 /* sel */
# 		>;
# 	#address-cells = <1>;
# 	#size-cells = <0>;
#
# 	retu-mfd: retu@1 {
# 		compatible = "retu-mfd";
# 		reg = <0x1>;
# 	};
# };
```

## Documentation/devicetree/bindings/i2c/i2c-davinci.yaml
```yaml
%YAML 1.2
---
version: 1

id: i2c-davinci

title: Texas Instruments Davinci I2C

maintainer:
    -   name: Grygorii Strashko <grygorii.strashko@ti.com>

description: >
    TODO

inherits:
    -   id: %ids%

properties:
    -   name: "compatible"
        constraint: |
            "ti,davinci-i2c"

    #address-cells:
    clock-frequency:
    clocks:
    interrupts:
    pinctrl-0:
    pinctrl-names:
    reg:
    #size-cells:
    status:

...

# * Texas Instruments Davinci I2C
#
# This file provides information, what the device node for the
# davinci i2c interface contain.
#
# Required properties:
# - compatible: "ti,davinci-i2c";
# - reg : Offset and length of the register set for the device
#
# Recommended properties :
# - interrupts : standard interrupt property.
# - clock-frequency : desired I2C bus clock frequency in Hz.
# - ti,has-pfunc: boolean; if defined, it indicates that SoC supports PFUNC
# 	registers. PFUNC registers allow to switch I2C pins to function as
# 	GPIOs, so they can by toggled manually.
#
# Example (enbw_cmc board):
# 	i2c@1c22000 {
# 		compatible = "ti,davinci-i2c";
# 		reg = <0x22000 0x1000>;
# 		clock-frequency = <100000>;
# 		interrupts = <15>;
# 		interrupt-parent = <&intc>;
# 		#address-cells = <1>;
# 		#size-cells = <0>;
#
# 		dtt@48 {
# 			compatible = "national,lm75";
# 			reg = <0x48>;
# 		};
# 	};
```

## Documentation/devicetree/bindings/i2c/i2c-digicolor.yaml
```yaml
%YAML 1.2
---
version: 1

id: i2c-digicolor

title: Conexant Digicolor I2C controller

maintainer:
    -   name: Baruch Siach <baruch@tkos.co.il>

description: >
    TODO

inherits:
    -   id: %ids%

properties:
    -   name: "compatible"
        constraint: |
            "cnxt,cx92755-i2c"

    #address-cells:
    clock-frequency:
    clocks:
    interrupts:
    reg:
    #size-cells:
    status:

...

# Conexant Digicolor I2C controller
#
# Required properties:
#  - compatible: must be "cnxt,cx92755-i2c"
#  - reg: physical address and length of the device registers
#  - interrupts: a single interrupt specifier
#  - clocks: clock for the device
#  - #address-cells: should be <1>
#  - #size-cells: should be <0>
#
# Optional properties:
# - clock-frequency: the desired I2C bus clock frequency in Hz; in
#   absence of this property the default value is used (100 kHz).
#
# Example:
#
# 	i2c: i2c@f0000120 {
# 		compatible = "cnxt,cx92755-i2c";
# 		reg = <0xf0000120 0x10>;
# 		interrupts = <28>;
# 		clocks = <&main_clk>;
# 		clock-frequency = <100000>;
# 		#address-cells = <1>;
# 		#size-cells = <0>;
# 	};
```

## Documentation/devicetree/bindings/i2c/i2c-hix5hd2.yaml
```yaml
%YAML 1.2
---
version: 1

id: i2c-hix5hd2

title: I2C for Hisilicon hix5hd2 chipset platform

maintainer:
    -   name: Wei Yan <sledge.yanwei@huawei.com>

description: >
    TODO

inherits:
    -   id: %ids%

properties:
    -   name: "compatible"
        constraint: |
            "hisilicon,hix5hd2-i2c"

    #address-cells:
    clocks:
    interrupts:
    reg:
    #size-cells:
    status:

...

# I2C for Hisilicon hix5hd2 chipset platform
#
# Required properties:
# - compatible: Must be "hisilicon,hix5hd2-i2c"
# - reg: physical base address of the controller and length of memory mapped
#      region.
# - interrupts: interrupt number to the cpu.
# - #address-cells = <1>;
# - #size-cells = <0>;
# - clocks: phandles to input clocks.
#
# Optional properties:
# - clock-frequency: Desired I2C bus frequency in Hz, otherwise defaults to 100000
# - Child nodes conforming to i2c bus binding
#
# Examples:
# I2C0@f8b10000 {
# 	compatible = "hisilicon,hix5hd2-i2c";
# 	reg = <0xf8b10000 0x1000>;
# 	interrupts = <0 38 4>;
# 	clocks = <&clock HIX5HD2_I2C0_RST>;
# 	#address-cells = <1>;
# 	#size-cells = <0>;
# }
```

## Documentation/devicetree/bindings/i2c/i2c-mxs.yaml
```yaml
%YAML 1.2
---
version: 1

id: i2c-mxs

title: Freescale MXS Inter IC (I2C) Controller

maintainer:
    -   name: Marek Vasut <marex@denx.de>

description: >
    TODO

inherits:
    -   id: %ids%

properties:
    -   name: "compatible"
        constraint: |
            "fsl,vf610-i2c"
            "fsl,mpc885-i2c" && "fsl,cpm1-i2c"
            "fsl,mpc866-i2c" && "fsl,cpm1-i2c"
            "fsl,mpc8544-i2c" && "fsl-i2c"
            "fsl,mpc8313-i2c" && "fsl-i2c"
            "fsl,mpc8272-i2c" && "fsl,cpm2-i2c"
            "fsl,mpc5200b-i2c" && "fsl,mpc5200-i2c" && "fsl-i2c"
            "fsl,mpc5121-i2c" && "fsl-i2c"
            "fsl,imx7d-i2c" && "fsl,imx21-i2c"
            "fsl,imx6ul-i2c" && "fsl,imx21-i2c"
            "fsl,imx6sx-i2c" && "fsl,imx21-i2c"
            "fsl,imx6sl-i2c" && "fsl,imx21-i2c"
            "fsl,imx6q-i2c" && "fsl,imx21-i2c"
            "fsl,imx53-i2c" && "fsl,imx21-i2c"
            "fsl,imx51-i2c" && "fsl,imx21-i2c"
            "fsl,imx50-i2c" && "fsl,imx21-i2c"
            "fsl,imx35-i2c" && "fsl,imx1-i2c"
            "fsl,imx28-i2c"
            "fsl,imx27-i2c" && "fsl,imx21-i2c"
            "fsl,imx25-i2c" && "fsl,imx21-i2c"
            "fsl,imx23-i2c"
            "fsl,imx1-i2c"

    #address-cells:
    clocks:
    interrupts:
    pinctrl-0:
    pinctrl-names:
    reg:
    #size-cells:
    status:

...

# * Freescale MXS Inter IC (I2C) Controller
#
# Required properties:
# - compatible: Should be "fsl,<chip>-i2c"
# - reg: Should contain registers location and length
# - interrupts: Should contain ERROR interrupt number
# - clock-frequency: Desired I2C bus clock frequency in Hz.
#                    Only 100000Hz and 400000Hz modes are supported.
# - dmas: DMA specifier, consisting of a phandle to DMA controller node
#   and I2C DMA channel ID.
#   Refer to dma.txt and fsl-mxs-dma.txt for details.
# - dma-names: Must be "rx-tx".
#
# Examples:
#
# i2c0: i2c@80058000 {
# 	#address-cells = <1>;
# 	#size-cells = <0>;
# 	compatible = "fsl,imx28-i2c";
# 	reg = <0x80058000 2000>;
# 	interrupts = <111>;
# 	clock-frequency = <100000>;
# 	dmas = <&dma_apbx 6>;
# 	dma-names = "rx-tx";
# };
```

## Documentation/devicetree/bindings/i2c/i2c-nomadik.yaml
```yaml
%YAML 1.2
---
version: 1

id: i2c-nomadik

title: I2C for Nomadik based systems

maintainer:
    -   name: Wolfram Sang <wolfram@the-dreams.de>

description: >
    TODO

inherits:
    -   id: %ids%

properties:
    -   name: "compatible"
        constraint: |
            "st,nomadik-i2c" && "arm,primecell"
            "stericsson,db8500-i2c" && "st,nomadik-i2c" && "arm,primecell"

    #address-cells:
    clock-frequency:
    clock-names:
    clocks:
    interrupts:
    pinctrl-0:
    pinctrl-1:
    pinctrl-names:
    power-domains:
    reg:
    #size-cells:
    status:
    v-i2c-supply:

...

# I2C for Nomadik based systems
#
# Required (non-standard) properties:
#  - Nil
#
# Recommended (non-standard) properties:
#  - clock-frequency : Maximum bus clock frequency for the device
#
# Optional (non-standard) properties:
#  - Nil
#
# Example :
#
# i2c@80004000 {
#         compatible = "stericsson,db8500-i2c", "st,nomadik-i2c";
#         reg = <0x80004000 0x1000>;
#         interrupts = <0 21 0x4>;
#         #address-cells = <1>;
#         #size-cells = <0>;
#         v-i2c-supply = <&db8500_vape_reg>;
#
#         clock-frequency = <400000>;
# };
```
