## Documentation/devicetree/bindings/arm/armada-380-mpcore-soc-ctrl.yaml
```yaml
%YAML 1.2
---
version: 1

id: armada-380-mpcore-soc-ctrl

title: Marvell Armada 38x CA9 MPcore SoC Controller

maintainer:
    -   name: Gregory CLEMENT <gregory.clement@free-electrons.com>

description: >
    TODO

inherits:
    -   id: %ids%

properties:
    -   name: "compatible"
        constraint: |
            "marvell,armada-380-mpcore-soc-ctrl"

    reg:

...

# Marvell Armada 38x CA9 MPcore SoC Controller
# ============================================
#
# Required properties:
#
# - compatible: Should be "marvell,armada-380-mpcore-soc-ctrl".
#
# - reg: should be the register base and length as documented in the
#   datasheet for the CA9 MPcore SoC Control registers
#
# mpcore-soc-ctrl@20d20 {
# 	compatible = "marvell,armada-380-mpcore-soc-ctrl";
# 	reg = <0x20d20 0x6c>;
# };
```

## Documentation/devicetree/bindings/arm/armada-38x.yaml
```yaml
%YAML 1.2
---
version: 1

id: armada-38x

title: Marvell Armada 38x Platforms Device Tree Bindings

maintainer:
    -   name: Gregory CLEMENT <gregory.clement@free-electrons.com>

description: >
    TODO

inherits:
    -   id: %ids%

properties:
    -   name: "compatible"
        constraint: |
            "marvell,armada388" && "marvell,armada385" && "marvell,armada380"
            "marvell,armada385" && "marvell,armada380"
            "marvell,armada380"
            "marvell,a385-rd" && "marvell,armada388" && "marvell,armada385" && "marvell,armada380"
            "marvell,a385-gp" && "marvell,armada388" && "marvell,armada380"
            "marvell,a385-db" && "marvell,armada388" && "marvell,armada385" && "marvell,armada380"
            "marvell,a385-db-ap" && "marvell,armada385" && "marvell,armada38x"
            "linksys,cobra" && "linksys,armada385" && "marvell,armada385" && "marvell,armada380"
            "linksys,caiman" && "linksys,armada385" && "marvell,armada385" && "marvell,armada380"
            "linksys,armada385" && "marvell,armada385" && "marvell,armada380"


...

# Marvell Armada 38x Platforms Device Tree Bindings
# -------------------------------------------------
#
# Boards with a SoC of the Marvell Armada 38x family shall have the
# following property:
#
# Required root node property:
#
#  - compatible: must contain "marvell,armada380"
#
# In addition, boards using the Marvell Armada 385 SoC shall have the
# following property before the previous one:
#
# Required root node property:
#
# compatible: must contain "marvell,armada385"
#
# In addition, boards using the Marvell Armada 388 SoC shall have the
# following property before the previous one:
#
# Required root node property:
#
# compatible: must contain "marvell,armada388"
#
# Example:
#
# compatible = "marvell,a385-rd", "marvell,armada385", "marvell,armada380";
```

## Documentation/devicetree/bindings/arm/armada-39x.yaml
```yaml
%YAML 1.2
---
version: 1

id: armada-39x

title: Marvell Armada 39x Platforms Device Tree Bindings

maintainer:
    -   name: Thomas Petazzoni <thomas.petazzoni@free-electrons.com>

description: >
    TODO

inherits:
    -   id: %ids%

properties:
    -   name: "compatible"
        constraint: |
            "marvell,armada398" && "marvell,armada390"
            "marvell,armada390"
            "marvell,a398-db" && "marvell,armada398" && "marvell,armada390"

    #address-cells:
    model:
    #size-cells:

...

# Marvell Armada 39x Platforms Device Tree Bindings
# -------------------------------------------------
#
# Boards with a SoC of the Marvell Armada 39x family shall have the
# following property:
#
# Required root node property:
#
#  - compatible: must contain "marvell,armada390"
#
# In addition, boards using the Marvell Armada 398 SoC shall have the
# following property before the previous one:
#
# Required root node property:
#
# compatible: must contain "marvell,armada398"
#
# Example:
#
# compatible = "marvell,a398-db", "marvell,armada398", "marvell,armada390";
```

## Documentation/devicetree/bindings/arm/armada-cpu-reset.yaml
```yaml
%YAML 1.2
---
version: 1

id: armada-cpu-reset

title: Marvell Armada CPU reset controller

maintainer:
    -   name: Thomas Petazzoni <thomas.petazzoni@free-electrons.com>

description: >
    TODO

inherits:
    -   id: %ids%

properties:
    -   name: "compatible"
        constraint: |
            "marvell,armada-370-cpu-reset"

    reg:

...

# Marvell Armada CPU reset controller
# ===================================
#
# Required properties:
#
# - compatible: Should be "marvell,armada-370-cpu-reset".
#
# - reg: should be register base and length as documented in the
#   datasheet for the CPU reset registers
#
# cpurst: cpurst@20800 {
#        compatible = "marvell,armada-370-cpu-reset";
#        reg = <0x20800 0x20>;
# };
```

## Documentation/devicetree/bindings/arm/armadeus.yaml
```yaml
%YAML 1.2
---
version: 1

id: armadeus

title: Armadeus i.MX Platforms Device Tree Bindings

maintainer:
    -   name: Laurent Cans <laurent.cans@gmail.com>

description: >
    TODO

inherits:
    -   id: %ids%

properties:
    -   name: "compatible"
        constraint: |
            "armadeus,imx51-apf51" && "fsl,imx51"
            "armadeus,imx51-apf51dev" && "armadeus,imx51-apf51" && "fsl,imx51"

    #address-cells:
    model:
    #size-cells:

...

# Armadeus i.MX Platforms Device Tree Bindings
# -----------------------------------------------
#
# APF51: i.MX51 based module.
# Required root node properties:
#     - compatible = "armadeus,imx51-apf51", "fsl,imx51";
```

## Documentation/devicetree/bindings/arm/armv7m_systick.yaml
```yaml
%YAML 1.2
---
version: 1

id: armv7m_systick

title: ARMv7M System Timer

maintainer:
    -   name: Maxime Coquelin <mcoquelin.stm32@gmail.com>

description: >
    TODO

inherits:
    -   id: %ids%

properties:
    -   name: "compatible"
        constraint: |
            "arm,armv7m-systick"

    clocks:
    reg:
    status:

...

# * ARMv7M System Timer
#
# ARMv7-M includes a system timer, known as SysTick. Current driver only
# implements the clocksource feature.
#
# Required properties:
# - compatible	  : Should be "arm,armv7m-systick"
# - reg		  : The address range of the timer
#
# Required clocking property, have to be one of:
# - clocks	  : The input clock of the timer
# - clock-frequency : The rate in HZ in input of the ARM SysTick
#
# Examples:
#
# systick: timer@e000e010 {
# 	compatible = "arm,armv7m-systick";
# 	reg = <0xe000e010 0x10>;
# 	clocks = <&clk_systick>;
# };
#
# systick: timer@e000e010 {
# 	compatible = "arm,armv7m-systick";
# 	reg = <0xe000e010 0x10>;
# 	clock-frequency = <90000000>;
# };
```
