## Documentation/devicetree/bindings/arc/archs-intc.yaml
```yaml
%YAML 1.2
---
version: 1

id: archs-intc

title: ARC-HS incore Interrupt Controller (Provided by cores implementing ARCv2 ISA)

maintainer:
    -   name: Vineet Gupta <vgupta@synopsys.com>

description: >
    TODO

inherits:
    -   id: %ids%

properties:
    -   name: "compatible"
        constraint: |
            "snps,archs-intc"

    #interrupt-cells:
    interrupt-controller:

...

# * ARC-HS incore Interrupt Controller (Provided by cores implementing ARCv2 ISA)
#
# Properties:
#
# - compatible: "snps,archs-intc"
# - interrupt-controller: This is an interrupt controller.
# - #interrupt-cells: Must be <1>.
#
#   Single Cell "interrupts" property of a device specifies the IRQ number
#   between 16 to 256
#
#   intc accessed via the special ARC AUX register interface, hence "reg" property
#   is not specified.
#
# Example:
#
# 	intc: interrupt-controller {
# 		compatible = "snps,archs-intc";
# 		interrupt-controller;
# 		#interrupt-cells = <1>;
# 		interrupts = <16 17 18 19 20 21 22 23 24 25>;
# 	};
```

## Documentation/devicetree/bindings/arc/archs-pct.yaml
```yaml
%YAML 1.2
---
version: 1

id: archs-pct

title: ARC HS Performance Counters

maintainer:
    -   name: Vineet Gupta <vgupta@synopsys.com>

description: >
    TODO

inherits:
    -   id: %ids%

properties:
    -   name: "compatible"
        constraint: |
            "snps,archs-pct"

    #interrupt-cells:
    interrupt-parent:
    interrupts:

...

# * ARC HS Performance Counters
#
# The ARC HS can be configured with a pipeline performance monitor for counting
# CPU and cache events like cache misses and hits. Like conventional PCT there
# are 100+ hardware conditions dynamically mapped to upto 32 counters.
# It also supports overflow interrupts.
#
# Required properties:
#
# - compatible : should contain
# 	"snps,archs-pct"
#
# Example:
#
# pmu {
#         compatible = "snps,archs-pct";
# };
```

## Documentation/devicetree/bindings/arc/axs101.yaml
```yaml
%YAML 1.2
---
version: 1

id: axs101

title: Synopsys DesignWare ARC Software Development Platforms Device Tree Bindings

maintainer:
    -   name: Alexey Brodkin <abrodkin@synopsys.com>

description: >
    TODO

inherits:
    -   id: %ids%

properties:
    -   name: "compatible"
        constraint: |
            "snps,axs101" && "snps,arc-sdp"

    #address-cells:
    clock-frequency:
    #size-cells:

...

# Synopsys DesignWare ARC Software Development Platforms Device Tree Bindings
# ---------------------------------------------------------------------------
#
# SDP Main Board with an AXC001 CPU Card hoisting ARC700 core in silicon
#
# Required root node properties:
#     - compatible = "snps,axs101", "snps,arc-sdp";
```

## Documentation/devicetree/bindings/arc/axs103.yaml
```yaml
%YAML 1.2
---
version: 1

id: axs103

title: Synopsys DesignWare ARC Software Development Platforms Device Tree Bindings

maintainer:
    -   name: Vineet Gupta <vgupta@synopsys.com>

description: >
    TODO

inherits:
    -   id: %ids%

properties:
    -   name: "compatible"
        constraint: |
            "snps,axs103" && "snps,arc-sdp"
            "snps,axs103"

    #address-cells:
    clock-frequency:
    #size-cells:

...

# Synopsys DesignWare ARC Software Development Platforms Device Tree Bindings
# ---------------------------------------------------------------------------
#
# SDP Main Board with an AXC003 FPGA Card which can contain various flavours of
# HS38x cores.
#
# Required root node properties:
#     - compatible = "snps,axs103", "snps,arc-sdp";
```

## Documentation/devicetree/bindings/arc/pct.yaml
```yaml
%YAML 1.2
---
version: 1

id: pct

title: ARC Performance Counters

maintainer:
    -   name: Vineet Gupta <vgupta@synopsys.com>

description: >
    TODO

inherits:
    -   id: %ids%

properties:
    -   name: "compatible"
        constraint: |
            "snps,arc700-pct"

    "snps,arc700-pct"::

...

# * ARC Performance Counters
#
# The ARC700 can be configured with a pipeline performance monitor for counting
# CPU and cache events like cache misses and hits. Like conventional PCT there
# are 100+ hardware conditions dynamically mapped to upto 32 counters
#
# Note that:
#  * The ARC 700 PCT does not support interrupts; although HW events may be
#    counted, the HW events themselves cannot serve as a trigger for a sample.
#
# Required properties:
#
# - compatible : should contain
# 	"snps,arc700-pct"
#
# Example:
#
# pmu {
#         compatible = "snps,arc700-pct";
# };
```

## Documentation/devicetree/bindings/arm/actions.yaml
```yaml
%YAML 1.2
---
$id: http://devicetree.org/schemas/soc/arm/actions.yaml#
$schema: http://devicetree.org/meta-schemas/core.yaml#

title: Actions Semi platforms device tree bindings

maintainers:
  - Andreas Färber <afaerber@suse.de>

description: |
  The Actions Semi S500 is a quad-core ARM Cortex-A9 SoC. The Actions Semi
  S900 is a quad-core ARM Cortex-A53 SoC.

properties:
  compatible:
    oneOf:
      - items:
          - enum:
              - lemaker,guitar-bb-rev-b
          - enum:
              - lemaker,guitar
              - allo,sparky
              - cubietech,cubieboard6
          - const: actions,s500
        minItems: 2
        maxItems: 3
        additionalItems: false
      - items:
          - const: cubietech,cubieboard7
          - const: actions,s700
      - items:
          - const: ucrobotics,bubblegum-96
          - const: actions,s900
```

## Documentation/devicetree/bindings/arm/adapteva.yaml
```yaml
%YAML 1.2
---
version: 1

id: adapteva

title: Adapteva Platforms Device Tree Bindings

maintainer:
    -   name: Andreas Färber <afaerber@suse.de>

description: >
    TODO

inherits:
    -   id: %ids%

properties:
    -   name: "compatible"
        constraint: |
            "adapteva,parallella" && "xlnx,zynq-7000"

    #address-cells:
    model:
    #size-cells:

...

# Adapteva Platforms Device Tree Bindings
# ---------------------------------------
#
# Parallella board
#
# Required root node properties:
#     - compatible = "adapteva,parallella";
```

## Documentation/devicetree/bindings/arm/al,alpine.yaml
```yaml
# SPDX-License-Identifier: GPL-2.0
%YAML 1.2
---
$id: http://devicetree.org/schemas/arm/al,alpine.yaml#
$schema: http://devicetree.org/meta-schemas/core.yaml#

title: Annapurna Labs Alpine Platform Device Tree Bindings

maintainers:
  - Tsahee Zidenberg <tsahee@annapurnalabs.com>
description: test

properties:
  compatible:
    items:
      - const: al,alpine
  model:
    items:
      - const: "Annapurna Labs Alpine Dev Board"

...
```

## Documentation/devicetree/bindings/arm/altera.yaml
```yaml
# SPDX-License-Identifier: None
%YAML 1.2
---
$id: http://devicetree.org/schemas/bindings/arm/altera.yaml#
$schema: http://devicetree.org/meta-schemas/core.yaml#

title: Altera's SoCFPGA platform device tree bindings

maintainers:
  - Dinh Nguyen <dinguyen@opensource.altera.com>

properties:
  compatible:
    items:
      - enum:
        - altr,socfpga-cyclone5
        - altr,socfpga-arria5
        - altr,socfpga-arria10
      - const: altr,socfpga
...
```

## Documentation/devicetree/bindings/arm/altera/socfpga-clk-manager.yaml
```yaml
# SPDX-License-Identifier: None
%YAML 1.2
---
$id: http://devicetree.org/schemas/bindings/arm/altera/socfpga-clk-manager.yaml#
$schema: http://devicetree.org/meta-schemas/core.yaml#

title: Altera SOCFPGA Clock Manager

maintainers:
  - Dinh Nguyen <dinguyen@altera.com>
description: test

properties:
  compatible:
    items:
      - const: altr,clk-mgr
  reg:
    maxItems: 1

required:
  - compatible

examples:
  - |
    clkmgr@ffd04000 {
      compatible = "altr,clk-mgr";
      reg = <0xffd04000 0x1000>;
    };

...
```

## Documentation/devicetree/bindings/arm/altera/socfpga-sdram-edac.yaml
```yaml
%YAML 1.2
---
version: 1

id: socfpga-sdram-edac

title: Altera SOCFPGA SDRAM Error Detection  %title% Correction [EDAC]

maintainer:
    -   name: Thor Thayer <tthayer@opensource.altera.com>

description: >
    TODO

inherits:
    -   id: %ids%

properties:
    -   name: "compatible"
        constraint: |
            "altr,sdram-edac-a10"
            "altr,sdram-edac"

    altr,sdr-syscon:
    interrupts:

...

# Altera SOCFPGA SDRAM Error Detection & Correction [EDAC]
# The EDAC accesses a range of registers in the SDRAM controller.
#
# Required properties:
# - compatible : should contain "altr,sdram-edac" or "altr,sdram-edac-a10"
# - altr,sdr-syscon : phandle of the sdr module
# - interrupts : Should contain the SDRAM ECC IRQ in the
# 	appropriate format for the IRQ controller.
#
# Example:
# 	sdramedac {
# 		compatible = "altr,sdram-edac";
# 		altr,sdr-syscon = <&sdr>;
# 		interrupts = <0 39 4>;
# 	};
```

## Documentation/devicetree/bindings/arm/altera/socfpga-system.yaml
```yaml
%YAML 1.2
---
version: 1

id: socfpga-system

title: Altera SOCFPGA System Manager

maintainer:
    -   name: Dinh Nguyen <dinguyen@altera.com>

description: >
    TODO

inherits:
    -   id: %ids%

properties:
    -   name: "compatible"
        constraint: |
            "altr,sys-mgr" && "syscon"

    cpu1-start-addr:
    reg:

...

# Altera SOCFPGA System Manager
#
# Required properties:
# - compatible : "altr,sys-mgr"
# - reg : Should contain 1 register ranges(address and length)
# - cpu1-start-addr : CPU1 start address in hex.
#
# Example:
# 	 sysmgr@ffd08000 {
# 		compatible = "altr,sys-mgr";
# 		reg = <0xffd08000 0x1000>;
# 		cpu1-start-addr = <0xffd080c4>;
# 	};
```

## Documentation/devicetree/bindings/arm/amlogic.yaml
```yaml
%YAML 1.2
---
version: 1

id: amlogic

title: Amlogic MesonX device tree bindings

maintainer:
    -   name: Beniamino Galvani <b.galvani@gmail.com>

description: >
    TODO

inherits:
    -   id: %ids%

properties:
    -   name: "compatible"
        constraint: |
            "minix,neo-x8" && "amlogic,meson8"
            "geniatech,atv1200" && "amlogic,meson6"
            "amlogic,meson8"
            "amlogic,meson6"


...

# Amlogic MesonX device tree bindings
# -------------------------------------------
#
# Boards with the Amlogic Meson6 SoC shall have the following properties:
#   Required root node property:
#     compatible: "amlogic,meson6"
#
# Boards with the Amlogic Meson8 SoC shall have the following properties:
#   Required root node property:
#     compatible: "amlogic,meson8";
#
# Board compatible values:
#   - "geniatech,atv1200"
#   - "minix,neo-x8"
```

## Documentation/devicetree/bindings/arm/armada-370-xp-pmsu.yaml
```yaml
%YAML 1.2
---
version: 1

id: armada-370-xp-pmsu

title: Power Management Service Unit(PMSU)

maintainer:
    -   name: Gregory CLEMENT <gregory.clement@free-electrons.com>

description: >
    TODO

inherits:
    -   id: %ids%

properties:
    -   name: "compatible"
        constraint: |
            "marvell,armada-390-pmsu" && "marvell,armada-380-pmsu"
            "marvell,armada-380-pmsu"
            "marvell,armada-370-pmsu"

    reg:

...

# Power Management Service Unit(PMSU)
# -----------------------------------
# Available on Marvell SOCs: Armada 370, Armada 38x and Armada XP
#
# Required properties:
#
# - compatible: should be one of:
#   - "marvell,armada-370-pmsu" for Armada 370 or Armada XP
#   - "marvell,armada-380-pmsu" for Armada 38x
#   - "marvell,armada-370-xp-pmsu" was used for Armada 370/XP but is now
#     deprecated and will be removed
#
# - reg: Should contain PMSU registers location and length.
#
# Example:
#
# armada-370-xp-pmsu@22000 {
# 	compatible = "marvell,armada-370-pmsu";
# 	reg = <0x22000 0x1000>;
# };
#
```

## Documentation/devicetree/bindings/arm/armada-370-xp.yaml
```yaml
%YAML 1.2
---
version: 1

id: armada-370-xp

title: Marvell Armada 370 and Armada XP Platforms Device Tree Bindings

maintainer:
    -   name: Gregory CLEMENT <gregory.clement@free-electrons.com>

description: >
    TODO

inherits:
    -   id: %ids%

properties:
    -   name: "compatible"
        constraint: |
            "synology,ds414" && "marvell,armadaxp-mv78230" && "marvell,armadaxp" && "marvell,armada-370-xp"
            "synology,ds213j" && "marvell,armada370" && "marvell,armada-370-xp"
            "plathome,openblocks-ax3-4" && "marvell,armadaxp-mv78260" && "marvell,armadaxp" && "marvell,armada-370-xp"
            "netgear,readynas-2120" && "marvell,armadaxp-mv78230" && "marvell,armadaxp" && "marvell,armada-370-xp"
            "netgear,readynas-104" && "marvell,armada370" && "marvell,armada-370-xp"
            "netgear,readynas-102" && "marvell,armada370" && "marvell,armada-370-xp"
            "marvell,rd-axpwifiap" && "marvell,armadaxp-mv78230" && "marvell,armadaxp" && "marvell,armada-370-xp"
            "marvell,axp-matrix" && "marvell,armadaxp-mv78460" && "marvell,armadaxp" && "marvell,armada-370-xp"
            "marvell,axp-gp" && "marvell,armadaxp-mv78460" && "marvell,armadaxp" && "marvell,armada-370-xp"
            "marvell,axp-db" && "marvell,armadaxp-mv78460" && "marvell,armadaxp" && "marvell,armada-370-xp"
            "marvell,armadaxp-mv78460" && "marvell,armadaxp" && "marvell,armada-370-xp"
            "marvell,armadaxp-mv78260" && "marvell,armadaxp" && "marvell,armada-370-xp"
            "marvell,armadaxp-mv78230" && "marvell,armadaxp" && "marvell,armada-370-xp"
            "marvell,armadaxp" && "marvell,armada-370-xp"
            "marvell,armada-370-xp"
            "marvell,armada370" && "marvell,armada-370-xp"
            "marvell,a370-rd" && "marvell,armada370" && "marvell,armada-370-xp"
            "marvell,a370-db" && "marvell,armada370" && "marvell,armada-370-xp"
            "linksys,mamba" && "marvell,armadaxp-mv78230" && "marvell,armadaxp" && "marvell,armada-370-xp"
            "lenovo,ix4-300d" && "marvell,armadaxp-mv78230" && "marvell,armadaxp" && "marvell,armada-370-xp"
            "globalscale,mirabox" && "marvell,armada370" && "marvell,armada-370-xp"
            "dlink,dns327l" && "marvell,armada370" && "marvell,armada-370-xp"

    #address-cells:
    model:
    #size-cells:

...

# Marvell Armada 370 and Armada XP Platforms Device Tree Bindings
# ---------------------------------------------------------------
#
# Boards with a SoC of the Marvell Armada 370 and Armada XP families
# shall have the following property:
#
# Required root node property:
#
# compatible: must contain "marvell,armada-370-xp"
#
# In addition, boards using the Marvell Armada 370 SoC shall have the
# following property:
#
# Required root node property:
#
# compatible: must contain "marvell,armada370"
#
# In addition, boards using the Marvell Armada XP SoC shall have the
# following property:
#
# Required root node property:
#
# compatible: must contain "marvell,armadaxp"
#
```

## Documentation/devicetree/bindings/arm/armada-375.yaml
```yaml
%YAML 1.2
---
version: 1

id: armada-375

title: Marvell Armada 375 Platforms Device Tree Bindings

maintainer:
    -   name: Gregory CLEMENT <gregory.clement@free-electrons.com>

description: >
    TODO

inherits:
    -   id: %ids%

properties:
    -   name: "compatible"
        constraint: |
            "marvell,armada375"
            "marvell,a375-db" && "marvell,armada375"

    #address-cells:
    model:
    #size-cells:

...

# Marvell Armada 375 Platforms Device Tree Bindings
# -------------------------------------------------
#
# Boards with a SoC of the Marvell Armada 375 family shall have the
# following property:
#
# Required root node property:
#
# compatible: must contain "marvell,armada375"
```
