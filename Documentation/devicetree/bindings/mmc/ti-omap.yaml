## Documentation/devicetree/bindings/net/can/fsl-flexcan.yaml
```yaml
%YAML 1.2
---
version: 1

id: fsl-flexcan

title: Flexcan CAN controller on Freescale's ARM and PowerPC system-on-a-chip (SOC).

maintainer:
    -   name: holt@sgi.com <holt@sgi.com>

description: >
    TODO

inherits:
    -   id: %ids%

properties:
    -   name: "compatible"
        constraint: |
            "fsl,vf610-flexcan"
            "fsl,imx6sx-flexcan" && "fsl,imx6q-flexcan"
            "fsl,imx6q-flexcan"
            "fsl,imx53-flexcan" && "fsl,p1010-flexcan"
            "fsl,imx35-flexcan" && "fsl,p1010-flexcan"
            "fsl,imx28-flexcan" && "fsl,p1010-flexcan"
            "fsl,imx25-flexcan" && "fsl,p1010-flexcan"

    clock-names:
    clocks:
    interrupts:
    pinctrl-0:
    pinctrl-names:
    reg:
    status:
    xceiver-supply:

...

# Flexcan CAN controller on Freescale's ARM and PowerPC system-on-a-chip (SOC).
#
# Required properties:
#
# - compatible : Should be "fsl,<processor>-flexcan"
#
#   An implementation should also claim any of the following compatibles
#   that it is fully backwards compatible with:
#
#   - fsl,p1010-flexcan
#
# - reg : Offset and length of the register set for this device
# - interrupts : Interrupt tuple for this device
#
# Optional properties:
#
# - clock-frequency : The oscillator frequency driving the flexcan device
#
# - xceiver-supply: Regulator that powers the CAN transceiver
#
# Example:
#
# 	can@1c000 {
# 		compatible = "fsl,p1010-flexcan";
# 		reg = <0x1c000 0x1000>;
# 		interrupts = <48 0x2>;
# 		interrupt-parent = <&mpic>;
# 		clock-frequency = <200000000>; // filled in by bootloader
# 	};
```

## Documentation/devicetree/bindings/net/can/microchip,mcp251x.yaml
```yaml
%YAML 1.2
---
version: 1

id: microchip,mcp251x

title: Microchip MCP251X stand-alone CAN controller device tree bindings

maintainer:
    -   name: Alexander Shiyan <shc_work@mail.ru>

description: >
    TODO

inherits:
    -   id: %ids%

properties:
    -   name: "compatible"
        constraint: |
            "microchip,mcp2515"

    clocks:
    interrupt-parent:
    interrupts:
    pinctrl-0:
    pinctrl-names:
    reg:
    spi-max-frequency:
    vdd-supply:

...

# * Microchip MCP251X stand-alone CAN controller device tree bindings
#
# Required properties:
#  - compatible: Should be one of the following:
#    - "microchip,mcp2510" for MCP2510.
#    - "microchip,mcp2515" for MCP2515.
#  - reg: SPI chip select.
#  - clocks: The clock feeding the CAN controller.
#  - interrupt-parent: The parent interrupt controller.
#  - interrupts: Should contain IRQ line for the CAN controller.
#
# Optional properties:
#  - vdd-supply: Regulator that powers the CAN controller.
#  - xceiver-supply: Regulator that powers the CAN transceiver.
#
# Example:
# 	can0: can@1 {
# 		compatible = "microchip,mcp2515";
# 		reg = <1>;
# 		clocks = <&clk24m>;
# 		interrupt-parent = <&gpio4>;
# 		interrupts = <13 0x2>;
# 		vdd-supply = <&reg5v0>;
# 		xceiver-supply = <&reg5v0>;
# 	};
```

## Documentation/devicetree/bindings/net/cdns-emac.yaml
```yaml
%YAML 1.2
---
version: 1

id: cdns-emac

title: Cadence EMAC Ethernet controller

maintainer:
    -   name: Jean-Christophe PLAGNIOL-VILLARD <plagnioj@jcrosoft.com>

description: >
    TODO

inherits:
    -   id: %ids%

properties:
    -   name: "compatible"
        constraint: |
            "cdns,zynq-gem" && "cdns,gem"
            "cdns,at91rm9200-emac" && "cdns,emac"

    clock-names:
    clocks:
    interrupts:
    phy-mode:
    pinctrl-0:
    pinctrl-names:
    reg:
    status:

...

# * Cadence EMAC Ethernet controller
#
# Required properties:
# - compatible: Should be "cdns,[<chip>-]{emac}"
#   Use "cdns,at91rm9200-emac" Atmel at91rm9200 SoC.
#   Use "cdns,zynq-gem" Xilinx Zynq-7xxx SoC.
#   Or the generic form: "cdns,emac".
# - reg: Address and length of the register set for the device
# - interrupts: Should contain macb interrupt
# - phy-mode: see ethernet.txt file in the same directory.
#
# Examples:
#
# 	macb0: ethernet@fffc4000 {
# 		compatible = "cdns,at91rm9200-emac";
# 		reg = <0xfffc4000 0x4000>;
# 		interrupts = <21>;
# 		phy-mode = "rmii";
# 		local-mac-address = [3a 0e 03 04 05 06];
# 	};
```

## Documentation/devicetree/bindings/net/cpsw-phy-sel.yaml
```yaml
%YAML 1.2
---
version: 1

id: cpsw-phy-sel

title: TI CPSW Phy mode Selection Device Tree Bindings

maintainer:
    -   name: Mugunthan V N <mugunthanvnm@ti.com>

description: >
    TODO

inherits:
    -   id: %ids%

properties:
    -   name: "compatible"
        constraint: |
            "ti,dra7xx-cpsw-phy-sel"
            "ti,am43xx-cpsw-phy-sel"
            "ti,am3352-cpsw-phy-sel"

    reg:
    reg-names:
    rmii-clock-ext:

...

# TI CPSW Phy mode Selection Device Tree Bindings
# -----------------------------------------------
#
# Required properties:
# - compatible		: Should be "ti,am3352-cpsw-phy-sel" for am335x platform and
# 			  "ti,dra7xx-cpsw-phy-sel" for dra7xx platform
# 			  "ti,am43xx-cpsw-phy-sel" for am43xx platform
# - reg			: physical base address and size of the cpsw
# 			  registers map
# - reg-names		: names of the register map given in "reg" node
#
# Optional properties:
# -rmii-clock-ext		: If present, the driver will configure the RMII
# 			  interface to external clock usage
#
# Examples:
#
# 	phy_sel: cpsw-phy-sel@44e10650 {
# 		compatible = "ti,am3352-cpsw-phy-sel";
# 		reg= <0x44e10650 0x4>;
# 		reg-names = "gmii-sel";
# 	};
#
# (or)
# 	phy_sel: cpsw-phy-sel@44e10650 {
# 		compatible = "ti,am3352-cpsw-phy-sel";
# 		reg= <0x44e10650 0x4>;
# 		reg-names = "gmii-sel";
# 		rmii-clock-ext;
# 	};
```

## Documentation/devicetree/bindings/net/davicom-dm9000.yaml
```yaml
%YAML 1.2
---
version: 1

id: davicom-dm9000

title: Davicom DM9000 Fast Ethernet controller

maintainer:
    -   name: Sergei Shtylyov <sergei.shtylyov@cogentembedded.com>

description: >
    TODO

inherits:
    -   id: %ids%

properties:
    -   name: "compatible"
        constraint: |
            "davicom,dm9000"

    bank-width:
    davicom,no-eeprom:
    fsl,weim-cs-timing:
    gpmc,access-ns:
    gpmc,adv-on-ns:
    gpmc,adv-rd-off-ns:
    gpmc,adv-wr-off-ns:
    gpmc,bus-turnaround-ns:
    gpmc,clk-activation-ns:
    gpmc,cs-on-ns:
    gpmc,cs-rd-off-ns:
    gpmc,cs-wr-off-ns:
    gpmc,cycle2cycle-delay-ns:
    gpmc,cycle2cycle-diffcsen:
    gpmc,cycle2cycle-samecsen:
    gpmc,device-width:
    gpmc,mux-add-data:
    gpmc,oe-off-ns:
    gpmc,oe-on-ns:
    gpmc,page-burst-access-ns:
    gpmc,rd-cycle-ns:
    gpmc,wait-monitoring-ns:
    gpmc,wait-pin:
    gpmc,we-off-ns:
    gpmc,we-on-ns:
    gpmc,wr-access-ns:
    gpmc,wr-cycle-ns:
    gpmc,wr-data-mux-bus-ns:
    interrupt-parent:
    interrupts:
    local-mac-address:
    pinctrl-0:
    pinctrl-names:
    reg:

...

# Davicom DM9000 Fast Ethernet controller
#
# Required properties:
# - compatible = "davicom,dm9000";
# - reg : physical addresses and sizes of registers, must contain 2 entries:
#     first entry : address register,
#     second entry : data register.
# - interrupt-parent : interrupt controller to which the device is connected
# - interrupts : interrupt specifier specific to interrupt controller
#
# Optional properties:
# - davicom,no-eeprom : Configuration EEPROM is not available
# - davicom,ext-phy : Use external PHY
# - reset-gpios : phandle of gpio that will be used to reset chip during probe
# - vcc-supply : phandle of regulator that will be used to enable power to chip
#
# Example:
#
# 	ethernet@18000000 {
# 		compatible = "davicom,dm9000";
# 		reg = <0x18000000 0x2 0x18000004 0x2>;
# 		interrupt-parent = <&gpn>;
# 		interrupts = <7 4>;
# 		local-mac-address = [00 00 de ad be ef];
# 		davicom,no-eeprom;
# 		reset-gpios = <&gpf 12 GPIO_ACTIVE_LOW>;
# 		vcc-supply = <&eth0_power>;
# 	};
```

## Documentation/devicetree/bindings/net/davinci_emac.yaml
```yaml
%YAML 1.2
---
version: 1

id: davinci_emac

title: Texas Instruments Davinci EMAC

maintainer:
    -   name: Sergei Shtylyov <sergei.shtylyov@cogentembedded.com>

description: >
    TODO

inherits:
    -   id: %ids%

properties:
    -   name: "compatible"
        constraint: |
            "ti,dm816-emac"
            "ti,davinci-dm6467-emac"
            "ti,am3517-emac"

    interrupts:
    local-mac-address:
    reg:
    status:
    syscon:
    ti,davinci-ctrl-mod-reg-offset:
    ti,davinci-ctrl-ram-offset:
    ti,davinci-ctrl-ram-size:
    ti,davinci-ctrl-reg-offset:
    ti,davinci-rmii-en:
    ti,hwmods:

...

# * Texas Instruments Davinci EMAC
#
# This file provides information, what the device node
# for the davinci_emac interface contains.
#
# Required properties:
# - compatible: "ti,davinci-dm6467-emac", "ti,am3517-emac" or
#   "ti,dm816-emac"
# - reg: Offset and length of the register set for the device
# - ti,davinci-ctrl-reg-offset: offset to control register
# - ti,davinci-ctrl-mod-reg-offset: offset to control module register
# - ti,davinci-ctrl-ram-offset: offset to control module ram
# - ti,davinci-ctrl-ram-size: size of control module ram
# - interrupts: interrupt mapping for the davinci emac interrupts sources:
#               4 sources: <Receive Threshold Interrupt
# 			  Receive Interrupt
# 			  Transmit Interrupt
# 			  Miscellaneous Interrupt>
#
# Optional properties:
# - phy-handle: See ethernet.txt file in the same directory.
#               If absent, davinci_emac driver defaults to 100/FULL.
# - ti,davinci-rmii-en: 1 byte, 1 means use RMII
# - ti,davinci-no-bd-ram: boolean, does EMAC have BD RAM?
#
# Example (enbw_cmc board):
# 	eth0: emac@1e20000 {
# 		compatible = "ti,davinci-dm6467-emac";
# 		reg = <0x220000 0x4000>;
# 		ti,davinci-ctrl-reg-offset = <0x3000>;
# 		ti,davinci-ctrl-mod-reg-offset = <0x2000>;
# 		ti,davinci-ctrl-ram-offset = <0>;
# 		ti,davinci-ctrl-ram-size = <0x2000>;
# 		local-mac-address = [ 00 00 00 00 00 00 ];
# 		interrupts = <33
# 				34
# 				35
# 				36
# 				>;
# 		interrupt-parent = <&intc>;
# 	};
```

## Documentation/devicetree/bindings/net/lpc-eth.yaml
```yaml
%YAML 1.2
---
version: 1

id: lpc-eth

title: NXP LPC32xx SoC Ethernet Controller

maintainer:
    -   name: Roland Stigge <stigge@antcom.de>

description: >
    TODO

inherits:
    -   id: %ids%

properties:
    -   name: "compatible"
        constraint: |
            "nxp,lpc-eth"

    interrupts:
    phy-mode:
    reg:
    use-iram:

...

# * NXP LPC32xx SoC Ethernet Controller
#
# Required properties:
# - compatible: Should be "nxp,lpc-eth"
# - reg: Address and length of the register set for the device
# - interrupts: Should contain ethernet controller interrupt
#
# Optional properties:
# - phy-mode: See ethernet.txt file in the same directory. If the property is
#   absent, "rmii" is assumed.
# - use-iram: Use LPC32xx internal SRAM (IRAM) for DMA buffering
#
# Example:
#
# 	mac: ethernet@31060000 {
# 		compatible = "nxp,lpc-eth";
# 		reg = <0x31060000 0x1000>;
# 		interrupt-parent = <&mic>;
# 		interrupts = <29 0>;
#
# 		phy-mode = "rmii";
# 		use-iram;
# 	};
```

## Documentation/devicetree/bindings/net/marvell-armada-370-neta.yaml
```yaml
%YAML 1.2
---
version: 1

id: marvell-armada-370-neta

title: Marvell Armada 370 / Armada XP Ethernet Controller (NETA)

maintainer:
    -   name: Thomas Petazzoni <thomas.petazzoni@free-electrons.com>

description: >
    TODO

inherits:
    -   id: %ids%

properties:
    -   name: "compatible"
        constraint: |
            "marvell,armada-xp-neta"
            "marvell,armada-370-neta"

    clocks:
    interrupts:
    interrupts-extended:
    phy:
    phy-mode:
    pinctrl-0:
    pinctrl-names:
    reg:
    status:

...

# * Marvell Armada 370 / Armada XP Ethernet Controller (NETA)
#
# Required properties:
# - compatible: "marvell,armada-370-neta" or "marvell,armada-xp-neta".
# - reg: address and length of the register set for the device.
# - interrupts: interrupt for the device
# - phy: See ethernet.txt file in the same directory.
# - phy-mode: See ethernet.txt file in the same directory
# - clocks: a pointer to the reference clock for this device.
#
# Example:
#
# ethernet@d0070000 {
# 	compatible = "marvell,armada-370-neta";
# 	reg = <0xd0070000 0x2500>;
# 	interrupts = <8>;
# 	clocks = <&gate_clk 4>;
# 	status = "okay";
# 	phy = <&phy0>;
# 	phy-mode = "rgmii-id";
# };
```

## Documentation/devicetree/bindings/net/marvell-pxa168.yaml
```yaml
%YAML 1.2
---
version: 1

id: marvell-pxa168

title: Marvell PXA168 Ethernet Controller

maintainer:
    -   name: Antoine Ténart <antoine.tenart@free-electrons.com>

description: >
    TODO

inherits:
    -   id: %ids%

properties:
    -   name: "compatible"
        constraint: |
            "marvell,pxa168-eth"

    #address-cells:
    clocks:
    interrupts:
    local-mac-address:
    phy-connection-type:
    phy-handle:
    reg:
    #size-cells:
    status:

...

# * Marvell PXA168 Ethernet Controller
#
# Required properties:
# - compatible: should be "marvell,pxa168-eth".
# - reg: address and length of the register set for the device.
# - interrupts: interrupt for the device.
# - clocks: pointer to the clock for the device.
#
# Optional properties:
# - port-id: Ethernet port number. Should be '0','1' or '2'.
# - #address-cells: must be 1 when using sub-nodes.
# - #size-cells: must be 0 when using sub-nodes.
# - phy-handle: see ethernet.txt file in the same directory.
# - local-mac-address: see ethernet.txt file in the same directory.
#
# Sub-nodes:
# Each PHY can be represented as a sub-node. This is not mandatory.
#
# Sub-nodes required properties:
# - reg: the MDIO address of the PHY.
#
# Example:
#
# 	eth0: ethernet@f7b90000 {
# 		compatible = "marvell,pxa168-eth";
# 		reg = <0xf7b90000 0x10000>;
# 		clocks = <&chip CLKID_GETH0>;
# 		interrupts = <GIC_SPI 24 IRQ_TYPE_LEVEL_HIGH>;
# 		#address-cells = <1>;
# 		#size-cells = <0>;
# 		phy-handle = <&ethphy0>;
#
# 		ethphy0: ethernet-phy@0 {
# 			reg = <0>;
# 		};
# 	};
```

## Documentation/devicetree/bindings/net/micrel-ks8851.yaml
```yaml
%YAML 1.2
---
version: 1

id: micrel-ks8851

title: Micrel KS8851 Ethernet mac (MLL)

maintainer:
    -   name: Jean-Christophe PLAGNIOL-VILLARD <plagnioj@jcrosoft.com>

description: >
    TODO

inherits:
    -   id: %ids%

properties:
    -   name: "compatible"
        constraint: |
            "micrel,ks8851"

    interrupt-parent:
    interrupts:
    reg:
    reset-gpios:
    spi-max-frequency:
    vdd-io-supply:
    vdd-supply:

...

# Micrel KS8851 Ethernet mac (MLL)
#
# Required properties:
# - compatible = "micrel,ks8851-mll" of parallel interface
# - reg : 2 physical address and size of registers for data and command
# - interrupts : interrupt connection
#
# Micrel KS8851 Ethernet mac (SPI)
#
# Required properties:
# - compatible = "micrel,ks8851" or the deprecated "ks8851"
# - reg : chip select number
# - interrupts : interrupt connection
#
# Optional properties:
# - vdd-supply: analog 3.3V supply for Ethernet mac
# - vdd-io-supply: digital 1.8V IO supply for Ethernet mac
# - reset-gpios: reset_n input pin
```

## Documentation/devicetree/bindings/net/moxa,moxart-mac.yaml
```yaml
%YAML 1.2
---
version: 1

id: moxa,moxart-mac

title: MOXA ART Ethernet Controller

maintainer:
    -   name: Jonas Jensen <jonas.jensen@gmail.com>

description: >
    TODO

inherits:
    -   id: %ids%

properties:
    -   name: "compatible"
        constraint: |
            "moxa,moxart-mac"

    interrupts:
    phy-handle:
    phy-mode:
    reg:
    status:

...

# MOXA ART Ethernet Controller
#
# Required properties:
#
# - compatible : Must be "moxa,moxart-mac"
# - reg : Should contain register location and length
# - interrupts : Should contain the mac interrupt number
#
# Example:
#
# 	mac0: mac@90900000 {
# 		compatible = "moxa,moxart-mac";
# 		reg =	<0x90900000 0x100>;
# 		interrupts = <25 0>;
# 	};
#
# 	mac1: mac@92000000 {
# 		compatible = "moxa,moxart-mac";
# 		reg =	<0x92000000 0x100>;
# 		interrupts = <27 0>;
# 	};
```
