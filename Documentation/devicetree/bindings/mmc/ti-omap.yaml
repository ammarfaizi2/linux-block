## Documentation/devicetree/bindings/mmc/ti-omap.yaml
```yaml
%YAML 1.2
---
version: 1

id: ti-omap

title: TI MMC host controller for OMAP1 and 2420

maintainer:
    -   name: Tony Lindgren <tony@atomide.com>

description: >
    TODO

inherits:
    -   id: %ids%

properties:
    -   name: "compatible"
        constraint: |
            "ti,omap2420-mmc"

    dma-names:
    dmas:
    interrupts:
    reg:
    ti,hwmods:

...

# * TI MMC host controller for OMAP1 and 2420
#
# The MMC Host Controller on TI OMAP1 and 2420 family provides
# an interface for MMC, SD, and SDIO types of memory cards.
#
# This file documents differences between the core properties described
# by mmc.txt and the properties used by the omap mmc driver.
#
# Note that this driver will not work with omap2430 or later omaps,
# please see the omap hsmmc driver for the current omaps.
#
# Required properties:
# - compatible: Must be "ti,omap2420-mmc", for OMAP2420 controllers
# - ti,hwmods: For 2420, must be "msdi<n>", where n is controller
#   instance starting 1
#
# Examples:
#
# 	msdi1: mmc@4809c000 {
# 		compatible = "ti,omap2420-mmc";
# 		ti,hwmods = "msdi1";
# 		reg = <0x4809c000 0x80>;
# 		interrupts = <83>;
# 		dmas = <&sdma 61 &sdma 62>;
# 		dma-names = "tx", "rx";
# 	};
#
# * TI MMC host controller for OMAP1 and 2420
#
# The MMC Host Controller on TI OMAP1 and 2420 family provides
# an interface for MMC, SD, and SDIO types of memory cards.
#
# This file documents differences between the core properties described
# by mmc.txt and the properties used by the omap mmc driver.
#
# Note that this driver will not work with omap2430 or later omaps,
# please see the omap hsmmc driver for the current omaps.
#
# Required properties:
# - compatible: Must be "ti,omap2420-mmc", for OMAP2420 controllers
# - ti,hwmods: For 2420, must be "msdi<n>", where n is controller
#   instance starting 1
#
# Examples:
#
# 	msdi1: mmc@4809c000 {
# 		compatible = "ti,omap2420-mmc";
# 		ti,hwmods = "msdi1";
# 		reg = <0x4809c000 0x80>;
# 		interrupts = <83>;
# 		dmas = <&sdma 61 &sdma 62>;
# 		dma-names = "tx", "rx";
# 	};
#
```

## Documentation/devicetree/bindings/mtd/arm-versatile.yaml
```yaml
%YAML 1.2
---
version: 1

id: arm-versatile

title: Flash device on ARM Versatile board

maintainer:
    -   name: Grant Likely <grant.likely@secretlab.ca>

description: >
    TODO

inherits:
    -   id: %ids%

properties:
    -   name: "compatible"
        constraint: |
            "arm,versatile-flash"

    bank-width:
    reg:

...

# Flash device on ARM Versatile board
#
# Required properties:
# - compatible : must be "arm,versatile-flash";
# - bank-width : width in bytes of flash interface.
#
# The device tree may optionally contain sub-nodes describing partitions of the
# address space. See partition.txt for more detail.
```

## Documentation/devicetree/bindings/mtd/atmel-dataflash.yaml
```yaml
%YAML 1.2
---
version: 1

id: atmel-dataflash

title: Atmel Data Flash

maintainer:
    -   name: Jamie Lentin <jm@lentin.co.uk>

description: >
    TODO

inherits:
    -   id: %ids%

properties:
    -   name: "compatible"
        constraint: |
            "atmel,at45db321d" && "atmel,at45" && "atmel,dataflash"
            "atmel,at45db021d" && "atmel,at45" && "atmel,dataflash"
            "atmel,at45" && "atmel,dataflash"

    reg:
    spi-max-frequency:

...

# * Atmel Data Flash
#
# Required properties:
# - compatible : "atmel,<model>", "atmel,<series>", "atmel,dataflash".
#
# The device tree may optionally contain sub-nodes describing partitions of the
# address space. See partition.txt for more detail.
#
# Example:
#
# flash@1 {
# 	#address-cells = <1>;
# 	#size-cells = <1>;
# 	compatible = "atmel,at45db321d", "atmel,at45", "atmel,dataflash";
# 	spi-max-frequency = <25000000>;
# 	reg = <1>;
# };
```

## Documentation/devicetree/bindings/mtd/elm.yaml
```yaml
%YAML 1.2
---
version: 1

id: elm

title: Error location module

maintainer:
    -   name: Philip Avinash <avinashphilip@ti.com>

description: >
    TODO

inherits:
    -   id: %ids%

properties:
    -   name: "compatible"
        constraint: |
            "ti,am3352-elm"

    clock-names:
    clocks:
    interrupts:
    reg:
    status:
    ti,hwmods:

...

# Error location module
#
# Required properties:
# - compatible: Must be "ti,am33xx-elm"
# - reg: physical base address and size of the registers map.
# - interrupts: Interrupt number for the elm.
#
# Optional properties:
# - ti,hwmods: Name of the hwmod associated to the elm
#
# Example:
# elm: elm@0 {
# 	compatible = "ti,am3352-elm";
# 	reg = <0x48080000 0x2000>;
# 	interrupts = <4>;
# };
```

## Documentation/devicetree/bindings/mtd/jedec,spi-nor.yaml
```yaml
%YAML 1.2
---
version: 1

id: jedec,spi-nor

title: MTD SPI driver for ST M25Pxx (and similar) serial flash chips

maintainer:
    -   name: Brian Norris <computersforpeace@gmail.com>

description: >
    TODO

inherits:
    -   id: %ids%

properties:
    -   name: "compatible"
        constraint: |
            "w25q32" && "jedec,spi-nor"
            "st,m25p40" && "jedec,spi-nor"
            "st,m25p16" && "jedec,spi-nor"
            "st,m25p128" && "jedec,spi-nor"
            "spansion,s25fl512s" && "jedec,spi-nor"
            "spansion,s25fl008k" && "jedec,spi-nor"
            "spansion,m25p80"
            "n25q128a13" && "jedec,spi-nor"
            "mxicy,mx25l4005a" && "jedec,spi-nor"
            "mxicy,mx25l1606e" && "jedec,spi-nor"
            "mxicy,mx25l12805d" && "jedec,spi-nor"
            "mx25l25635e" && "jedec,spi-nor"
            "micron,n25q064" && "jedec,spi-nor"
            "m25p64" && "jedec,spi-nor"
            "m25p40" && "jedec,spi-nor"
            "m25p128" && "jedec,spi-nor"

    #address-cells:
    mode:
    reg:
    #size-cells:
    spi-max-frequency:

...

# * MTD SPI driver for ST M25Pxx (and similar) serial flash chips
#
# Required properties:
# - #address-cells, #size-cells : Must be present if the device has sub-nodes
#   representing partitions.
# - compatible : May include a device-specific string consisting of the
#                manufacturer and name of the chip. Bear in mind the DT binding
#                is not Linux-only, but in case of Linux, see the "m25p_ids"
#                table in drivers/mtd/devices/m25p80.c for the list of supported
#                chips.
#                Must also include "jedec,spi-nor" for any SPI NOR flash that can
#                be identified by the JEDEC READ ID opcode (0x9F).
# - reg : Chip-Select number
# - spi-max-frequency : Maximum frequency of the SPI bus the chip can operate at
#
# Optional properties:
# - m25p,fast-read : Use the "fast read" opcode to read data from the chip instead
#                    of the usual "read" opcode. This opcode is not supported by
#                    all chips and support for it can not be detected at runtime.
#                    Refer to your chips' datasheet to check if this is supported
#                    by your chip.
#
# Example:
#
# 	flash: m25p80@0 {
# 		#address-cells = <1>;
# 		#size-cells = <1>;
# 		compatible = "spansion,m25p80", "jedec,spi-nor";
# 		reg = <0>;
# 		spi-max-frequency = <40000000>;
# 		m25p,fast-read;
# 	};
```

## Documentation/devicetree/bindings/mtd/mtd-physmap.yaml
```yaml
%YAML 1.2
---
version: 1

id: mtd-physmap

title: CFI or JEDEC memory-mapped NOR flash, MTD-RAM (NVRAM...)

maintainer:
    -   name: Aaron Sierra <asierra@xes-inc.com>

description: >
    TODO

inherits:
    -   id: %ids%

properties:
    -   name: "compatible"
        constraint: |
            "xlnx,xps-mch-emc-2"."00"."a" && "cfi-flash"
            "numonyx,js28f128" && "cfi-flash"
            "mtd-ram"
            "intel,PC28F640P30T85" && "cfi-flash"
            "intel,JS28F640" && "cfi-flash"
            "intel,JS28F128" && "cfi-flash"
            "intel,28F640J3A" && "cfi-flash"
            "ge,imp3a-paged-flash" && "cfi-flash"
            "ge,imp3a-firmware-mirror" && "cfi-flash"
            "gef,sbc610-paged-flash" && "cfi-flash"
            "gef,sbc610-firmware-mirror" && "cfi-flash"
            "gef,sbc310-paged-flash" && "cfi-flash"
            "gef,sbc310-firmware-mirror" && "cfi-flash"
            "gef,ppc9a-paged-flash" && "cfi-flash"
            "gef,ppc9a-firmware-mirror" && "cfi-flash"
            "everspin,mram" && "mtd-ram"
            "cfi-flash"
            "arm,vexpress-psram" && "mtd-ram"
            "arm,vexpress-flash" && "cfi-flash"
            "amd,s29gl512n" && "cfi-flash"
            "amd,s29gl256n" && "cfi-flash"
            "amd,s29gl032a" && "cfi-flash"
            "amd,s29gl01gp" && "cfi-flash"
            "amd,am29lv652d" && "cfi-flash"
            "amd,am29lv28ml" && "cfi-flash"

    bank-width:
    device-width:
    reg:

...

# CFI or JEDEC memory-mapped NOR flash, MTD-RAM (NVRAM...)
#
# Flash chips (Memory Technology Devices) are often used for solid state
# file systems on embedded devices.
#
#  - compatible : should contain the specific model of mtd chip(s)
#    used, if known, followed by either "cfi-flash", "jedec-flash",
#    "mtd-ram" or "mtd-rom".
#  - reg : Address range(s) of the mtd chip(s)
#    It's possible to (optionally) define multiple "reg" tuples so that
#    non-identical chips can be described in one node.
#  - bank-width : Width (in bytes) of the bank.  Equal to the
#    device width times the number of interleaved chips.
#  - device-width : (optional) Width of a single mtd chip.  If
#    omitted, assumed to be equal to 'bank-width'.
#  - #address-cells, #size-cells : Must be present if the device has
#    sub-nodes representing partitions (see below).  In this case
#    both #address-cells and #size-cells must be equal to 1.
#  - no-unaligned-direct-access: boolean to disable the default direct
#    mapping of the flash.
#    On some platforms (e.g. MPC5200) a direct 1:1 mapping may cause
#    problems with JFFS2 usage, as the local bus (LPB) doesn't support
#    unaligned accesses as implemented in the JFFS2 code via memcpy().
#    By defining "no-unaligned-direct-access", the flash will not be
#    exposed directly to the MTD users (e.g. JFFS2) any more.
#  - linux,mtd-name: allow to specify the mtd name for retro capability with
#    physmap-flash drivers as boot loader pass the mtd partition via the old
#    device name physmap-flash.
#  - use-advanced-sector-protection: boolean to enable support for the
#    advanced sector protection (Spansion: PPB - Persistent Protection
#    Bits) locking.
#
# For JEDEC compatible devices, the following additional properties
# are defined:
#
#  - vendor-id : Contains the flash chip's vendor id (1 byte).
#  - device-id : Contains the flash chip's device id (1 byte).
#
# For ROM compatible devices (and ROM fallback from cfi-flash), the following
# additional (optional) property is defined:
#
#  - erase-size : The chip's physical erase block size in bytes.
#
# The device tree may optionally contain sub-nodes describing partitions of the
# address space. See partition.txt for more detail.
#
# Example:
#
# 	flash@ff000000 {
# 		compatible = "amd,am29lv128ml", "cfi-flash";
# 		reg = <ff000000 01000000>;
# 		bank-width = <4>;
# 		device-width = <1>;
# 		#address-cells = <1>;
# 		#size-cells = <1>;
# 		fs@0 {
# 			label = "fs";
# 			reg = <0 f80000>;
# 		};
# 		firmware@f80000 {
# 			label ="firmware";
# 			reg = <f80000 80000>;
# 			read-only;
# 		};
# 	};
#
# Here an example with multiple "reg" tuples:
#
# 	flash@f0000000,0 {
# 		#address-cells = <1>;
# 		#size-cells = <1>;
# 		compatible = "intel,PC48F4400P0VB", "cfi-flash";
# 		reg = <0 0x00000000 0x02000000
# 		       0 0x02000000 0x02000000>;
# 		bank-width = <2>;
# 		partition@0 {
# 			label = "test-part1";
# 			reg = <0 0x04000000>;
# 		};
# 	};
#
# An example using SRAM:
#
# 	sram@2,0 {
# 		compatible = "samsung,k6f1616u6a", "mtd-ram";
# 		reg = <2 0 0x00200000>;
# 		bank-width = <2>;
# 	};
#
```

## Documentation/devicetree/bindings/mtd/mxc-nand.yaml
```yaml
%YAML 1.2
---
version: 1

id: mxc-nand

title: Freescale's mxc_nand

maintainer:
    -   name: Uwe Kleine-König <u.kleine-koenig@pengutronix.de>

description: >
    TODO

inherits:
    -   id: %ids%

properties:
    -   name: "compatible"
        constraint: |
            "fsl,imx27-nand"

    #address-cells:
    clocks:
    interrupts:
    nand-bus-width:
    nand-ecc-mode:
    nand-on-flash-bbt:
    pinctrl-0:
    pinctrl-names:
    reg:
    #size-cells:
    status:

...

# * Freescale's mxc_nand
#
# Required properties:
# - compatible: "fsl,imxXX-nand"
# - reg: address range of the nfc block
# - interrupts: irq to be used
# - nand-bus-width: see nand.txt
# - nand-ecc-mode: see nand.txt
# - nand-on-flash-bbt: see nand.txt
#
# Example:
#
# 	nand@d8000000 {
# 		compatible = "fsl,imx27-nand";
# 		reg = <0xd8000000 0x1000>;
# 		interrupts = <29>;
# 		nand-bus-width = <8>;
# 		nand-ecc-mode = "hw";
# 	};
```

## Documentation/devicetree/bindings/net/allwinner,sun7i-a20-gmac.yaml
```yaml
%YAML 1.2
---
version: 1

id: allwinner,sun7i-a20-gmac

title: Allwinner GMAC ethernet controller

maintainer:
    -   name: Chen-Yu Tsai <wens@csie.org>

description: >
    TODO

inherits:
    -   id: %ids%

properties:
    -   name: "compatible"
        constraint: |
            "allwinner,sun7i-a20-gmac-clk"
            "allwinner,sun7i-a20-gmac"

    #address-cells:
    clock-names:
    clocks:
    interrupt-names:
    interrupts:
    phy:
    phy-mode:
    phy-supply:
    pinctrl-0:
    pinctrl-names:
    reg:
    reset-names:
    resets:
    #size-cells:
    snps,fixed-burst:
    snps,force_sf_dma_mode:
    snps,pbl:
    snps,reset-active-low:
    snps,reset-delays-us:
    snps,reset-gpio:
    status:

...

# * Allwinner GMAC ethernet controller
#
# This device is a platform glue layer for stmmac.
# Please see stmmac.txt for the other unchanged properties.
#
# Required properties:
#  - compatible:  Should be "allwinner,sun7i-a20-gmac"
#  - clocks: Should contain the GMAC main clock, and tx clock
#    The tx clock type should be "allwinner,sun7i-a20-gmac-clk"
#  - clock-names: Should contain the clock names "stmmaceth",
#    and "allwinner_gmac_tx"
#
# Optional properties:
# - phy-supply: phandle to a regulator if the PHY needs one
#
# Examples:
#
# 	gmac: ethernet@01c50000 {
# 		compatible = "allwinner,sun7i-a20-gmac";
# 		reg = <0x01c50000 0x10000>,
# 		      <0x01c20164 0x4>;
# 		interrupts = <0 85 1>;
# 		interrupt-names = "macirq";
# 		clocks = <&ahb_gates 49>, <&gmac_tx>;
# 		clock-names = "stmmaceth", "allwinner_gmac_tx";
# 		phy-mode = "mii";
# 	};
```

## Documentation/devicetree/bindings/net/can/atmel-can.yaml
```yaml
%YAML 1.2
---
version: 1

id: atmel-can

title: AT91 CAN *

maintainer:
    -   name: Ludovic Desroches <ludovic.desroches@atmel.com>

description: >
    TODO

inherits:
    -   id: %ids%

properties:
    -   name: "compatible"
        constraint: |
            "atmel,at91sam9x5-can"
            "atmel,at91sam9263-can"

    clock-names:
    clocks:
    interrupts:
    pinctrl-0:
    pinctrl-names:
    reg:

...

# * AT91 CAN *
#
# Required properties:
#   - compatible: Should be "atmel,at91sam9263-can" or "atmel,at91sam9x5-can"
#   - reg: Should contain CAN controller registers location and length
#   - interrupts: Should contain IRQ line for the CAN controller
#
# Example:
#
# 	can0: can@f000c000 {
# 		compatible = "atmel,at91sam9x5-can";
# 		reg = <0xf000c000 0x300>;
# 		interrupts = <40 4 5>
# 	};
```
