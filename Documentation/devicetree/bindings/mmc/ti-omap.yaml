## Documentation/devicetree/bindings/net/smsc-lan91c111.yaml
```yaml
%YAML 1.2
---
version: 1

id: smsc-lan91c111

title: SMSC LAN91c111 Ethernet mac

maintainer:
    -   name: Tony Lindgren <tony@atomide.com>

description: >
    TODO

inherits:
    -   id: %ids%

properties:
    -   name: "compatible"
        constraint: |
            "smsc,lan91c111"

    interrupt-parent:
    interrupts:
    reg:
    reg-io-width:
    reset-gpios:

...

# SMSC LAN91c111 Ethernet mac
#
# Required properties:
# - compatible = "smsc,lan91c111";
# - reg : physical address and size of registers
# - interrupts : interrupt connection
#
# Optional properties:
# - phy-device : see ethernet.txt file in the same directory
# - reg-io-width : Mask of sizes (in bytes) of the IO accesses that
#   are supported on the device.  Valid value for SMSC LAN91c111 are
#   1, 2 or 4.  If it's omitted or invalid, the size would be 2 meaning
#   16-bit access only.
# - power-gpios: GPIO to control the PWRDWN pin
# - reset-gpios: GPIO to control the RESET pin
```

## Documentation/devicetree/bindings/net/socfpga-dwmac.yaml
```yaml
%YAML 1.2
---
version: 1

id: socfpga-dwmac

title: Altera SOCFPGA SoC DWMAC controller

maintainer:
    -   name: Dinh Nguyen <dinguyen@altera.com>

description: >
    TODO

inherits:
    -   id: %ids%

properties:
    -   name: "compatible"
        constraint: |
            "snps,dwmac-3"."70a" && "snps,dwmac"
            "snps,dwmac-3"."70a"
            "altr,socfpga-stmmac" && "snps,dwmac-3"."72a" && "snps,dwmac"
            "altr,socfpga-stmmac" && "snps,dwmac-3"."70a" && "snps,dwmac"

    altr,sysmgr-syscon:
    clock-names:
    clocks:
    interrupt-names:
    interrupts:
    mac-address:
    max-frame-size:
    phy-addr:
    phy-mode:
    reg:
    reset-names:
    resets:
    rxc-skew-ps:
    rxd0-skew-ps:
    rxd1-skew-ps:
    rxd2-skew-ps:
    rxd3-skew-ps:
    rxdv-skew-ps:
    rx-fifo-depth:
    snps,multicast-filter-bins:
    snps,perfect-filter-entries:
    status:
    txc-skew-ps:
    txd0-skew-ps:
    txd1-skew-ps:
    txd2-skew-ps:
    txd3-skew-ps:
    txen-skew-ps:
    tx-fifo-depth:

...

# Altera SOCFPGA SoC DWMAC controller
#
# This is a variant of the dwmac/stmmac driver an inherits all descriptions
# present in Documentation/devicetree/bindings/net/stmmac.txt.
#
# The device node has additional properties:
#
# Required properties:
#  - compatible	: Should contain "altr,socfpga-stmmac" along with
# 		  "snps,dwmac" and any applicable more detailed
# 		  designware version numbers documented in stmmac.txt
#  - altr,sysmgr-syscon : Should be the phandle to the system manager node that
#    encompasses the glue register, the register offset, and the register shift.
#
# Optional properties:
# altr,emac-splitter: Should be the phandle to the emac splitter soft IP node if
# 		DWMAC controller is connected emac splitter.
#
# Example:
#
# gmac0: ethernet@ff700000 {
# 	compatible = "altr,socfpga-stmmac", "snps,dwmac-3.70a", "snps,dwmac";
# 	altr,sysmgr-syscon = <&sysmgr 0x60 0>;
# 	status = "disabled";
# 	reg = <0xff700000 0x2000>;
# 	interrupts = <0 115 4>;
# 	interrupt-names = "macirq";
# 	mac-address = [00 00 00 00 00 00];/* Filled in by U-Boot */
# 	clocks = <&emac_0_clk>;
# 	clock-names = "stmmaceth";
# };
```

## Documentation/devicetree/bindings/net/via-rhine.yaml
```yaml
%YAML 1.2
---
version: 1

id: via-rhine

title: VIA Rhine 10/100 Network Controller

maintainer:
    -   name: Alexey Charkov <alchark@gmail.com>

description: >
    TODO

inherits:
    -   id: %ids%

properties:
    -   name: "compatible"
        constraint: |
            "via,vt8500-rhine"

    interrupts:
    reg:

...

# * VIA Rhine 10/100 Network Controller
#
# Required properties:
# - compatible : Should be "via,vt8500-rhine" for integrated
# 	Rhine controllers found in VIA VT8500, WonderMedia WM8950
# 	and similar. These are listed as 1106:3106 rev. 0x84 on the
# 	virtual PCI bus under vendor-provided kernels
# - reg : Address and length of the io space
# - interrupts : Should contain the controller interrupt line
#
# Examples:
#
# ethernet@d8004000 {
# 	compatible = "via,vt8500-rhine";
# 	reg = <0xd8004000 0x100>;
# 	interrupts = <10>;
# };
```

## Documentation/devicetree/bindings/nvmem/allwinner,sunxi-sid.yaml
```yaml
%YAML 1.2
---
version: 1

id: allwinner,sunxi-sid

title: Allwinner sunxi-sid

maintainer:
    -   name: Maxime Ripard <maxime.ripard@free-electrons.com>

description: >
    TODO

inherits:
    -   id: %ids%

properties:
    -   name: "compatible"
        constraint: |
            "allwinner,sun7i-a20-sid"
            "allwinner,sun4i-a10-sid"

    reg:

...

# Allwinner sunxi-sid
#
# Required properties:
# - compatible: "allwinner,sun4i-a10-sid" or "allwinner,sun7i-a20-sid"
# - reg: Should contain registers location and length
#
# = Data cells =
# Are child nodes of qfprom, bindings of which as described in
# bindings/nvmem/nvmem.txt
#
# Example for sun4i:
# 	sid@01c23800 {
# 		compatible = "allwinner,sun4i-a10-sid";
# 		reg = <0x01c23800 0x10>
# 	};
#
# Example for sun7i:
# 	sid@01c23800 {
# 		compatible = "allwinner,sun7i-a20-sid";
# 		reg = <0x01c23800 0x200>
# 	};
```

## Documentation/devicetree/bindings/panel/auo,b101aw03.yaml
```yaml
%YAML 1.2
---
version: 1

id: auo,b101aw03

title: AU Optronics Corporation 10.1" WSVGA TFT LCD panel

maintainer:
    -   name: Thierry Reding <treding@nvidia.com>

description: >
    TODO

inherits:
    -   id: %ids%

properties:
    -   name: "compatible"
        constraint: |
            "auo,b101aw03" && "simple-panel"

    backlight:
    enable-gpios:
    power-supply:

...

# AU Optronics Corporation 10.1" WSVGA TFT LCD panel
#
# Required properties:
# - compatible: should be "auo,b101aw03"
#
# This binding is compatible with the simple-panel binding, which is specified
# in simple-panel.txt in this directory.
```
