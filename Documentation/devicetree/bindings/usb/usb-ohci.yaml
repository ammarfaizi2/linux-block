## Documentation/devicetree/bindings/usb/usb-ohci.yaml
```yaml
%YAML 1.2
---
version: 1

id: usb-ohci

title: USB OHCI controllers

maintainer:
    -   name: Hans de Goede <hdegoede@redhat.com>

description: >
    TODO

inherits:
    -   id: %ids%

properties:
    -   name: "compatible"
        constraint: |
            "ibm,476gtr-ohci" && "generic-ohci"
            "generic-ohci"
            "allwinner,sun9i-a80-ohci" && "generic-ohci"
            "allwinner,sun8i-a23-ohci" && "generic-ohci"
            "allwinner,sun7i-a20-ohci" && "generic-ohci"
            "allwinner,sun6i-a31-ohci" && "generic-ohci"
            "allwinner,sun5i-a13-ohci" && "generic-ohci"
            "allwinner,sun4i-a10-ohci" && "generic-ohci"

    clocks:
    interrupts:
    phy-names:
    phys:
    reg:
    status:

...

# USB OHCI controllers
#
# Required properties:
# - compatible : "generic-ohci"
# - reg : ohci controller register range (address and length)
# - interrupts : ohci controller interrupt
#
# Optional properties:
# - big-endian-regs : boolean, set this for hcds with big-endian registers
# - big-endian-desc : boolean, set this for hcds with big-endian descriptors
# - big-endian : boolean, for hcds with big-endian-regs + big-endian-desc
# - no-big-frame-no : boolean, set if frame_no lives in bits [15:0] of HCCA
# - num-ports : u32, to override the detected port count
# - clocks : a list of phandle + clock specifier pairs
# - phys : phandle + phy specifier pair
# - phy-names : "usb"
# - resets : phandle + reset specifier pair
#
# Example:
#
# 	ohci0: usb@01c14400 {
# 		compatible = "allwinner,sun4i-a10-ohci", "generic-ohci";
# 		reg = <0x01c14400 0x100>;
# 		interrupts = <64>;
# 		clocks = <&usb_clk 6>, <&ahb_gates 2>;
# 		phys = <&usbphy 1>;
# 		phy-names = "usb";
# 	};
```

## Documentation/devicetree/bindings/usb/usb-uhci.yaml
```yaml
%YAML 1.2
---
version: 1

id: usb-uhci

title: Generic Platform UHCI Controller

maintainer:
    -   name: Hans de Goede <hdegoede@redhat.com>

description: >
    TODO

inherits:
    -   id: %ids%

properties:
    -   name: "compatible"
        constraint: |
            "platform-uhci"

    interrupts:
    reg:

...

# Generic Platform UHCI Controller
# -----------------------------------------------------
#
# Required properties:
# - compatible : "generic-uhci" (deprecated: "platform-uhci")
# - reg : Should contain 1 register ranges(address and length)
# - interrupts : UHCI controller interrupt
#
# Example:
#
# 	uhci@d8007b00 {
# 		compatible = "generic-uhci";
# 		reg = <0xd8007b00 0x200>;
# 		interrupts = <43>;
# 	};
```

## Documentation/devicetree/bindings/usb/usb-xhci.yaml
```yaml
%YAML 1.2
---
version: 1

id: usb-xhci

title: USB xHCI controllers

maintainer:
    -   name: Al Cooper <alcooperx@gmail.com>

description: >
    TODO

inherits:
    -   id: %ids%

properties:
    -   name: "compatible"
        constraint: |
            "renesas,xhci-r8a7791"
            "renesas,xhci-r8a7790"
            "marvell,armada-380-xhci"
            "marvell,armada-375-xhci"

    clocks:
    interrupts:
    phy-names:
    phys:
    reg:
    status:

...

# USB xHCI controllers
#
# Required properties:
#   - compatible: should be one of "generic-xhci",
#     "marvell,armada-375-xhci", "marvell,armada-380-xhci",
#     "renesas,xhci-r8a7790", "renesas,xhci-r8a7791" (deprecated:
#     "xhci-platform").
#   - reg: should contain address and length of the standard XHCI
#     register set for the device.
#   - interrupts: one XHCI interrupt should be described here.
#
# Optional properties:
#   - clocks: reference to a clock
#   - usb3-lpm-capable: determines if platform is USB3 LPM capable
#
# Example:
# 	usb@f0931000 {
# 		compatible = "generic-xhci";
# 		reg = <0xf0931000 0x8c8>;
# 		interrupts = <0x0 0x4e 0x0>;
# 	};
```

## Documentation/devicetree/bindings/video/adi,adv7123.yaml
```yaml
%YAML 1.2
---
version: 1

id: adi,adv7123

title: Analog Device ADV7123 Video DAC

maintainer:
    -   name: Laurent Pinchart <laurent.pinchart+renesas@ideasonboard.com>

description: >
    TODO

inherits:
    -   id: %ids%

properties:
    -   name: "compatible"
        constraint: |
            "adi,adv7123"

    "adi,adv7123"::

...

# Analog Device ADV7123 Video DAC
# -------------------------------
#
# The ADV7123 is a digital-to-analog converter that outputs VGA signals from a
# parallel video input.
#
# Required properties:
#
# - compatible: Should be "adi,adv7123"
#
# Optional properties:
#
# - psave-gpios: Power save control GPIO
#
# Required nodes:
#
# The ADV7123 has two video ports. Their connections are modeled using the OF
# graph bindings specified in Documentation/devicetree/bindings/graph.txt.
#
# - Video port 0 for DPI input
# - Video port 1 for VGA output
#
#
# Example
# -------
#
# 	adv7123: encoder@0 {
# 		compatible = "adi,adv7123";
#
# 		ports {
# 			#address-cells = <1>;
# 			#size-cells = <0>;
#
# 			port@0 {
# 				reg = <0>;
#
# 				adv7123_in: endpoint@0 {
# 					remote-endpoint = <&dpi_out>;
# 				};
# 			};
#
# 			port@1 {
# 				reg = <1>;
#
# 				adv7123_out: endpoint@0 {
# 					remote-endpoint = <&vga_connector_in>;
# 				};
# 			};
# 		};
# 	};
```

## Documentation/devicetree/bindings/video/analog-tv-connector.yaml
```yaml
%YAML 1.2
---
version: 1

id: analog-tv-connector

title: Analog TV Connector

maintainer:
    -   name: Tomi Valkeinen <tomi.valkeinen@ti.com>

description: >
    TODO

inherits:
    -   id: %ids%

properties:
    -   name: "compatible"
        constraint: |
            "svideo-connector"
            "composite-video-connector"

    label:

...

# Analog TV Connector
# ===================
#
# Required properties:
# - compatible: "composite-video-connector" or "svideo-connector"
#
# Optional properties:
# - label: a symbolic name for the connector
#
# Required nodes:
# - Video port for TV input
#
# Example
# -------
#
# tv: connector {
# 	compatible = "composite-video-connector";
# 	label = "tv";
#
# 	port {
# 		tv_connector_in: endpoint {
# 			remote-endpoint = <&venc_out>;
# 		};
# 	};
# };
```

## Documentation/devicetree/bindings/video/backlight/gpio-backlight.yaml
```yaml
%YAML 1.2
---
version: 1

id: gpio-backlight

title: gpio-backlight bindings

maintainer:
    -   name: Denis Carikli <denis@eukrea.com>

description: >
    TODO

inherits:
    -   id: %ids%

properties:
    -   name: "compatible"
        constraint: |
            "gpio-backlight"

    default-on:
    gpios:
    pinctrl-0:
    pinctrl-names:

...

# gpio-backlight bindings
#
# Required properties:
#   - compatible: "gpio-backlight"
#   - gpios: describes the gpio that is used for enabling/disabling the backlight.
#     refer to bindings/gpio/gpio.txt for more details.
#
# Optional properties:
#   - default-on: enable the backlight at boot.
#
# Example:
# 	backlight {
# 		compatible = "gpio-backlight";
# 		gpios = <&gpio3 4 GPIO_ACTIVE_HIGH>;
# 		default-on;
# 	};
```

## Documentation/devicetree/bindings/video/exynos_hdmiddc.yaml
```yaml
%YAML 1.2
---
version: 1

id: exynos_hdmiddc

title: Device-Tree bindings for hdmiddc driver

maintainer:
    -   name: Rahul Sharma <rahul.sharma@samsung.com>

description: >
    TODO

inherits:
    -   id: %ids%

properties:
    -   name: "compatible"
        constraint: |
            "samsung,exynos4210-hdmiddc"

    reg:

...

# Device-Tree bindings for hdmiddc driver
#
# Required properties:
# - compatible: value should be one of the following
# 	1) "samsung,exynos5-hdmiddc" <DEPRECATED>
# 	2) "samsung,exynos4210-hdmiddc"
#
# - reg: I2C address of the hdmiddc device.
#
# Example:
#
# 	hdmiddc {
# 		compatible = "samsung,exynos4210-hdmiddc";
# 		reg = <0x50>;
# 	};
```

## Documentation/devicetree/bindings/video/exynos_hdmiphy.yaml
```yaml
%YAML 1.2
---
version: 1

id: exynos_hdmiphy

title: Device-Tree bindings for hdmiphy driver

maintainer:
    -   name: Rahul Sharma <rahul.sharma@samsung.com>

description: >
    TODO

inherits:
    -   id: %ids%

properties:
    -   name: "compatible"
        constraint: |
            "samsung,exynos4212-hdmiphy"

    reg:

...

# Device-Tree bindings for hdmiphy driver
#
# Required properties:
# - compatible: value should be one of the following:
# 	1) "samsung,exynos5-hdmiphy" <DEPRECATED>
# 	2) "samsung,exynos4210-hdmiphy".
# 	3) "samsung,exynos4212-hdmiphy".
# - reg: I2C address of the hdmiphy device.
#
# Example:
#
# 	hdmiphy {
# 		compatible = "samsung,exynos4210-hdmiphy";
# 		reg = <0x38>;
# 	};
```

## Documentation/devicetree/bindings/video/hdmi-connector.yaml
```yaml
%YAML 1.2
---
version: 1

id: hdmi-connector

title: HDMI Connector

maintainer:
    -   name: Tomi Valkeinen <tomi.valkeinen@ti.com>

description: >
    TODO

inherits:
    -   id: %ids%

properties:
    -   name: "compatible"
        constraint: |
            "hdmi-connector"

    hpd-gpios:
    label:
    pinctrl-0:
    pinctrl-names:
    type:

...

# HDMI Connector
# ==============
#
# Required properties:
# - compatible: "hdmi-connector"
# - type: the HDMI connector type: "a", "b", "c", "d" or "e"
#
# Optional properties:
# - label: a symbolic name for the connector
# - hpd-gpios: HPD GPIO number
#
# Required nodes:
# - Video port for HDMI input
#
# Example
# -------
#
# hdmi0: connector@1 {
# 	compatible = "hdmi-connector";
# 	label = "hdmi";
#
# 	type = "a";
#
# 	port {
# 		hdmi_connector_in: endpoint {
# 			remote-endpoint = <&tpd12s015_out>;
# 		};
# 	};
# };
```

## Documentation/devicetree/bindings/video/lgphilips,lb035q02.yaml
```yaml
%YAML 1.2
---
version: 1

id: lgphilips,lb035q02

title: LG.Philips LB035Q02 Panel

maintainer:
    -   name: Tomi Valkeinen <tomi.valkeinen@ti.com>

description: >
    TODO

inherits:
    -   id: %ids%

properties:
    -   name: "compatible"
        constraint: |
            "lgphilips,lb035q02"

    enable-gpios:
    label:
    pinctrl-0:
    pinctrl-names:
    reg:
    spi-cpha:
    spi-cpol:
    spi-max-frequency:

...

# LG.Philips LB035Q02 Panel
# =========================
#
# Required properties:
# - compatible: "lgphilips,lb035q02"
# - enable-gpios: panel enable gpio
#
# Optional properties:
# - label: a symbolic name for the panel
#
# Required nodes:
# - Video port for DPI input
#
# Example
# -------
#
# lcd-panel: panel@0 {
# 	compatible = "lgphilips,lb035q02";
# 	reg = <0>;
# 	spi-max-frequency = <100000>;
# 	spi-cpol;
# 	spi-cpha;
#
# 	label = "lcd";
#
# 	enable-gpios = <&gpio7 7 0>;
#
# 	port {
# 		lcd_in: endpoint {
# 			remote-endpoint = <&dpi_out>;
# 		};
# 	};
# };
```

## Documentation/devicetree/bindings/video/panel-dpi.yaml
```yaml
%YAML 1.2
---
version: 1

id: panel-dpi

title: Generic MIPI DPI Panel

maintainer:
    -   name: Tomi Valkeinen <tomi.valkeinen@ti.com>

description: >
    TODO

inherits:
    -   id: %ids%

properties:
    -   name: "compatible"
        constraint: |
            "startek,startek-kd050c" && "panel-dpi"
            "samsung,lte430wq-f0c" && "panel-dpi"
            "panel-dpi"
            "osddisplays,osd057T0559-34ts" && "panel-dpi"
            "newhaven,nhd-4"."3-480272ef-atxl" && "panel-dpi"
            "mitsubishi,aa104xd12" && "panel-dpi"
            "innolux,at070tn83" && "panel-dpi"

    label:

...

# Generic MIPI DPI Panel
# ======================
#
# Required properties:
# - compatible: "panel-dpi"
#
# Optional properties:
# - label: a symbolic name for the panel
# - enable-gpios: panel enable gpio
#
# Required nodes:
# - "panel-timing" containing video timings
#   (Documentation/devicetree/bindings/video/display-timing.txt)
# - Video port for DPI input
#
# Example
# -------
#
# lcd0: display@0 {
#         compatible = "samsung,lte430wq-f0c", "panel-dpi";
#         label = "lcd";
#
#         port {
#             lcd_in: endpoint {
#                     remote-endpoint = <&dpi_out>;
#             };
#         };
#
#         panel-timing {
#                 clock-frequency = <9200000>;
#                 hactive = <480>;
#                 vactive = <272>;
#                 hfront-porch = <8>;
#                 hback-porch = <4>;
#                 hsync-len = <41>;
#                 vback-porch = <2>;
#                 vfront-porch = <4>;
#                 vsync-len = <10>;
#
#                 hsync-active = <0>;
#                 vsync-active = <0>;
#                 de-active = <1>;
#                 pixelclk-active = <1>;
#         };
# };
```

## Documentation/devicetree/bindings/video/rockchip-drm.yaml
```yaml
%YAML 1.2
---
version: 1

id: rockchip-drm

title: Rockchip DRM master device

maintainer:
    -   name: Mark Yao <mark.yao@rock-chips.com>

description: >
    TODO

inherits:
    -   id: %ids%

properties:
    -   name: "compatible"
        constraint: |
            "rockchip,display-subsystem"

    ports:

...

# Rockchip DRM master device
# ================================
#
# The Rockchip DRM master device is a virtual device needed to list all
# vop devices or other display interface nodes that comprise the
# graphics subsystem.
#
# Required properties:
# - compatible: Should be "rockchip,display-subsystem"
# - ports: Should contain a list of phandles pointing to display interface port
#   of vop devices. vop definitions as defined in
#   Documentation/devicetree/bindings/video/rockchip-vop.txt
#
# example:
#
# display-subsystem {
# 	compatible = "rockchip,display-subsystem";
# 	ports = <&vopl_out>, <&vopb_out>;
# };
```

## Documentation/devicetree/bindings/video/ssd1289fb.yaml
```yaml
%YAML 1.2
---
version: 1

id: ssd1289fb

title: Solomon SSD1289 Framebuffer Driver

maintainer:
    -   name: Xie Xiaobo <X.Xie@freescale.com>

description: >
    TODO

inherits:
    -   id: %ids%

properties:
    -   name: "compatible"
        constraint: |
            "solomon,ssd1289fb"

    reg:

...

# * Solomon SSD1289 Framebuffer Driver
#
# Required properties:
#   - compatible: Should be "solomon,ssd1289fb". The only supported bus for
#     now is lbc.
#   - reg: Should contain address of the controller on the LBC bus. The detail
#     was described in Documentation/devicetree/bindings/powerpc/fsl/lbc.txt
#
# Examples:
# display@2,0 {
# 	compatible = "solomon,ssd1289fb";
# 	reg = <0x2 0x0000 0x0004>;
# };
```

## Documentation/devicetree/bindings/video/toppoly,td028ttec1.yaml
```yaml
%YAML 1.2
---
version: 1

id: toppoly,td028ttec1

title: Toppoly TD028TTEC1 Panel

maintainer:
    -   name: Marek Belisko <marek@goldelico.com>

description: >
    TODO

inherits:
    -   id: %ids%

properties:
    -   name: "compatible"
        constraint: |
            "toppoly,td028ttec1"

    label:
    reg:
    spi-cpha:
    spi-cpol:
    spi-max-frequency:

...

# Toppoly TD028TTEC1 Panel
# ========================
#
# Required properties:
# - compatible: "toppoly,td028ttec1"
#
# Optional properties:
# - label: a symbolic name for the panel
#
# Required nodes:
# - Video port for DPI input
#
# Example
# -------
#
# lcd-panel: td028ttec1@0 {
# 	compatible = "toppoly,td028ttec1";
# 	reg = <0>;
# 	spi-max-frequency = <100000>;
# 	spi-cpol;
# 	spi-cpha;
#
# 	label = "lcd";
# 	port {
# 		lcd_in: endpoint {
# 			remote-endpoint = <&dpi_out>;
# 		};
# 	};
# };
#
```

## Documentation/devicetree/bindings/video/wm,prizm-ge-rops.yaml
```yaml
%YAML 1.2
---
version: 1

id: wm,prizm-ge-rops

title: VIA/Wondermedia Graphics Engine Controller

maintainer:
    -   name: Tony Prisk <linux@prisktech.co.nz>

description: >
    TODO

inherits:
    -   id: %ids%

properties:
    -   name: "compatible"
        constraint: |
            "wm,prizm-ge-rops"

    reg:

...

# VIA/Wondermedia Graphics Engine Controller
# -----------------------------------------------------
#
# Required properties:
# - compatible : "wm,prizm-ge-rops"
# - reg : Should contain 1 register ranges(address and length)
#
# Example:
#
# 	ge_rops@d8050400 {
# 		compatible = "wm,prizm-ge-rops";
# 		reg = <0xd8050400 0x100>;
# 	};
```
