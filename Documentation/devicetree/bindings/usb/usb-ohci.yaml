## Documentation/devicetree/bindings/w1/fsl-imx-owire.yaml
```yaml
%YAML 1.2
---
version: 1

id: fsl-imx-owire

title: Freescale i.MX One wire bus master controller

maintainer:
    -   name: Martin Fuzzey <mfuzzey@parkeon.com>

description: >
    TODO

inherits:
    -   id: %ids%

properties:
    -   name: "compatible"
        constraint: |
            "fsl,imx53-owire" && "fsl,imx21-owire"
            "fsl,imx51-owire" && "fsl,imx21-owire"
            "fsl,imx50-owire" && "fsl,imx21-owire"
            "fsl,imx27-owire" && "fsl,imx21-owire"

    clocks:
    pinctrl-0:
    pinctrl-names:
    reg:
    status:

...

# * Freescale i.MX One wire bus master controller
#
# Required properties:
# - compatible : should be "fsl,imx21-owire"
# - reg : Address and length of the register set for the device
#
# Optional properties:
# - clocks : phandle of clock that supplies the module (required if platform
# 		clock bindings use device tree)
#
# Example:
#
# - From imx53.dtsi:
# owire: owire@63fa4000 {
# 	compatible = "fsl,imx53-owire", "fsl,imx21-owire";
# 	reg = <0x63fa4000 0x4000>;
# 	clocks = <&clks 159>;
# 	status = "disabled";
# };
```

## Documentation/devicetree/bindings/watchdog/atmel-at91rm9200-wdt.yaml
```yaml
%YAML 1.2
---
version: 1

id: atmel-at91rm9200-wdt

title: Atmel AT91RM9200 System Timer Watchdog

maintainer:
    -   name: Joachim Eastwood <manabian@gmail.com>

description: >
    TODO

inherits:
    -   id: %ids%

properties:
    -   name: "compatible"
        constraint: |
            "atmel,at91rm9200-wdt"

    "atmel,at91rm9200-wdt"::

...

# Atmel AT91RM9200 System Timer Watchdog
#
# Required properties:
# - compatible: must be "atmel,at91sam9260-wdt".
#
# Example:
# 	watchdog@fffffd00 {
# 		compatible = "atmel,at91rm9200-wdt";
# 	};
```

## Documentation/devicetree/bindings/watchdog/brcm,bcm2835-pm-wdog.yaml
```yaml
%YAML 1.2
---
version: 1

id: brcm,bcm2835-pm-wdog

title: BCM2835 Watchdog timer

maintainer:
    -   name: Lubomir Rintel <lkundrak@v3.sk>

description: >
    TODO

inherits:
    -   id: %ids%

properties:
    -   name: "compatible"
        constraint: |
            "brcm,bcm2835-pm-wdt"

    reg:

...

# BCM2835 Watchdog timer
#
# Required properties:
#
# - compatible : should be "brcm,bcm2835-pm-wdt"
# - reg : Specifies base physical address and size of the registers.
#
# Optional properties:
#
# - timeout-sec   : Contains the watchdog timeout in seconds
#
# Example:
#
# watchdog {
# 	compatible = "brcm,bcm2835-pm-wdt";
# 	reg = <0x7e100000 0x28>;
# 	timeout-sec = <10>;
# };
```

## Documentation/devicetree/bindings/watchdog/brcm,kona-wdt.yaml
```yaml
%YAML 1.2
---
version: 1

id: brcm,kona-wdt

title: Broadcom Kona Family Watchdog Timer

maintainer:
    -   name: Scott Branden <sbranden@broadcom.com>

description: >
    TODO

inherits:
    -   id: %ids%

properties:
    -   name: "compatible"
        constraint: |
            "brcm,bcm11351-wdt" && "brcm,kona-wdt"

    reg:

...

# Broadcom Kona Family Watchdog Timer
# -----------------------------------
#
# This watchdog timer is used in the following Broadcom SoCs:
#   BCM11130, BCM11140, BCM11351, BCM28145, BCM28155
#
# Required properties:
#   - compatible = "brcm,bcm11351-wdt", "brcm,kona-wdt";
#   - reg: memory address & range
#
# Example:
# 	watchdog@35002f40 {
# 		compatible = "brcm,bcm11351-wdt", "brcm,kona-wdt";
# 		reg = <0x35002f40 0x6c>;
# 	};
```

## Documentation/devicetree/bindings/watchdog/digicolor-wdt.yaml
```yaml
%YAML 1.2
---
version: 1

id: digicolor-wdt

title: Conexant Digicolor SoCs Watchdog timer

maintainer:
    -   name: Baruch Siach <baruch@tkos.co.il>

description: >
    TODO

inherits:
    -   id: %ids%

properties:
    -   name: "compatible"
        constraint: |
            "cnxt,cx92755-wdt"

    clocks:
    reg:
    timeout-sec:

...

# Conexant Digicolor SoCs Watchdog timer
#
# The watchdog functionality in Conexant Digicolor SoCs relies on the so called
# "Agent Communication" block. This block includes the eight programmable system
# timer counters. The first timer (called "Timer A") is the only one that can be
# used as watchdog.
#
# Required properties:
#
# - compatible : Should be "cnxt,cx92755-wdt"
# - reg : Specifies base physical address and size of the registers
# - clocks : phandle; specifies the clock that drives the timer
#
# Optional properties:
#
# - timeout-sec : Contains the watchdog timeout in seconds
#
# Example:
#
# 	watchdog@f0000fc0 {
# 		compatible = "cnxt,cx92755-wdt";
# 		reg = <0xf0000fc0 0x8>;
# 		clocks = <&main_clk>;
# 		timeout-sec = <15>;
# 	};
```

## Documentation/devicetree/bindings/watchdog/fsl-imx-wdt.yaml
```yaml
%YAML 1.2
---
version: 1

id: fsl-imx-wdt

title: Freescale i.MX Watchdog Timer (WDT) Controller

maintainer:
    -   name: Xiubo Li <Li.Xiubo@freescale.com>

description: >
    TODO

inherits:
    -   id: %ids%

properties:
    -   name: "compatible"
        constraint: |
            "fsl,vf610-wdt" && "fsl,imx21-wdt"
            "fsl,mpc8610-wdt"
            "fsl,mpc5121-wdt"
            "fsl,imx7d-wdt" && "fsl,imx21-wdt"
            "fsl,imx6ul-wdt" && "fsl,imx21-wdt"
            "fsl,imx6sx-wdt" && "fsl,imx21-wdt"
            "fsl,imx6sl-wdt" && "fsl,imx21-wdt"
            "fsl,imx6q-wdt" && "fsl,imx21-wdt"
            "fsl,imx53-wdt" && "fsl,imx21-wdt"
            "fsl,imx51-wdt" && "fsl,imx21-wdt"
            "fsl,imx50-wdt" && "fsl,imx21-wdt"
            "fsl,imx35-wdt" && "fsl,imx21-wdt"
            "fsl,imx27-wdt" && "fsl,imx21-wdt"
            "fsl,imx25-wdt" && "fsl,imx21-wdt"
            "fsl,imx21-wdt"

    big-endian:
    clock-names:
    clocks:
    interrupts:
    reg:

...

# * Freescale i.MX Watchdog Timer (WDT) Controller
#
# Required properties:
# - compatible : Should be "fsl,<soc>-wdt"
# - reg : Should contain WDT registers location and length
# - interrupts : Should contain WDT interrupt
#
# Optional property:
# - big-endian: If present the watchdog device's registers are implemented
#   in big endian mode, otherwise in native mode(same with CPU), for more
#   detail please see: Documentation/devicetree/bindings/regmap/regmap.txt.
#
# Examples:
#
# wdt@73f98000 {
# 	compatible = "fsl,imx51-wdt", "fsl,imx21-wdt";
# 	reg = <0x73f98000 0x4000>;
# 	interrupts = <58>;
# 	big-endian;
# };
```

## Documentation/devicetree/bindings/watchdog/mtk-wdt.yaml
```yaml
%YAML 1.2
---
version: 1

id: mtk-wdt

title: Mediatek SoCs Watchdog timer

maintainer:
    -   name: Matthias Brugger <matthias.bgg@gmail.com>

description: >
    TODO

inherits:
    -   id: %ids%

properties:
    -   name: "compatible"
        constraint: |
            "mediatek,mt6589-wdt"

    reg:

...

# Mediatek SoCs Watchdog timer
#
# Required properties:
#
# - compatible : should be "mediatek,mt6589-wdt"
# - reg : Specifies base physical address and size of the registers.
#
# Example:
#
# wdt: watchdog@010000000 {
# 	compatible = "mediatek,mt6589-wdt";
# 	reg = <0x10000000 0x18>;
# };
```

## Documentation/devicetree/bindings/watchdog/omap-wdt.yaml
```yaml
%YAML 1.2
---
version: 1

id: omap-wdt

title: TI Watchdog Timer (WDT) Controller for OMAP

maintainer:
    -   name: Uwe Kleine-König <u.kleine-koenig@pengutronix.de>

description: >
    TODO

inherits:
    -   id: %ids%

properties:
    -   name: "compatible"
        constraint: |
            "ti,omap5-wdt" && "ti,omap3-wdt"
            "ti,omap4-wdt" && "ti,omap3-wdt"
            "ti,omap3-wdt"
            "ti,am4372-wdt" && "ti,omap3-wdt"

    interrupts:
    reg:
    status:
    ti,hwmods:

...

# TI Watchdog Timer (WDT) Controller for OMAP
#
# Required properties:
# - compatible : "ti,omap3-wdt" for OMAP3 or "ti,omap4-wdt" for OMAP4
# - ti,hwmods : Name of the hwmod associated to the WDT
#
# Optional properties:
# - timeout-sec : default watchdog timeout in seconds
#
# Examples:
#
# wdt2: wdt@4a314000 {
# 	compatible = "ti,omap4-wdt", "ti,omap3-wdt";
# 	ti,hwmods = "wd_timer2";
# };
```

## Documentation/devicetree/bindings/watchdog/pnx4008-wdt.yaml
```yaml
%YAML 1.2
---
version: 1

id: pnx4008-wdt

title: NXP PNX watchdog timer

maintainer:
    -   name: Fabio Porcedda <fabio.porcedda@gmail.com>

description: >
    TODO

inherits:
    -   id: %ids%

properties:
    -   name: "compatible"
        constraint: |
            "nxp,pnx4008-wdt"

    reg:

...

# * NXP PNX watchdog timer
#
# Required properties:
# - compatible: must be "nxp,pnx4008-wdt"
# - reg: physical base address of the controller and length of memory mapped
#   region.
#
# Optional properties:
# - timeout-sec: contains the watchdog timeout in seconds.
#
# Example:
#
# 	watchdog@4003C000 {
# 		compatible = "nxp,pnx4008-wdt";
# 		reg = <0x4003C000 0x1000>;
# 		timeout-sec = <10>;
# 	};
```

## Documentation/devicetree/bindings/watchdog/sirfsoc_wdt.yaml
```yaml
%YAML 1.2
---
version: 1

id: sirfsoc_wdt

title: SiRFSoC Timer and Watchdog Timer(WDT) Controller

maintainer:
    -   name: Xianglong Du <Xianglong.Du@csr.com>

description: >
    TODO

inherits:
    -   id: %ids%

properties:
    -   name: "compatible"
        constraint: |
            "sirf,prima2-tick"

    clocks:
    interrupts:
    reg:

...

# SiRFSoC Timer and Watchdog Timer(WDT) Controller
#
# Required properties:
# - compatible: "sirf,prima2-tick"
# - reg: Address range of tick timer/WDT register set
# - interrupts: interrupt number to the cpu
#
# Example:
#
# timer@b0020000 {
# 	compatible = "sirf,prima2-tick";
# 	reg = <0xb0020000 0x1000>;
# 	interrupts = <0>;
# };
```
