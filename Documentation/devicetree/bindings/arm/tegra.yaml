## Documentation/devicetree/bindings/ata/fsl-sata.yaml
```yaml
%YAML 1.2
---
version: 1

id: fsl-sata

title: Freescale 8xxx/3.0 Gb/s SATA nodes

maintainer:
    -   name: 

description: >
    TODO

inherits:
    -   id: %ids%

properties:
    -   name: "compatible"
        constraint: |
            "fsl,mpc8379-sata" && "fsl,pq-sata"
            "fsl,mpc8377-sata" && "fsl,pq-sata"
            "fsl,mpc8315-sata" && "fsl,pq-sata"

    cell-index:
    interrupt-parent:
    interrupts:
    reg:

...

# * Freescale 8xxx/3.0 Gb/s SATA nodes
#
# SATA nodes are defined to describe on-chip Serial ATA controllers.
# Each SATA port should have its own node.
#
# Required properties:
# - compatible        : compatible list, contains 2 entries, first is
# 		 "fsl,CHIP-sata", where CHIP is the processor
# 		 (mpc8315, mpc8379, etc.) and the second is
# 		 "fsl,pq-sata"
# - interrupts        : <interrupt mapping for SATA IRQ>
# - cell-index        : controller index.
#                           1 for controller @ 0x18000
#                           2 for controller @ 0x19000
#                           3 for controller @ 0x1a000
#                           4 for controller @ 0x1b000
#
# Optional properties:
# - interrupt-parent  : optional, if needed for interrupt mapping
# - reg               : <registers mapping>
#
# Example:
# 	sata@18000 {
# 		compatible = "fsl,mpc8379-sata", "fsl,pq-sata";
# 		reg = <0x18000 0x1000>;
# 		cell-index = <1>;
# 		interrupts = <2c 8>;
# 		interrupt-parent = < &ipic >;
# 	};
```

## Documentation/devicetree/bindings/ata/imx-pata.yaml
```yaml
%YAML 1.2
---
version: 1

id: imx-pata

title: Freescale i.MX PATA Controller

maintainer:
    -   name: Sascha Hauer <s.hauer@pengutronix.de>

description: >
    TODO

inherits:
    -   id: %ids%

properties:
    -   name: "compatible"
        constraint: |
            "fsl,imx51-pata" && "fsl,imx27-pata"

    clocks:
    interrupts:
    reg:
    status:

...

# * Freescale i.MX PATA Controller
#
# Required properties:
# - compatible: "fsl,imx27-pata"
# - reg: Address range of the PATA Controller
# - interrupts: The interrupt of the PATA Controller
# - clocks: the clocks for the PATA Controller
#
# Example:
#
# 	pata: pata@83fe0000 {
# 		compatible = "fsl,imx51-pata", "fsl,imx27-pata";
# 		reg = <0x83fe0000 0x4000>;
# 		interrupts = <70>;
# 		clocks = <&clks 161>;
# 		status = "disabled";
# 	};
```

## Documentation/devicetree/bindings/bus/omap-ocp2scp.yaml
```yaml
%YAML 1.2
---
version: 1

id: omap-ocp2scp

title: OMAP OCP2SCP - ocp interface to scp interface

maintainer:
    -   name: Kishon Vijay Abraham I <kishon@ti.com>

description: >
    TODO

inherits:
    -   id: %ids%

properties:
    -   name: "compatible"
        constraint: |
            "ti,omap-ocp2scp"
            "ti,am437x-ocp2scp" && "ti,omap-ocp2scp"

    #address-cells:
    ranges:
    #size-cells:
    ti,hwmods:

...

# * OMAP OCP2SCP - ocp interface to scp interface
#
# properties:
# - compatible : Should be "ti,am437x-ocp2scp" for AM437x processor
# 	       Should be "ti,omap-ocp2scp" for all others
# - reg : Address and length of the register set for the device
# - #address-cells, #size-cells : Must be present if the device has sub-nodes
# - ranges : the child address space are mapped 1:1 onto the parent address space
# - ti,hwmods : must be "ocp2scp_usb_phy"
#
# Sub-nodes:
# All the devices connected to ocp2scp are described using sub-node to ocp2scp
#
# ocp2scp@4a0ad000 {
# 	compatible = "ti,omap-ocp2scp";
# 	reg = <0x4a0ad000 0x1f>;
# 	#address-cells = <1>;
# 	#size-cells = <1>;
# 	ranges;
# 	ti,hwmods = "ocp2scp_usb_phy";
#
# 	subnode1 {
# 	...
# 	};
#
# 	subnode2 {
# 	...
# 	};
# };
```

## Documentation/devicetree/bindings/clock/efm32-clock.yaml
```yaml
%YAML 1.2
---
version: 1

id: efm32-clock

title: Clock bindings for Energy Micro efm32 Giant Gecko's Clock Management Unit

maintainer:
    -   name: Uwe Kleine-König <u.kleine-koenig@pengutronix.de>

description: >
    TODO

inherits:
    -   id: %ids%

properties:
    -   name: "compatible"
        constraint: |
            "efm32gg,cmu"

    #clock-cells:
    interrupts:
    reg:

...

# * Clock bindings for Energy Micro efm32 Giant Gecko's Clock Management Unit
#
# Required properties:
# - compatible: Should be "efm32gg,cmu"
# - reg: Base address and length of the register set
# - interrupts: Interrupt used by the CMU
# - #clock-cells: Should be <1>
#
# The clock consumer should specify the desired clock by having the clock ID in
# its "clocks" phandle cell. The header efm32-clk.h contains a list of available
# IDs.
```

## Documentation/devicetree/bindings/clock/exynos5440-clock.yaml
```yaml
%YAML 1.2
---
version: 1

id: exynos5440-clock

title: Samsung Exynos5440 Clock Controller

maintainer:
    -   name: Andrzej Hajda <a.hajda@samsung.com>

description: >
    TODO

inherits:
    -   id: %ids%

properties:
    -   name: "compatible"
        constraint: |
            "samsung,exynos5440-clock"

    #clock-cells:
    reg:

...

# * Samsung Exynos5440 Clock Controller
#
# The Exynos5440 clock controller generates and supplies clock to various
# controllers within the Exynos5440 SoC.
#
# Required Properties:
#
# - compatible: should be "samsung,exynos5440-clock".
#
# - reg: physical base address of the controller and length of memory mapped
#   region.
#
# - #clock-cells: should be 1.
#
# Each clock is assigned an identifier and client nodes can use this identifier
# to specify the clock which they consume.
#
# All available clocks are defined as preprocessor macros in
# dt-bindings/clock/exynos5440.h header and can be used in device
# tree sources.
#
# Example: An example of a clock controller node is listed below.
#
# 	clock: clock-controller@0x10010000 {
# 		compatible = "samsung,exynos5440-clock";
# 		reg = <0x160000 0x10000>;
# 		#clock-cells = <1>;
# 	};
```

## Documentation/devicetree/bindings/clock/fixed-clock.yaml
```yaml
%YAML 1.2
---
version: 1

id: fixed-clock

title: Binding for simple fixed-rate clock sources.

maintainer:
    -   name: Boris BREZILLON <b.brezillon@overkiz.com>

description: >
    TODO

inherits:
    -   id: %ids%

properties:
    -   name: "compatible"
        constraint: |
            "samsung,clock-xxti" && "fixed-clock"
            "samsung,clock-xusbxti" && "fixed-clock"
            "fsl,imx-osc" && "fixed-clock"
            "fsl,imx-osc26m" && "fixed-clock"
            "fsl,imx-clk32" && "fixed-clock"
            "fsl,imx-ckil" && "fixed-clock"
            "fsl,imx-ckih2" && "fixed-clock"
            "fsl,imx-ckih1" && "fixed-clock"
            "fixed-clock"
            "atmel,osc" && "fixed-clock"

    clock-frequency:

...

# Binding for simple fixed-rate clock sources.
#
# This binding uses the common clock binding[1].
#
# [1] Documentation/devicetree/bindings/clock/clock-bindings.txt
#
# Required properties:
# - compatible : shall be "fixed-clock".
# - #clock-cells : from common clock binding; shall be set to 0.
# - clock-frequency : frequency of clock in Hz. Should be a single cell.
#
# Optional properties:
# - clock-accuracy : accuracy of clock in ppb (parts per billion).
# 		   Should be a single cell.
# - clock-output-names : From common clock binding.
#
# Example:
# 	clock {
# 		compatible = "fixed-clock";
# 		#clock-cells = <0>;
# 		clock-frequency = <1000000000>;
# 		clock-accuracy = <100>;
# 	};
```

## Documentation/devicetree/bindings/clock/imx5-clock.yaml
```yaml
%YAML 1.2
---
version: 1

id: imx5-clock

title: Clock bindings for Freescale i.MX5

maintainer:
    -   name: Philipp Zabel <p.zabel@pengutronix.de>

description: >
    TODO

inherits:
    -   id: %ids%

properties:
    -   name: "compatible"
        constraint: |
            "fsl,imx53-ccm"
            "fsl,imx51-ccm"
            "fsl,imx50-ccm"
            "fsl,imx35-ccm"
            "fsl,imx31-ccm"
            "fsl,imx27-ccm"
            "fsl,imx25-ccm"
            "fsl,imx1-ccm"

    #clock-cells:
    reg:

...

# * Clock bindings for Freescale i.MX5
#
# Required properties:
# - compatible: Should be "fsl,<soc>-ccm" , where <soc> can be imx51 or imx53
# - reg: Address and length of the register set
# - interrupts: Should contain CCM interrupt
# - #clock-cells: Should be <1>
#
# The clock consumer should specify the desired clock by having the clock
# ID in its "clocks" phandle cell. See include/dt-bindings/clock/imx5-clock.h
# for the full list of i.MX5 clock IDs.
#
# Examples (for mx53):
#
# clks: ccm@53fd4000{
# 	compatible = "fsl,imx53-ccm";
# 	reg = <0x53fd4000 0x4000>;
# 	interrupts = <0 71 0x04 0 72 0x04>;
# 	#clock-cells = <1>;
# };
#
# can1: can@53fc8000 {
# 	compatible = "fsl,imx53-flexcan", "fsl,p1010-flexcan";
# 	reg = <0x53fc8000 0x4000>;
# 	interrupts = <82>;
# 	clocks = <&clks IMX5_CLK_CAN1_IPG_GATE>, <&clks IMX5_CLK_CAN1_SERIAL_GATE>;
# 	clock-names = "ipg", "per";
# 	status = "disabled";
# };
```

## Documentation/devicetree/bindings/clock/imx6sl-clock.yaml
```yaml
%YAML 1.2
---
version: 1

id: imx6sl-clock

title: Clock bindings for Freescale i.MX6 SoloLite

maintainer:
    -   name: Shawn Guo <shawn.guo@linaro.org>

description: >
    TODO

inherits:
    -   id: %ids%

properties:
    -   name: "compatible"
        constraint: |
            "fsl,imx6sl-ccm"

    #clock-cells:
    interrupts:
    reg:

...

# * Clock bindings for Freescale i.MX6 SoloLite
#
# Required properties:
# - compatible: Should be "fsl,imx6sl-ccm"
# - reg: Address and length of the register set
# - #clock-cells: Should be <1>
#
# The clock consumer should specify the desired clock by having the clock
# ID in its "clocks" phandle cell.  See include/dt-bindings/clock/imx6sl-clock.h
# for the full list of i.MX6 SoloLite clock IDs.
```

## Documentation/devicetree/bindings/clock/imx6ul-clock.yaml
```yaml
%YAML 1.2
---
version: 1

id: imx6ul-clock

title: Clock bindings for Freescale i.MX6 UltraLite

maintainer:
    -   name: Frank Li <Frank.Li@freescale.com>

description: >
    TODO

inherits:
    -   id: %ids%

properties:
    -   name: "compatible"
        constraint: |
            "fsl,imx6ul-ccm"

    #clock-cells:
    clock-names:
    clocks:
    interrupts:
    reg:

...

# * Clock bindings for Freescale i.MX6 UltraLite
#
# Required properties:
# - compatible: Should be "fsl,imx6ul-ccm"
# - reg: Address and length of the register set
# - #clock-cells: Should be <1>
# - clocks: list of clock specifiers, must contain an entry for each required
#   entry in clock-names
# - clock-names: should include entries "ckil", "osc", "ipp_di0" and "ipp_di1"
#
# The clock consumer should specify the desired clock by having the clock
# ID in its "clocks" phandle cell.  See include/dt-bindings/clock/imx6ul-clock.h
# for the full list of i.MX6 UltraLite clock IDs.
```

## Documentation/devicetree/bindings/clock/marvell,mmp2.yaml
```yaml
%YAML 1.2
---
version: 1

id: marvell,mmp2

title: Marvell MMP2 Clock Controller

maintainer:
    -   name: Chao Xie <chao.xie@marvell.com>

description: >
    TODO

inherits:
    -   id: %ids%

properties:
    -   name: "compatible"
        constraint: |
            "marvell,mmp2-clock"

    #clock-cells:
    reg:
    reg-names:
    #reset-cells:

...

# * Marvell MMP2 Clock Controller
#
# The MMP2 clock subsystem generates and supplies clock to various
# controllers within the MMP2 SoC.
#
# Required Properties:
#
# - compatible: should be one of the following.
#   - "marvell,mmp2-clock" - controller compatible with MMP2 SoC.
#
# - reg: physical base address of the clock subsystem and length of memory mapped
#   region. There are 3 places in SOC has clock control logic:
#   "mpmu", "apmu", "apbc". So three reg spaces need to be defined.
#
# - #clock-cells: should be 1.
# - #reset-cells: should be 1.
#
# Each clock is assigned an identifier and client nodes use this identifier
# to specify the clock which they consume.
#
# All these identifier could be found in <dt-bindings/clock/marvell-mmp2.h>.
```

## Documentation/devicetree/bindings/clock/marvell,pxa168.yaml
```yaml
%YAML 1.2
---
version: 1

id: marvell,pxa168

title: Marvell PXA168 Clock Controller

maintainer:
    -   name: Chao Xie <chao.xie@marvell.com>

description: >
    TODO

inherits:
    -   id: %ids%

properties:
    -   name: "compatible"
        constraint: |
            "marvell,pxa168-clock"

    #clock-cells:
    reg:
    reg-names:
    #reset-cells:

...

# * Marvell PXA168 Clock Controller
#
# The PXA168 clock subsystem generates and supplies clock to various
# controllers within the PXA168 SoC.
#
# Required Properties:
#
# - compatible: should be one of the following.
#   - "marvell,pxa168-clock" - controller compatible with PXA168 SoC.
#
# - reg: physical base address of the clock subsystem and length of memory mapped
#   region. There are 3 places in SOC has clock control logic:
#   "mpmu", "apmu", "apbc". So three reg spaces need to be defined.
#
# - #clock-cells: should be 1.
# - #reset-cells: should be 1.
#
# Each clock is assigned an identifier and client nodes use this identifier
# to specify the clock which they consume.
#
# All these identifier could be found in <dt-bindings/clock/marvell,pxa168.h>.
```
