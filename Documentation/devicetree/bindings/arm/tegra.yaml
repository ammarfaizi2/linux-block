## Documentation/devicetree/bindings/arm/tegra.yaml
```yaml
%YAML 1.2
---
version: 1

id: tegra

title: NVIDIA Tegra device tree bindings

maintainer:
    -   name: Bryan Wu <pengw@nvidia.com>

description: >
    TODO

inherits:
    -   id: %ids%

properties:
    -   name: "compatible"
        constraint: |
            "toradex,iris" && "toradex,colibri"_"t20-512" && "nvidia,tegra20"
            "toradex,colibri"_"t30" && "nvidia,tegra30"
            "toradex,colibri"_"t30-eval-v3" && "toradex,colibri"_"t30" && "nvidia,tegra30"
            "toradex,colibri"_"t20-512" && "nvidia,tegra20"
            "toradex,apalis"_"t30" && "nvidia,tegra30"
            "toradex,apalis"_"t30-eval" && "toradex,apalis"_"t30" && "nvidia,tegra30"
            "nvidia,whistler" && "nvidia,tegra20"
            "nvidia,ventana" && "nvidia,tegra20"
            "nvidia,tegra30"
            "nvidia,tegra20"
            "nvidia,seaboard" && "nvidia,tegra20"
            "nvidia,harmony" && "nvidia,tegra20"
            "nvidia,cardhu" && "nvidia,tegra30"
            "nvidia,cardhu-a04" && "nvidia,cardhu" && "nvidia,tegra30"
            "nvidia,cardhu-a02" && "nvidia,cardhu" && "nvidia,tegra30"
            "nvidia,beaver" && "nvidia,tegra30"
            "compulab,trimslice" && "nvidia,tegra20"
            "compal,paz00" && "nvidia,tegra20"
            "ad,tec" && "ad,tamonten" && "nvidia,tegra20"
            "ad,tamonten" && "nvidia,tegra20"
            "ad,plutux" && "ad,tamonten" && "nvidia,tegra20"
            "ad,medcom-wide" && "ad,tamonten" && "nvidia,tegra20"

    #address-cells:
    interrupt-parent:
    model:
    #size-cells:

...

# NVIDIA Tegra device tree bindings
# -------------------------------------------
#
# SoCs
# -------------------------------------------
#
# Each device tree must specify which Tegra SoC it uses, using one of the
# following compatible values:
#
#   nvidia,tegra20
#   nvidia,tegra30
#
# Boards
# -------------------------------------------
#
# Each device tree must specify which one or more of the following
# board-specific compatible values:
#
#   ad,medcom-wide
#   ad,plutux
#   ad,tamonten
#   ad,tec
#   compal,paz00
#   compulab,trimslice
#   nvidia,beaver
#   nvidia,cardhu
#   nvidia,cardhu-a02
#   nvidia,cardhu-a04
#   nvidia,harmony
#   nvidia,seaboard
#   nvidia,ventana
#   nvidia,whistler
#   toradex,apalis_t30
#   toradex,apalis_t30-eval
#   toradex,colibri_t20-512
#   toradex,iris
#
# Trusted Foundations
# -------------------------------------------
# Tegra supports the Trusted Foundation secure monitor. See the
# "tlm,trusted-foundations" binding's documentation for more details.
```

## Documentation/devicetree/bindings/arm/tegra/nvidia,tegra20-flowctrl.yaml
```yaml
%YAML 1.2
---
version: 1

id: nvidia,tegra20-flowctrl

title: NVIDIA Tegra Flow Controller

maintainer:
    -   name: Thierry Reding <treding@nvidia.com>

description: >
    TODO

inherits:
    -   id: %ids%

properties:
    -   name: "compatible"
        constraint: |
            "nvidia,tegra30-flowctrl"
            "nvidia,tegra20-flowctrl"
            "nvidia,tegra124-flowctrl"
            "nvidia,tegra114-flowctrl"

    reg:

...

# NVIDIA Tegra Flow Controller
#
# Required properties:
# - compatible: Should be "nvidia,tegra<chip>-flowctrl"
# - reg: Should contain one register range (address and length)
#
# Example:
#
# 	flow-controller@60007000 {
# 		compatible = "nvidia,tegra20-flowctrl";
# 		reg = <0x60007000 0x1000>;
# 	};
```

## Documentation/devicetree/bindings/arm/tegra/nvidia,tegra30-mc.yaml
```yaml
%YAML 1.2
---
version: 1

id: nvidia,tegra30-mc

title: NVIDIA Tegra30 MC(Memory Controller)

maintainer:
    -   name: Hiroshi DOYU <hdoyu@nvidia.com>

description: >
    TODO

inherits:
    -   id: %ids%

properties:
    -   name: "compatible"
        constraint: |
            "nvidia,tegra30-mc"

    clock-names:
    clocks:
    interrupts:
    #iommu-cells:
    reg:

...

# NVIDIA Tegra30 MC(Memory Controller)
#
# Required properties:
# - compatible : "nvidia,tegra30-mc"
# - reg : Should contain 4 register ranges(address and length); see the
#   example below. Note that the MC registers are interleaved with the
#   SMMU registers, and hence must be represented as multiple ranges.
# - interrupts : Should contain MC General interrupt.
#
# Example:
# 	memory-controller {
# 		compatible = "nvidia,tegra30-mc";
# 		reg = <0x7000f000 0x010
# 		       0x7000f03c 0x1b4
# 		       0x7000f200 0x028
# 		       0x7000f284 0x17c>;
# 		interrupts = <0 77 0x04>;
# 	};
```

## Documentation/devicetree/bindings/arm/ti/nspire.yaml
```yaml
# SPDX-License-Identifier: None
%YAML 1.2
---
$id: http://devicetree.org/schemas/bindings/arm/nspire.yaml#
$schema: http://devicetree.org/meta-schemas/core.yaml#

title: TI-NSPIRE calculators

maintainers:
  - Daniel Tang <dt.tangr@gmail.com>

properties:
  $nodename:
    const: '/'
  compatible:
    items:
      - enum:
          # CX models
          - ti,nspire-cx
          # Touchpad models
          - ti,nspire-tp
          # Clickpad models
          - ti,nspire-clp
...
```

## Documentation/devicetree/bindings/arm/ti/ti,davinci.yaml
```yaml
# SPDX-License-Identifier: None
%YAML 1.2
---
$id: http://devicetree.org/schemas/bindings/arm/davinci.yaml#
$schema: http://devicetree.org/meta-schemas/core.yaml#

title: Texas Instruments DaVinci Platforms Device Tree Bindings

maintainers:
  - Sekhar Nori <nsekhar@ti.com>
description: |
  DA850/OMAP-L138/AM18x based boards


properties:
  $nodename:
    const: '/'
  compatible:
    items:
      - enum:
          - ti,da850-evm
          - ti,da850-lcdk
          - enbw,cmc
          - lego,ev3
      - const: ti,da850
...
```

## Documentation/devicetree/bindings/arm/versatile-sysreg.yaml
```yaml
%YAML 1.2
---
version: 1

id: versatile-sysreg

title: ARM Versatile system registers

maintainer:
    -   name: Rob Herring <robh@kernel.org>

description: >
    TODO

inherits:
    -   id: %ids%

properties:
    -   name: "compatible"
        constraint: |
            "arm,versatile-sysreg" && "syscon"

    reg:

...

# ARM Versatile system registers
# --------------------------------------
#
# This is a system control registers block, providing multiple low level
# platform functions like board detection and identification, software
# interrupt generation, MMC and NOR Flash control etc.
#
# Required node properties:
# - compatible value : = "arm,versatile-sysreg", "syscon"
# - reg : physical base address and the size of the registers window
```

## Documentation/devicetree/bindings/arm/vt8500.yaml
```yaml
%YAML 1.2
---
version: 1

id: vt8500

title: VIA/Wondermedia VT8500 Platforms Device Tree Bindings

maintainer:
    -   name: Tony Prisk <linux@prisktech.co.nz>

description: >
    TODO

inherits:
    -   id: %ids%

properties:
    -   name: "compatible"
        constraint: |
            "wm,wm8850"
            "wm,wm8750"
            "wm,wm8650"
            "wm,wm8505"
            "via,vt8500"

    #address-cells:
    model:
    #size-cells:

...

# VIA/Wondermedia VT8500 Platforms Device Tree Bindings
# ---------------------------------------
#
# Boards with the VIA VT8500 SoC shall have the following properties:
# Required root node property:
# compatible = "via,vt8500";
#
# Boards with the Wondermedia WM8505 SoC shall have the following properties:
# Required root node property:
# compatible = "wm,wm8505";
#
# Boards with the Wondermedia WM8650 SoC shall have the following properties:
# Required root node property:
# compatible = "wm,wm8650";
#
# Boards with the Wondermedia WM8750 SoC shall have the following properties:
# Required root node property:
# compatible = "wm,wm8750";
#
# Boards with the Wondermedia WM8850 SoC shall have the following properties:
# Required root node property:
# compatible = "wm,wm8850";
```

## Documentation/devicetree/bindings/arm/vt8500/via,vt8500-intc.yaml
```yaml
%YAML 1.2
---
version: 1

id: via,vt8500-intc

title: VIA/Wondermedia VT8500 Interrupt Controller

maintainer:
    -   name: Tony Prisk <linux@prisktech.co.nz>

description: >
    TODO

inherits:
    -   id: %ids%

properties:
    -   name: "compatible"
        constraint: |
            "via,vt8500-intc"

    #interrupt-cells:
    interrupt-controller:
    interrupts:
    reg:

...

# VIA/Wondermedia VT8500 Interrupt Controller
# -----------------------------------------------------
#
# Required properties:
# - compatible : "via,vt8500-intc"
# - reg : Should contain 1 register ranges(address and length)
# - #interrupt-cells : should be <1>
#
# Example:
#
# 	intc: interrupt-controller@d8140000 {
# 		compatible = "via,vt8500-intc";
# 		interrupt-controller;
# 		reg = <0xd8140000 0x10000>;
# 		#interrupt-cells = <1>;
# 	};
```

## Documentation/devicetree/bindings/arm/vt8500/via,vt8500-pmc.yaml
```yaml
%YAML 1.2
---
version: 1

id: via,vt8500-pmc

title: VIA/Wondermedia VT8500 Power Management Controller

maintainer:
    -   name: Tony Prisk <linux@prisktech.co.nz>

description: >
    TODO

inherits:
    -   id: %ids%

properties:
    -   name: "compatible"
        constraint: |
            "via,vt8500-pmc"

    reg:

...

# VIA/Wondermedia VT8500 Power Management Controller
# -----------------------------------------------------
#
# Required properties:
# - compatible : "via,vt8500-pmc"
# - reg : Should contain 1 register ranges(address and length)
#
# Example:
#
# 	pmc@d8130000 {
# 		compatible = "via,vt8500-pmc";
# 		reg = <0xd8130000 0x1000>;
# 	};
```

## Documentation/devicetree/bindings/arm/vt8500/via,vt8500-timer.yaml
```yaml
%YAML 1.2
---
version: 1

id: via,vt8500-timer

title: VIA/Wondermedia VT8500 Timer

maintainer:
    -   name: Tony Prisk <linux@prisktech.co.nz>

description: >
    TODO

inherits:
    -   id: %ids%

properties:
    -   name: "compatible"
        constraint: |
            "via,vt8500-timer"

    interrupts:
    reg:

...

# VIA/Wondermedia VT8500 Timer
# -----------------------------------------------------
#
# Required properties:
# - compatible : "via,vt8500-timer"
# - reg : Should contain 1 register ranges(address and length)
# - interrupts : interrupt for the timer
#
# Example:
#
# 	timer@d8130100 {
# 		compatible = "via,vt8500-timer";
# 		reg = <0xd8130100 0x28>;
# 		interrupts = <36>;
# 	};
```

## Documentation/devicetree/bindings/arm/xen.yaml
```yaml
%YAML 1.2
---
version: 1

id: xen

title: Xen hypervisor device tree bindings

maintainer:
    -   name: Stefano Stabellini <stefano.stabellini@eu.citrix.com>

description: >
    TODO

inherits:
    -   id: %ids%

properties:
    -   name: "compatible"
        constraint: |
            "xen,xen-4"."2" && "xen,xen"

    interrupts:
    reg:

...

# * Xen hypervisor device tree bindings
#
# Xen ARM virtual platforms shall have a top-level "hypervisor" node with
# the following properties:
#
# - compatible:
# 	compatible = "xen,xen-<version>", "xen,xen";
#   where <version> is the version of the Xen ABI of the platform.
#
# - reg: specifies the base physical address and size of a region in
#   memory where the grant table should be mapped to, using an
#   HYPERVISOR_memory_op hypercall. The memory region is large enough to map
#   the whole grant table (it is larger or equal to gnttab_max_grant_frames()).
#
# - interrupts: the interrupt used by Xen to inject event notifications.
#   A GIC node is also required.
#
#
# Example (assuming #address-cells = <2> and #size-cells = <2>):
#
# hypervisor {
# 	compatible = "xen,xen-4.3", "xen,xen";
# 	reg = <0 0xb0000000 0 0x20000>;
# 	interrupts = <1 15 0xf08>;
# };
```

## Documentation/devicetree/bindings/arm/xilinx.yaml
```yaml
%YAML 1.2
---
version: 1

id: xilinx

title: Xilinx Zynq Platforms Device Tree Bindings

maintainer:
    -   name: John Linn <john.linn@xilinx.com>

description: >
    TODO

inherits:
    -   id: %ids%

properties:
    -   name: "compatible"
        constraint: |
            "xlnx,zynq-zed" && "xlnx,zynq-7000"
            "xlnx,zynq-zc706" && "xlnx,zynq-7000"
            "xlnx,zynq-zc702" && "xlnx,zynq-7000"
            "xlnx,zynq-7000"
            "digilent,zynq-zybo" && "xlnx,zynq-7000"

    #address-cells:
    model:
    #size-cells:

...

# Xilinx Zynq Platforms Device Tree Bindings
#
# Boards with Zynq-7000 SOC based on an ARM Cortex A9 processor
# shall have the following properties.
#
# Required root node properties:
#     - compatible = "xlnx,zynq-7000";
```

## Documentation/devicetree/bindings/arm/zte.yaml
```yaml
%YAML 1.2
---
version: 1

id: zte

title: ZTE platforms device tree bindings

maintainer:
    -   name: Jun Nie <jun.nie@linaro.org>

description: >
    TODO

inherits:
    -   id: %ids%

properties:
    -   name: "compatible"
        constraint: |
            "zte,zx-bus-matrix"
            "zte,zx296702-pcu"
            "zte,zx296702-ad1" && "zte,zx296702"
            "zte,sysctrl" && "syscon"

    reg:

...

# ZTE platforms device tree bindings
# ---------------------------------------
#
# -  ZX296702 board:
#     Required root node properties:
#       - compatible = "zte,zx296702-ad1", "zte,zx296702"
#
# System management required properties:
#       - compatible = "zte,sysctrl"
#
# Low power management required properties:
#       - compatible = "zte,zx296702-pcu"
#
# Bus matrix required properties:
#       - compatible = "zte,zx-bus-matrix"
```

## Documentation/devicetree/bindings/ata/exynos-sata.yaml
```yaml
%YAML 1.2
---
version: 1

id: exynos-sata

title: Samsung AHCI SATA Controller

maintainer:
    -   name: Arnd Bergmann <arnd@arndb.de>

description: >
    TODO

inherits:
    -   id: %ids%

properties:
    -   name: "compatible"
        constraint: |
            "snps,dwc-ahci"

    clock-names:
    clocks:
    dma-coherent:
    interrupts:
    phy-names:
    phys:
    reg:
    samsung,sata-freq:
    status:
    ti,hwmods:

...

# * Samsung AHCI SATA Controller
#
# SATA nodes are defined to describe on-chip Serial ATA controllers.
# Each SATA controller should have its own node.
#
# Required properties:
# - compatible		: compatible list, contains "samsung,exynos5-sata"
# - interrupts		: <interrupt mapping for SATA IRQ>
# - reg			: <registers mapping>
# - samsung,sata-freq	: <frequency in MHz>
# - phys			: Must contain exactly one entry as specified
# 			  in phy-bindings.txt
# - phy-names		: Must be "sata-phy"
#
# Optional properties:
# - clocks		: Must contain an entry for each entry in clock-names.
# - clock-names		: Shall be "sata" for the external SATA bus clock,
# 			  and "sclk_sata" for the internal controller clock.
#
# Example:
# 	sata@122f0000 {
# 		compatible = "snps,dwc-ahci";
# 		samsung,sata-freq = <66>;
# 		reg = <0x122f0000 0x1ff>;
# 		interrupts = <0 115 0>;
# 		clocks = <&clock 277>, <&clock 143>;
# 		clock-names = "sata", "sclk_sata";
# 		phys = <&sata_phy>;
# 		phy-names = "sata-phy";
# 	};
```
