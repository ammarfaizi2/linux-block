## Documentation/devicetree/bindings/arm/psci.txt
```
* Power State Coordination Interface (PSCI)

Firmware implementing the PSCI functions described in ARM document number
ARM DEN 0022B ("Power State Coordination Interface System Software on ARM
processors") can be used by Linux to initiate various CPU-centric power
operations.

Issue B of the specification describes functions for CPU suspend, hotplug,
migration of secure software, and system level reset and powerdown.

Functions are invoked by trapping to the privilege level of the PSCI
firmware (specified as part of the binding below) and passing arguments
as defined in ARM document "SMC Calling Convention" (ARM DEN 0028) in a manner
similar to that specified by AAPCS:

	 r0		=> 32-bit Function ID / return value
	{r1 - r3}	=> Parameters

Note that the immediate field of the trapping instruction must be set
to #0.


Main node required properties:

 - compatible    : Must contain "arm,psci-0.2" or "arm,psci"

 - method        : The method defines the calling convention for the PSCI
                   firmware. Permitted values are:

                   "smc" : SMC #0, with the register assignments specified
		           in this binding.

                   "hvc" : HVC #0, with the register assignments specified
		           in this binding.

 - psci_version  : Function ID for PSCI_VERSION operation. Required for
                   "arm,psci-0.2" compatible version or later.

Main node optional properties:

 - cpu_suspend[-<32|64]   : Function ID for CPU_SUSPEND operation

 - cpu_off                : Function ID for CPU_OFF operation

 - cpu_on[-<32|64]        : Function ID for CPU_ON operation

 - affinity_info[-<32|64] : Function ID for AFFINITY_INFO operation

 - migrate[-<32|64]       : Function ID for MIGRATE operation

 - migrate_info_type      : Function ID for MIGRATE_INFO_TYPE operation

 - migrate_info_up_cpu[-<32|64] : Function ID for MIGRATE_INFO_UP_CPU operation

 - system_reset           : Function ID for SYSTEM_RESET operation

 - system_off             : Function ID for SYSTEM_OFF operation

Some functions have have separate IDs for 32-bit and 64-bit calling
conventions. These separate function IDs are described with function names with
"-64" and "-32" suffixes (e.g. cpu_on-64). Where a function name does not have
a suffix, the ID may be used with either calling convention depending on the
CPU state -- AArch32 callers should use the 32-bit calling convention, and
AArch64 callers should use the 64-bit calling convention.

Example:

	psci {
		compatible	= "arm,psci-0.2";
		method		= "smc";
		psci_version	= <0x84000000>;
		cpu_suspend-32	= <0x84000001>;
		cpu_suspend-64	= <0xc4000001>;
		cpu_off		= <0x84000002>;
		cpu_on-32	= <0x84000003>;
		cpu_on-64	= <0xc4000003>;
		affinity_info-32 = <0x84000004>;
		affinity_info-64 = <0xc4000004>;
		migrate-32	= <0x84000005>;
		migrate-64	= <0xc4000005>;
		migrate_info_type = <0x84000006>;
		migrate_info_up_cpu-32 = <0x84000007>;
		migrate_info_up_cpu-64 = <0xc4000007>;
		system_off	= <0x84000008>;
		system_reset	= <0x84000009>;
	};
```

## Documentation/devicetree/bindings/arm/realtek.yaml
```yaml
# SPDX-License-Identifier: None
%YAML 1.2
---
$id: http://devicetree.org/schemas/bindings/arm/realtek.yaml#
$schema: http://devicetree.org/meta-schemas/core.yaml#

title: Realtek platforms device tree bindings

maintainers:
  - Andreas Färber <afaerber@suse.de>

description: |+
  RTD1295 SoC

properties:
  $nodename:
    const: '/'
  compatible:
    items:
      - enum:
          - mele,v9
          - probox2,ava
          - zidoo,x9s
      - const: realtek,rtd1295
...
```

## Documentation/devicetree/bindings/arm/rockchip.yaml
```yaml
# SPDX-License-Identifier: GPL-2.0
%YAML 1.2
---
$id: http://devicetree.org/schemas/arm/rockchip.yaml#
$schema: http://devicetree.org/meta-schemas/core.yaml#

title: Rockchip platforms device tree bindings

maintainers:
  - Beniamino Galvani <b.galvani@gmail.com>
  - Heiko Stuebner <heiko@sntech.de>

properties:
  $nodename:
    const: '/'
  compatible:
    oneOf:
      - items:
          - enum:
              - amarula,vyasa-rk3288
              - asus,rk3288-tinker
              - asus,rk3288-tinker-s
              - radxa,rock2-square
              - chipspark,popmetal-rk3288
              - netxeon,r89
              - firefly,firefly-rk3288
              - firefly,firefly-rk3288-beta
              - firefly,firefly-rk3288-reload
              - mqmaker,miqi
              - rockchip,rk3288-fennec
          - const: rockchip,rk3288

      - description: Phytec phyCORE-RK3288 Rapid Development Kit
        items:
          - const: phytec,rk3288-pcm-947
          - const: phytec,rk3288-phycore-som
          - const: rockchip,rk3288

      - description: Google Mickey (Asus Chromebit CS10)
        items:
          - const: google,veyron-mickey-rev8
          - const: google,veyron-mickey-rev7
          - const: google,veyron-mickey-rev6
          - const: google,veyron-mickey-rev5
          - const: google,veyron-mickey-rev4
          - const: google,veyron-mickey-rev3
          - const: google,veyron-mickey-rev2
          - const: google,veyron-mickey-rev1
          - const: google,veyron-mickey-rev0
          - const: google,veyron-mickey
          - const: google,veyron
          - const: rockchip,rk3288

      - description: Google Minnie (Asus Chromebook Flip C100P)
        items:
          - const: google,veyron-minnie-rev4
          - const: google,veyron-minnie-rev3
          - const: google,veyron-minnie-rev2
          - const: google,veyron-minnie-rev1
          - const: google,veyron-minnie-rev0
          - const: google,veyron-minnie
          - const: google,veyron
          - const: rockchip,rk3288

      - description: Google Pinky (dev-board)
        items:
          - const: google,veyron-pinky-rev2
          - const: google,veyron-pinky
          - const: google,veyron
          - const: rockchip,rk3288

      - description: Google Speedy (Asus C201 Chromebook)
        items:
          - const: google,veyron-speedy-rev9
          - const: google,veyron-speedy-rev8
          - const: google,veyron-speedy-rev7
          - const: google,veyron-speedy-rev6
          - const: google,veyron-speedy-rev5
          - const: google,veyron-speedy-rev4
          - const: google,veyron-speedy-rev3
          - const: google,veyron-speedy-rev2
          - const: google,veyron-speedy
          - const: google,veyron
          - const: rockchip,rk3288

      - description: Google Jaq (Haier Chromebook 11 and more)
        items:
          - const: google,veyron-jaq-rev5
          - const: google,veyron-jaq-rev4
          - const: google,veyron-jaq-rev3
          - const: google,veyron-jaq-rev2
          - const: google,veyron-jaq-rev1
          - const: google,veyron-jaq
          - const: google,veyron
          - const: rockchip,rk3288

      - description: Google Jerry (Hisense Chromebook C11 and more)
        items:
          - const: google,veyron-jerry-rev7
          - const: google,veyron-jerry-rev6
          - const: google,veyron-jerry-rev5
          - const: google,veyron-jerry-rev4
          - const: google,veyron-jerry-rev3
          - const: google,veyron-jerry
          - const: google,veyron
          - const: rockchip,rk3288

      - description: Google Brain (dev-board)
        items:
          - const: google,veyron-brain-rev0
          - const: google,veyron-brain
          - const: google,veyron
          - const: rockchip,rk3288

      - items:
          - enum:
              - rockchip,kylin-rk3036
          - const: rockchip,rk3036

      - items:
          - enum:
              - haoyu,marsboard-rk3066
              - mundoreader,bq-curie2
              - chipspark,rayeager-px2
              - rikomagic,mk80
          - const: rockchip,rk3066a

      - items:
          - enum:
              - radxa,rock
          - const: rockchip,rk3188

      - items:
          - const: rockchip,px3-evb
          - const: rockchip,px3
          - const: rockchip,rk3188

      - items:
          - enum:
              - firefly,roc-rk3328-cc
              - pine64,rock64
              - rockchip,rk3328-evb
          - const: rockchip,rk3328

      - items:
          - enum:
              - geekbuying,geekbox
              - rockchip,rk3368-evb-act8846
              - rockchip,r88
              - tsd,rk3368-uq7-haikou
              - tronsmart,orion-r68-meta
          - const: rockchip,rk3368

      - items:
          - enum:
              - geekbuying,geekbox
              - rockchip,rk3368-evb-act8846
              - rockchip,r88
              - tsd,rk3368-uq7-haikou
              - tronsmart,orion-r68-meta
          - const: rockchip,rk3368

      - items:
          - const: rockchip,px5-evb
          - const: rockchip,px5
          - const: rockchip,rk3368

      - items:
          - enum:
              - firefly,firefly-rk3399
              - firefly,roc-rk3399-pc
              - pine64,rockpro64
              - rockchip,rk3399-evb
              - rockchip,rk3399-sapphire
              - rockchip,rk3399-sapphire-excavator
              - tsd,rk3399-q7-haikou
              - vamrs,ficus
              - vamrs,rock960 # 96boards RK3399 Rock960 (ROCK960 Consumer Edition)
          - const: rockchip,rk3399

      - description: Google Bob (Asus Chromebook Flip C101PA)
        items:
          - const: google,bob-rev13
          - const: google,bob-rev12
          - const: google,bob-rev11
          - const: google,bob-rev10
          - const: google,bob-rev9
          - const: google,bob-rev8
          - const: google,bob-rev7
          - const: google,bob-rev6
          - const: google,bob-rev5
          - const: google,bob-rev4
          - const: google,bob
          - const: google,gru
          - const: rockchip,rk3399

      - description: Google Gru (dev-board)
        items:
          - const: google,gru-rev15
          - const: google,gru-rev14
          - const: google,gru-rev13
          - const: google,gru-rev12
          - const: google,gru-rev11
          - const: google,gru-rev10
          - const: google,gru-rev9
          - const: google,gru-rev8
          - const: google,gru-rev7
          - const: google,gru-rev6
          - const: google,gru-rev5
          - const: google,gru-rev4
          - const: google,gru-rev3
          - const: google,gru-rev2
          - const: google,gru
          - const: rockchip,rk3399

      - description: Google Kevin (Samsung Chromebook Plus)
        items:
          - const: google,kevin-rev15
          - const: google,kevin-rev14
          - const: google,kevin-rev13
          - const: google,kevin-rev12
          - const: google,kevin-rev11
          - const: google,kevin-rev10
          - const: google,kevin-rev9
          - const: google,kevin-rev8
          - const: google,kevin-rev7
          - const: google,kevin-rev6
          - const: google,kevin
          - const: google,gru
          - const: rockchip,rk3399

      - items:
          - enum:
              - rockchip,px30-evb
          - const: rockchip,px30

      - items:
          - enum:
              - rockchip,rv1108-evb
          - const: rockchip,rv1108

      - items:
          - enum:
              - rockchip,rk3228-evb
          - const: rockchip,rk3228

      - items:
          - enum:
              - rockchip,rk3229-evb
          - const: rockchip,rk3229
...
```

## Documentation/devicetree/bindings/arm/rockchip/pmu.yaml
```yaml
%YAML 1.2
---
version: 1

id: pmu

title: Rockchip power-management-unit:

maintainer:
    -   name: Heiko Stuebner <heiko@sntech.de>

description: >
    TODO

inherits:
    -   id: %ids%

properties:
    -   name: "compatible"
        constraint: |
            "rockchip,rk3066-pmu" && "syscon"

    reg:

...

# Rockchip power-management-unit:
# -------------------------------
#
# The pmu is used to turn off and on different power domains of the SoCs
# This includes the power to the CPU cores.
#
# Required node properties:
# - compatible value : = "rockchip,rk3066-pmu";
# - reg : physical base address and the size of the registers window
#
# Example:
#
# 	pmu@20004000 {
# 		compatible = "rockchip,rk3066-pmu";
# 		reg = <0x20004000 0x100>;
# 	};
```

## Documentation/devicetree/bindings/arm/samsung-boards.yaml
```yaml
%YAML 1.2
---
version: 1

id: samsung-boards

title: Samsung's Exynos SoC based boards

maintainer:
    -   name: Chanwoo Choi <cw00.choi@samsung.com>

description: >
    TODO

inherits:
    -   id: %ids%

properties:
    -   name: "compatible"
        constraint: |
            "samsung,xyref5260" && "samsung,exynos5260" && "samsung,exynos5"
            "samsung,universal"_"c210" && "samsung,exynos4210" && "samsung,exynos4"
            "samsung,trats" && "samsung,exynos4210" && "samsung,exynos4"
            "samsung,trats2" && "samsung,exynos4412" && "samsung,exynos4"
            "samsung,ssdk5440" && "samsung,exynos5440" && "samsung,exynos5"
            "samsung,smdkv310" && "samsung,exynos4210" && "samsung,exynos4"
            "samsung,smdk5420" && "samsung,exynos5420" && "samsung,exynos5"
            "samsung,smdk5410" && "samsung,exynos5410" && "samsung,exynos5"
            "samsung,smdk5250" && "samsung,exynos5250" && "samsung,exynos5"
            "samsung,smdk4412" && "samsung,exynos4412" && "samsung,exynos4"
            "samsung,secure-firmware"
            "samsung,sd5v1" && "samsung,exynos5440" && "samsung,exynos5"
            "samsung,rinato" && "samsung,exynos3250" && "samsung,exynos3"
            "samsung,monk" && "samsung,exynos3250" && "samsung,exynos3"

    #address-cells:
    interrupt-parent:
    model:
    #size-cells:

...

# * Samsung's Exynos SoC based boards
#
# Required root node properties:
#     - compatible = should be one or more of the following.
# 	- "samsung,monk"	- for Exynos3250-based Samsung Simband board.
# 	- "samsung,rinato"	- for Exynos3250-based Samsung Gear2 board.
# 	- "samsung,smdkv310"	- for Exynos4210-based Samsung SMDKV310 eval board.
# 	- "samsung,trats"	- for Exynos4210-based Tizen Reference board.
# 	- "samsung,universal_c210" - for Exynos4210-based Samsung board.
# 	- "samsung,smdk4412",	- for Exynos4412-based Samsung SMDK4412 eval board.
# 	- "samsung,trats2"	- for Exynos4412-based Tizen Reference board.
# 	- "samsung,smdk5250"	- for Exynos5250-based Samsung SMDK5250 eval board.
# 	- "samsung,xyref5260"	- for Exynos5260-based Samsung board.
# 	- "samsung,smdk5410"	- for Exynos5410-based Samsung SMDK5410 eval board.
# 	- "samsung,smdk5420"	- for Exynos5420-based Samsung SMDK5420 eval board.
# 	- "samsung,sd5v1"	- for Exynos5440-based Samsung board.
# 	- "samsung,ssdk5440"	- for Exynos5440-based Samsung board.
#
# Optional:
#     - firmware node, specifying presence and type of secure firmware:
#         - compatible: only "samsung,secure-firmware" is currently supported
#         - reg: address of non-secure SYSRAM used for communication with firmware
#
# 	firmware@0203F000 {
# 		compatible = "samsung,secure-firmware";
# 		reg = <0x0203F000 0x1000>;
# 	};
```

## Documentation/devicetree/bindings/arm/samsung/exynos-chipid.yaml
```yaml
%YAML 1.2
---
version: 1

id: exynos-chipid

title: SAMSUNG Exynos SoCs Chipid driver.

maintainer:
    -   name: Pankaj Dubey <pankaj.dubey@samsung.com>

description: >
    TODO

inherits:
    -   id: %ids%

properties:
    -   name: "compatible"
        constraint: |
            "samsung,exynos4210-chipid"

    reg:

...

# SAMSUNG Exynos SoCs Chipid driver.
#
# Required properties:
# - compatible : Should at least contain "samsung,exynos4210-chipid".
#
# - reg: offset and length of the register set
#
# Example:
# 	chipid@10000000 {
# 		compatible = "samsung,exynos4210-chipid";
# 		reg = <0x10000000 0x100>;
# 	};
```
