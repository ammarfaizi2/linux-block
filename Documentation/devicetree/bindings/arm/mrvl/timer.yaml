## Documentation/devicetree/bindings/arm/samsung/sysreg.yaml
```yaml
%YAML 1.2
---
version: 1

id: sysreg

title: SAMSUNG S5P/Exynos SoC series System Registers (SYSREG)

maintainer:
    -   name: Sachin Kamat <sachin.kamat@linaro.org>

description: >
    TODO

inherits:
    -   id: %ids%

properties:
    -   name: "compatible"
        constraint: |
            "samsung,exynos5-sysreg" && "syscon"
            "samsung,exynos4-sysreg" && "syscon"

    reg:

...

# SAMSUNG S5P/Exynos SoC series System Registers (SYSREG)
#
# Properties:
#  - compatible : should contain two values. First value must be one from following list:
# 		- "samsung,exynos4-sysreg" - for Exynos4 based SoCs,
# 		- "samsung,exynos5-sysreg" - for Exynos5 based SoCs.
# 		second value must be always "syscon".
#  - reg : offset and length of the register set.
#
# Example:
# 	syscon@10010000 {
# 		compatible = "samsung,exynos4-sysreg", "syscon";
# 		reg = <0x10010000 0x400>;
# 	};
#
# 	syscon@10050000 {
# 		compatible = "samsung,exynos5-sysreg", "syscon";
# 		reg = <0x10050000 0x5000>;
# 	};
```

## Documentation/devicetree/bindings/arm/sirf.yaml
```yaml
%YAML 1.2
---
version: 1

id: sirf

title: CSR SiRFprimaII and SiRFmarco device tree bindings.

maintainer:
    -   name: Barry Song <Baohua.Song@csr.com>

description: >
    TODO

inherits:
    -   id: %ids%

properties:
    -   name: "compatible"
        constraint: |
            "sirf,prima2" && "sirf,prima2-cb"
            "sirf,prima2"
            "sirf,atlas7-cb" && "sirf,atlas7"
            "sirf,atlas7"
            "sirf,atlas6-cb" && "sirf,atlas6"
            "sirf,atlas6"


...

# CSR SiRFprimaII and SiRFmarco device tree bindings.
# ========================================
#
# Required root node properties:
#     - compatible:
#     - "sirf,atlas6-cb" : atlas6 "cb" evaluation board
#     - "sirf,atlas6" : atlas6 device based board
#     - "sirf,atlas7-cb" : atlas7 "cb" evaluation board
#     - "sirf,atlas7" : atlas7 device based board
#     - "sirf,prima2-cb" : prima2 "cb" evaluation board
#     - "sirf,prima2" : prima2 device based board
```

## Documentation/devicetree/bindings/arm/spear-misc.yaml
```yaml
%YAML 1.2
---
version: 1

id: spear-misc

title: SPEAr Misc configuration

maintainer:
    -   name: Pratyush Anand <pratyush.anand@gmail.com>

description: >
    TODO

inherits:
    -   id: %ids%

properties:
    -   name: "compatible"
        constraint: |
            "st,spear1340-misc" && "syscon"

    reg:

...

# SPEAr Misc configuration
# ===========================
# SPEAr SOCs have some miscellaneous registers which are used to configure
# few properties of different peripheral controllers.
#
# misc node required properties:
#
# - compatible Should be	"st,spear1340-misc", "syscon".
# - reg: Address range of misc space upto 8K
```

## Documentation/devicetree/bindings/arm/spear.yaml
```yaml
%YAML 1.2
---
version: 1

id: spear

title: ST SPEAr Platforms Device Tree Bindings

maintainer:
    -   name: Viresh Kumar <vireshk@kernel.org>

description: >
    TODO

inherits:
    -   id: %ids%

properties:
    -   name: "compatible"
        constraint: |
            "st,spear600-evb" && "st,spear600"
            "st,spear600"
            "st,spear320-hmi" && "st,spear320"
            "st,spear320-evb" && "st,spear320"
            "st,spear310-evb" && "st,spear310"
            "st,spear300-evb" && "st,spear300"
            "st,spear1340-evb" && "st,spear1340"
            "st,spear1340"
            "st,spear1310-evb" && "st,spear1310"
            "st,spear1310"


...

# ST SPEAr Platforms Device Tree Bindings
# ---------------------------------------
#
# Boards with the ST SPEAr600 SoC shall have the following properties:
# Required root node property:
# compatible = "st,spear600";
#
# Boards with the ST SPEAr300 SoC shall have the following properties:
# Required root node property:
# compatible = "st,spear300";
#
# Boards with the ST SPEAr310 SoC shall have the following properties:
# Required root node property:
# compatible = "st,spear310";
#
# Boards with the ST SPEAr320 SoC shall have the following properties:
# Required root node property:
# compatible = "st,spear320";
#
# Boards with the ST SPEAr1310 SoC shall have the following properties:
# Required root node property:
# compatible = "st,spear1310";
#
# Boards with the ST SPEAr1340 SoC shall have the following properties:
# Required root node property:
# compatible = "st,spear1340";
```

## Documentation/devicetree/bindings/arm/ste-nomadik.yaml
```yaml
%YAML 1.2
---
version: 1

id: ste-nomadik

title: ST-Ericsson Nomadik Device Tree Bindings

maintainer:
    -   name: Linus Walleij <linus.walleij@linaro.org>

description: >
    TODO

inherits:
    -   id: %ids%

properties:
    -   name: "compatible"
        constraint: |
            "st,nomadik-nhk-15"
            "calaosystems,usb-s8815"

    #address-cells:
    model:
    #size-cells:

...

# ST-Ericsson Nomadik Device Tree Bindings
#
# For various board the "board" node may contain specific properties
# that pertain to this particular board, such as board-specific GPIOs.
#
# Required root node property: src
# - Nomadik System and reset controller used for basic chip control, clock
#   and reset line control.
# - compatible: must be "stericsson,nomadik,src"
#
# Boards with the Nomadik SoC include:
#
# Nomadik NHK-15 board manufactured by ST Microelectronics:
#
# Required root node property:
#
# compatible="st,nomadik-nhk-15";
#
# S8815 "MiniKit" manufactured by Calao Systems:
#
# Required root node property:
#
# compatible="calaosystems,usb-s8815";
#
# Required node: usb-s8815
#
# Example:
#
# usb-s8815 {
# 		ethernet-gpio {
# 			gpios = <&gpio3 19 0x1>;
# 			interrupts = <19 0x1>;
# 			interrupt-parent = <&gpio3>;
# 		};
# 		mmcsd-gpio {
# 			gpios = <&gpio3 16 0x1>;
# 		};
# };
```

## Documentation/devicetree/bindings/arm/sti.yaml
```yaml
# SPDX-License-Identifier: None
%YAML 1.2
---
$id: http://devicetree.org/schemas/bindings/arm/sti.yaml#
$schema: http://devicetree.org/meta-schemas/core.yaml#

title: ST STi Platforms Device Tree Bindings

maintainers:
  - Maxime Coquelin <maxime.coquelin@st.com>

properties:
  $nodename:
    const: '/'
  compatible:
    items:
      - enum:
          - st,stih415
          - st,stih416
          - st,stih407
          - st,stih410
          - st,stih418
...
```

## Documentation/devicetree/bindings/arm/sunxi.yaml
```yaml
%YAML 1.2
---
version: 1

id: sunxi

title: Allwinner sunXi Platforms Device Tree Bindings

maintainer:
    -   name: Chen-Yu Tsai <wens@csie.org>

description: >
    TODO

inherits:
    -   id: %ids%

properties:
    -   name: "compatible"
        constraint: |
            "xunlong,orangepi-mini" && "allwinner,sun7i-a20"
            "xunlong,orangepi" && "allwinner,sun7i-a20"
            "wits,colombus" && "allwinner,sun6i-a31"
            "wexler,tab7200" && "allwinner,sun7i-a20"
            "utoo,p66" && "allwinner,sun5i-a13"
            "sinlinx,sina33" && "allwinner,sun8i-a33"
            "primux,inet97fv2" && "allwinner,sun4i-a10"
            "pineriver,mini-xplus" && "allwinner,sun4i-a10"
            "olimex,a20-olinuxino-micro" && "allwinner,sun7i-a20"
            "olimex,a20-olinuxino-lime" && "allwinner,sun7i-a20"
            "olimex,a20-olinuxino-lime2" && "allwinner,sun7i-a20"
            "olimex,a13-olinuxino-micro" && "allwinner,sun5i-a13"
            "olimex,a13-olinuxino" && "allwinner,sun5i-a13"
            "olimex,a10s-olinuxino-micro" && "allwinner,sun5i-a10s"
            "olimex,a10-olinuxino-lime" && "allwinner,sun4i-a10"
            "miniand,hackberry" && "allwinner,sun4i-a10"
            "merrii,a80-optimus" && "allwinner,sun9i-a80"
            "merrii,a31-hummingbird" && "allwinner,sun6i-a31"
            "merrii,a20-hummingbird" && "allwinner,sun7i-a20"
            "mele,m9" && "allwinner,sun6i-a31"
            "mele,m3" && "allwinner,sun7i-a20"
            "mele,i7" && "allwinner,sun6i-a31"
            "mele,a1000g-quad" && "allwinner,sun6i-a31"
            "mele,a1000" && "allwinner,sun4i-a10"
            "linksprite,pcduino3-nano" && "allwinner,sun7i-a20"
            "linksprite,pcduino3" && "allwinner,sun7i-a20"
            "linksprite,a10-pcduino" && "allwinner,sun4i-a10"
            "lemaker,bananapro" && "allwinner,sun7i-a20"
            "lemaker,bananapi" && "allwinner,sun7i-a20"
            "jesurun,q5" && "allwinner,sun4i-a10"
            "itead,iteaduino-plus-a10" && "allwinner,sun4i-a10"
            "ippo,q8h-v5" && "allwinner,sun8i-a23"
            "ippo,q8h-v1"."2" && "allwinner,sun8i-a23"
            "ippo,a33-q8h-v1"."2" && "allwinner,sun8i-a33"
            "hyundai,a7hd" && "allwinner,sun4i-a10"
            "hsg,h702" && "allwinner,sun5i-a13"
            "haoyu,a10-marsboard" && "allwinner,sun4i-a10"
            "gemei,g9" && "allwinner,sun4i-a10"
            "et,q8-v1"."6" && "allwinner,sun8i-a33"
            "cubietech,cubietruck" && "allwinner,sun7i-a20"
            "cubietech,cubieboard2" && "allwinner,sun7i-a20"
            "cubietech,a80-cubieboard4" && "allwinner,sun9i-a80"
            "cubietech,a10-cubieboard" && "allwinner,sun4i-a10"
            "chuwi,v7-cw0825" && "allwinner,sun4i-a10"
            "allwinner,sun8i-a23-evb" && "allwinner,sun8i-a23"
            "allwinner,r7-tv-dongle" && "allwinner,sun5i-a10s"
            "allwinner,mk808c" && "allwinner,sun7i-a20"
            "allwinner,mk802ii" && "allwinner,sun4i-a10"
            "allwinner,mk802" && "allwinner,sun4i-a10"
            "allwinner,i12-tvbox" && "allwinner,sun7i-a20"
            "allwinner,ga10h-v1"."1" && "allwinner,sun8i-a33"
            "allwinner,ba10-tvbox" && "allwinner,sun4i-a10"
            "allwinner,auxtek-t004" && "allwinner,sun5i-a10s"
            "allwinner,app4-evb1" && "allwinner,sun6i-a31"
            "allwinner,a10s-mk802" && "allwinner,sun5i-a10s"

    #address-cells:
    interrupt-parent:
    model:
    #size-cells:

...

# Allwinner sunXi Platforms Device Tree Bindings
#
# Each device tree must specify which Allwinner SoC it uses,
# using one of the following compatible strings:
#
#   allwinner,sun4i-a10
#   allwinner,sun5i-a10s
#   allwinner,sun5i-a13
#   allwinner,sun6i-a31
#   allwinner,sun7i-a20
#   allwinner,sun8i-a23
#   allwinner,sun8i-a33
#   allwinner,sun8i-h3
#   allwinner,sun9i-a80
```
