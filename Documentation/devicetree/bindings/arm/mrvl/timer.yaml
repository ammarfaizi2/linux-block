## Documentation/devicetree/bindings/arm/mrvl/timer.yaml
```yaml
%YAML 1.2
---
version: 1

id: timer

title: Marvell MMP Timer controller

maintainer:
    -   name: Haojian Zhuang <haojian.zhuang@gmail.com>

description: >
    TODO

inherits:
    -   id: %ids%

properties:
    -   name: "compatible"
        constraint: |
            "mrvl,mmp-timer"

    interrupts:
    reg:
    status:

...

# * Marvell MMP Timer controller
#
# Required properties:
# - compatible : Should be "mrvl,mmp-timer".
# - reg : Address and length of the register set of timer controller.
# - interrupts : Should be the interrupt number.
#
# Example:
# 	timer0: timer@d4014000 {
# 		compatible = "mrvl,mmp-timer";
# 		reg = <0xd4014000 0x100>;
# 		interrupts = <13>;
# 	};
```

## Documentation/devicetree/bindings/arm/mvebu-system-controller.yaml
```yaml
%YAML 1.2
---
version: 1

id: mvebu-system-controller

title: MVEBU System Controller

maintainer:
    -   name: Gregory CLEMENT <gregory.clement@free-electrons.com>

description: >
    TODO

inherits:
    -   id: %ids%

properties:
    -   name: "compatible"
        constraint: |
            "marvell,orion-system-controller"
            "marvell,armada-390-system-controller" && "marvell,armada-370-xp-system-controller"
            "marvell,armada-380-system-controller" && "marvell,armada-370-xp-system-controller"
            "marvell,armada-375-system-controller"
            "marvell,armada-370-xp-system-controller"

    reg:

...

# MVEBU System Controller
# -----------------------
# MVEBU (Marvell SOCs: Armada 370/375/XP, Dove, mv78xx0, Kirkwood, Orion5x)
#
# Required properties:
#
# - compatible: one of:
# 	- "marvell,orion-system-controller"
# 	- "marvell,armada-370-xp-system-controller"
# 	- "marvell,armada-375-system-controller"
# - reg: Should contain system controller registers location and length.
#
# Example:
#
# 	system-controller@d0018200 {
# 		compatible = "marvell,armada-370-xp-system-controller";
# 		reg = <0xd0018200 0x500>;
# 	};
```

## Documentation/devicetree/bindings/arm/nspire.yaml
```yaml
%YAML 1.2
---
version: 1

id: nspire

title: TI-NSPIRE calculators

maintainer:
    -   name: Daniel Tang <dt.tangr@gmail.com>

description: >
    TODO

inherits:
    -   id: %ids%

properties:
    -   name: "compatible"
        constraint: |
            "ti,nspire-tp"
            "ti,nspire-cx"
            "ti,nspire-clp"

    #address-cells:
    interrupt-parent:
    model:
    #size-cells:

...

# TI-NSPIRE calculators
#
# Required properties:
# - compatible: Compatible property value should contain "ti,nspire".
# 	CX models should have "ti,nspire-cx"
# 	Touchpad models should have "ti,nspire-tp"
# 	Clickpad models should have "ti,nspire-clp"
#
# Example:
#
# / {
# 	model = "TI-NSPIRE CX";
# 	compatible = "ti,nspire-cx";
# 	...
```

## Documentation/devicetree/bindings/arm/olimex.yaml
```yaml
%YAML 1.2
---
version: 1

id: olimex

title: Olimex i.MX Platforms Device Tree Bindings

maintainer:
    -   name: Fabio Estevam <fabio.estevam@freescale.com>

description: >
    TODO

inherits:
    -   id: %ids%

properties:
    -   name: "compatible"
        constraint: |
            "olimex,imx23-olinuxino" && "fsl,imx23"
            "fsl,stmp378x-devb" && "fsl,imx23"

    #address-cells:
    interrupt-parent:
    model:
    #size-cells:

...

# Olimex i.MX Platforms Device Tree Bindings
# ------------------------------------------
#
# i.MX23 Olinuxino Low Cost Board
# Required root node properties:
#     - compatible = "olimex,imx23-olinuxino", "fsl,imx23";
```

## Documentation/devicetree/bindings/arm/omap/counter.yaml
```yaml
%YAML 1.2
---
version: 1

id: counter

title: OMAP Counter-32K bindings

maintainer:
    -   name: Jon Hunter <jon-hunter@ti.com>

description: >
    TODO

inherits:
    -   id: %ids%

properties:
    -   name: "compatible"
        constraint: |
            "ti,omap-counter32k"
            "ti,am4372-counter32k" && "ti,omap-counter32k"

    reg:
    ti,hwmods:

...

# OMAP Counter-32K bindings
#
# Required properties:
# - compatible:	Must be "ti,omap-counter32k" for OMAP controllers
# - reg:		Contains timer register address range (base address and length)
# - ti,hwmods:	Name of the hwmod associated to the counter, which is typically
# 		"counter_32k"
#
# Example:
#
# counter32k: counter@4a304000 {
# 	compatible = "ti,omap-counter32k";
# 	reg = <0x4a304000 0x20>;
# 	ti,hwmods = "counter_32k";
# };
```

## Documentation/devicetree/bindings/arm/omap/ctrl.yaml
```yaml
%YAML 1.2
---
version: 1

id: ctrl

title: OMAP Control Module bindings

maintainer:
    -   name: Tero Kristo <t-kristo@ti.com>

description: >
    TODO

inherits:
    -   id: %ids%

properties:
    -   name: "compatible"
        constraint: |
            "ti,omap5-scm-padconf-core" && "simple-bus"
            "ti,omap5-scm-core" && "simple-bus"
            "ti,omap4-scm-padconf-core" && "simple-bus"
            "ti,omap4-scm-core" && "simple-bus"
            "ti,omap3-scm" && "simple-bus"
            "ti,omap2-scm" && "simple-bus"
            "ti,dra7-scm-core" && "simple-bus"
            "ti,dm816-scrm" && "simple-bus"
            "ti,am4-scm" && "simple-bus"
            "ti,am3-scm" && "simple-bus"

    #address-cells:
    ranges:
    reg:
    #size-cells:

...

# OMAP Control Module bindings
#
# Control Module contains miscellaneous features under it based on SoC type.
# Pincontrol is one common feature, and it has a specialized support
# described in [1]. Typically some clock nodes are also under control module.
# Syscon is used to share register level access to drivers external to
# control module driver itself.
#
# See [2] for documentation about clock/clockdomain nodes.
#
# [1] Documentation/devicetree/bindings/pinctrl/pinctrl-single.txt
# [2] Documentation/devicetree/bindings/clock/ti/*
#
# Required properties:
# - compatible:	Must be one of:
# 		"ti,am3-scm"
# 		"ti,am4-scm"
# 		"ti,dm814-scrm"
# 		"ti,dm816-scrm"
# 		"ti,omap2-scm"
# 		"ti,omap3-scm"
# 		"ti,omap4-scm-core"
# 		"ti,omap4-scm-padconf-core"
# 		"ti,omap5-scm-core"
# 		"ti,omap5-scm-padconf-core"
# 		"ti,dra7-scm-core"
# - reg:		Contains Control Module register address range
# 		(base address and length)
#
# Optional properties:
# - clocks:	clocks for this module
# - clockdomains:	clockdomains for this module
#
# Examples:
#
# scm: scm@2000 {
# 	compatible = "ti,omap3-scm", "simple-bus";
# 	reg = <0x2000 0x2000>;
# 	#address-cells = <1>;
# 	#size-cells = <1>;
# 	ranges = <0 0x2000 0x2000>;
#
# 	omap3_pmx_core: pinmux@30 {
# 		compatible = "ti,omap3-padconf",
# 			     "pinctrl-single";
# 		reg = <0x30 0x230>;
# 		#address-cells = <1>;
# 		#size-cells = <0>;
# 		#interrupt-cells = <1>;
# 		interrupt-controller;
# 		pinctrl-single,register-width = <16>;
# 		pinctrl-single,function-mask = <0xff1f>;
# 	};
#
# 	scm_conf: scm_conf@270 {
# 		compatible = "syscon";
# 		reg = <0x270 0x330>;
# 		#address-cells = <1>;
# 		#size-cells = <1>;
#
# 		scm_clocks: clocks {
# 			#address-cells = <1>;
# 			#size-cells = <0>;
# 		};
# 	};
#
# 	scm_clockdomains: clockdomains {
# 	};
# }
#
# &scm_clocks {
# 	mcbsp5_mux_fck: mcbsp5_mux_fck {
# 		#clock-cells = <0>;
# 		compatible = "ti,composite-mux-clock";
# 		clocks = <&core_96m_fck>, <&mcbsp_clks>;
# 		ti,bit-shift = <4>;
# 		reg = <0x02d8>;
# 	};
# };
```

## Documentation/devicetree/bindings/arm/omap/dmm.yaml
```yaml
%YAML 1.2
---
version: 1

id: dmm

title: OMAP Dynamic Memory Manager (DMM) bindings

maintainer:
    -   name: Archit Taneja <archit@ti.com>

description: >
    TODO

inherits:
    -   id: %ids%

properties:
    -   name: "compatible"
        constraint: |
            "ti,omap5-dmm"
            "ti,omap4-dmm"

    interrupts:
    reg:
    ti,hwmods:

...

# OMAP Dynamic Memory Manager (DMM) bindings
#
# The dynamic memory manager (DMM) is a module located immediately in front of the
# SDRAM controllers (called EMIFs on OMAP). DMM manages various aspects of memory
# accesses such as priority generation amongst initiators, configuration of SDRAM
# interleaving, optimizing transfer of 2D block objects, and provide MMU-like page
# translation for initiators which need contiguous dma bus addresses.
#
# Required properties:
# - compatible:	Should contain "ti,omap4-dmm" for OMAP4 family
# 		Should contain "ti,omap5-dmm" for OMAP5 and DRA7x family
# - reg:		Contains DMM register address range (base address and length)
# - interrupts:	Should contain an interrupt-specifier for DMM_IRQ.
# - ti,hwmods:	Name of the hwmod associated to DMM, which is typically "dmm"
#
# Example:
#
# dmm@4e000000 {
# 	compatible = "ti,omap4-dmm";
# 	reg = <0x4e000000 0x800>;
# 	ti,hwmods = "dmm";
# };
```

## Documentation/devicetree/bindings/arm/omap/dsp.yaml
```yaml
%YAML 1.2
---
version: 1

id: dsp

title: TI - DSP (Digital Signal Processor)

maintainer:
    -   name: Benoit Cousson <b-cousson@ti.com>

description: >
    TODO

inherits:
    -   id: %ids%

properties:
    -   name: "compatible"
        constraint: |
            "ti,omap3-c64"

    ti,hwmods:
    "ti,omap3-c64"::

...

# * TI - DSP (Digital Signal Processor)
#
# TI DSP included in OMAP SoC
#
# Required properties:
# - compatible : Should be "ti,omap3-c64" for OMAP3 & 4
# - ti,hwmods: "dsp"
#
# Examples:
#
# dsp {
#     compatible = "ti,omap3-c64";
#     ti,hwmods = "dsp";
# };
```

## Documentation/devicetree/bindings/arm/omap/iva.yaml
```yaml
%YAML 1.2
---
version: 1

id: iva

title: TI - IVA (Imaging and Video Accelerator) subsystem

maintainer:
    -   name: Benoit Cousson <b-cousson@ti.com>

description: >
    TODO

inherits:
    -   id: %ids%

properties:
    -   name: "compatible"
        constraint: |
            "ti,ivahd"
            "ti,iva2"."2"

    status:
    ti,hwmods:

...

# * TI - IVA (Imaging and Video Accelerator) subsystem
#
# The IVA contain various audio, video or imaging HW accelerator
# depending of the version.
#
# Required properties:
# - compatible : Should be:
#   - "ti,ivahd" for OMAP4
#   - "ti,iva2.2" for OMAP3
#   - "ti,iva2.1" for OMAP2430
#   - "ti,iva1" for OMAP2420
# - ti,hwmods: "iva"
#
# Examples:
#
# iva {
#     compatible = "ti,ivahd", "ti,iva";
#     ti,hwmods = "iva";
# };
```

## Documentation/devicetree/bindings/arm/omap/l3-noc.yaml
```yaml
%YAML 1.2
---
version: 1

id: l3-noc

title: TI - L3 Network On Chip (NoC)

maintainer:
    -   name: Afzal Mohammed <afzal@ti.com>

description: >
    TODO

inherits:
    -   id: %ids%

properties:
    -   name: "compatible"
        constraint: |
            "ti,omap5-l3-noc" && "simple-bus"
            "ti,omap4-l3-noc" && "simple-bus"
            "ti,omap3-l3-smx" && "simple-bus"
            "ti,dra7-l3-noc" && "simple-bus"
            "ti,am4372-l3-noc" && "simple-bus"

    #address-cells:
    interrupts:
    ranges:
    reg:
    #size-cells:
    ti,hwmods:

...

# * TI - L3 Network On Chip (NoC)
#
# This version is an implementation of the generic NoC IP
# provided by Arteris.
#
# Required properties:
# - compatible : Should be "ti,omap3-l3-smx" for OMAP3 family
#                Should be "ti,omap4-l3-noc" for OMAP4 family
#                Should be "ti,omap5-l3-noc" for OMAP5 family
# 	       Should be "ti,dra7-l3-noc" for DRA7 family
#                Should be "ti,am4372-l3-noc" for AM43 family
# - reg:	Contains L3 register address range for each noc domain.
# - ti,hwmods: "l3_main_1", ... One hwmod for each noc domain.
#
# Examples:
#
# ocp {
# 	compatible = "ti,omap4-l3-noc", "simple-bus";
# 	#address-cells = <1>;
# 	#size-cells = <1>;
# 	ranges;
# 	ti,hwmods = "l3_main_1", "l3_main_2", "l3_main_3";
# };
```

## Documentation/devicetree/bindings/arm/omap/l4.yaml
```yaml
%YAML 1.2
---
version: 1

id: l4

title: L4 interconnect bindings

maintainer:
    -   name: Tero Kristo <t-kristo@ti.com>

description: >
    TODO

inherits:
    -   id: %ids%

properties:
    -   name: "compatible"
        constraint: |
            "ti,omap5-l4-wkup" && "simple-bus"
            "ti,omap5-l4-cfg" && "simple-bus"
            "ti,omap4-l4-wkup" && "simple-bus"
            "ti,omap4-l4-cfg" && "simple-bus"
            "ti,omap3-l4-core" && "simple-bus"
            "ti,omap2-l4-wkup" && "simple-bus"
            "ti,omap2-l4" && "simple-bus"
            "ti,dra7-l4-wkup" && "simple-bus"
            "ti,dra7-l4-cfg" && "simple-bus"
            "ti,am4-l4-wkup" && "simple-bus"
            "ti,am3-l4-wkup" && "simple-bus"

    #address-cells:
    ranges:
    #size-cells:

...

# L4 interconnect bindings
#
# These bindings describe the OMAP SoCs L4 interconnect bus.
#
# Required properties:
# - compatible : Should be "ti,omap2-l4" for OMAP2 family l4 core bus
# 	       Should be "ti,omap2-l4-wkup" for OMAP2 family l4 wkup bus
# 	       Should be "ti,omap3-l4-core" for OMAP3 family l4 core bus
# 	       Should be "ti,omap4-l4-cfg" for OMAP4 family l4 cfg bus
# 	       Should be "ti,omap4-l4-wkup" for OMAP4 family l4 wkup bus
# 	       Should be "ti,omap5-l4-cfg" for OMAP5 family l4 cfg bus
# 	       Should be "ti,omap5-l4-wkup" for OMAP5 family l4 wkup bus
# 	       Should be "ti,dra7-l4-cfg" for DRA7 family l4 cfg bus
# 	       Should be "ti,dra7-l4-wkup" for DRA7 family l4 wkup bus
# 	       Should be "ti,am3-l4-wkup" for AM33xx family l4 wkup bus
# 	       Should be "ti,am4-l4-wkup" for AM43xx family l4 wkup bus
# - ranges : contains the IO map range for the bus
#
# Examples:
#
# l4: l4@48000000 {
# 	compatible "ti,omap2-l4", "simple-bus";
# 	#address-cells = <1>;
# 	#size-cells = <1>;
# 	ranges = <0 0x48000000 0x100000>;
# };
```

## Documentation/devicetree/bindings/arm/oxnas.yaml
```yaml
# SPDX-License-Identifier: GPL-2.0
%YAML 1.2
---
$id: http://devicetree.org/schemas/arm/oxnas.yaml#
$schema: http://devicetree.org/meta-schemas/core.yaml#

title: Oxford Semiconductor OXNAS SoCs Family device tree bindings

maintainers:
  - Neil Armstrong <narmstrong@baylibre.com>

properties:
  $nodename:
    const: '/'
  compatible:
    oneOf:
      - items:
        - enum:
            - wd,mbwe
        - const: oxsemi,ox810se

      - items:
        - enum:
            - cloudengines,pogoplugv3
        - const: oxsemi,ox820
```
