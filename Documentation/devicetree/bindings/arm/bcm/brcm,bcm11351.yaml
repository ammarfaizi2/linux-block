## Documentation/devicetree/bindings/arm/bcm/brcm,bcm11351.yaml
```yaml
%YAML 1.2
---
version: 1

id: brcm,bcm11351

title: Broadcom BCM11351 device tree bindings

maintainer:
    -   name: Scott Branden <sbranden@broadcom.com>

description: >
    TODO

inherits:
    -   id: %ids%

properties:
    -   name: "compatible"
        constraint: |
            "brcm,bcm28155-ap" && "brcm,bcm11351"
            "brcm,bcm11351"


...

# Broadcom BCM11351 device tree bindings
# -------------------------------------------
#
# Boards with the bcm281xx SoC family (which includes bcm11130, bcm11140,
# bcm11351, bcm28145, bcm28155 SoCs) shall have the following properties:
#
# Required root node property:
#
# compatible = "brcm,bcm11351";
# DEPRECATED: compatible = "bcm,bcm11351";
```

## Documentation/devicetree/bindings/arm/bcm/brcm,bcm21664.yaml
```yaml
%YAML 1.2
---
version: 1

id: brcm,bcm21664

title: Broadcom BCM21664 device tree bindings

maintainer:
    -   name: Scott Branden <sbranden@broadcom.com>

description: >
    TODO

inherits:
    -   id: %ids%

properties:
    -   name: "compatible"
        constraint: |
            "brcm,bcm21664-garnet" && "brcm,bcm21664"
            "brcm,bcm21664"


...

# Broadcom BCM21664 device tree bindings
# --------------------------------------
#
# This document describes the device tree bindings for boards with the BCM21664
# SoC.
#
# Required root node property:
#   - compatible: brcm,bcm21664
#
# Example:
# 	/ {
# 		model = "BCM21664 SoC";
# 		compatible = "brcm,bcm21664";
# 		[...]
# 	}
```

## Documentation/devicetree/bindings/arm/bcm/brcm,bcm4708.yaml
```yaml
%YAML 1.2
---
version: 1

id: brcm,bcm4708

title: Broadcom BCM4708 device tree bindings

maintainer:
    -   name: Scott Branden <sbranden@broadcom.com>

description: >
    TODO

inherits:
    -   id: %ids%

properties:
    -   name: "compatible"
        constraint: |
            "smartrg,sr400ac" && "brcm,bcm4708"
            "netgear,r8000" && "brcm,bcm4709" && "brcm,bcm4708"
            "netgear,r6300v2" && "brcm,bcm4708"
            "netgear,r6250v1" && "brcm,bcm4708"
            "luxul,xwc-1000" && "brcm,bcm4708"
            "buffalo,wzr-900dhp" && "brcm,bcm47081" && "brcm,bcm4708"
            "buffalo,wzr-600dhp2" && "brcm,bcm47081" && "brcm,bcm4708"
            "buffalo,wzr-1750dhp" && "brcm,bcm4708"
            "buffalo,wxr-1900dhp" && "brcm,bcm4709" && "brcm,bcm4708"
            "brcm,bcm4708"
            "asus,rt-n18u" && "brcm,bcm47081" && "brcm,bcm4708"
            "asus,rt-ac87u" && "brcm,bcm4709" && "brcm,bcm4708"
            "asus,rt-ac68u" && "brcm,bcm4708"
            "asus,rt-ac56u" && "brcm,bcm4708"

    #address-cells:
    interrupt-parent:
    model:
    #size-cells:

...

# Broadcom BCM4708 device tree bindings
# -------------------------------------------
#
# Boards with the BCM4708 SoC shall have the following properties:
#
# Required root node property:
#
# compatible = "brcm,bcm4708";
```

## Documentation/devicetree/bindings/arm/bcm/brcm,cygnus.yaml
```yaml
%YAML 1.2
---
version: 1

id: brcm,cygnus

title: Broadcom Cygnus device tree bindings

maintainer:
    -   name: Scott Branden <sbranden@broadcom.com>

description: >
    TODO

inherits:
    -   id: %ids%

properties:
    -   name: "compatible"
        constraint: |
            "brcm,cygnus"
            "brcm,bcm58305" && "brcm,cygnus"
            "brcm,bcm58300" && "brcm,cygnus"
            "brcm,bcm11360" && "brcm,cygnus"

    #address-cells:
    interrupt-parent:
    model:
    #size-cells:

...

# Broadcom Cygnus device tree bindings
# ------------------------------------
#
#
# Boards with Cygnus SoCs shall have the following properties:
#
# Required root node property:
#
# BCM11300
# compatible = "brcm,bcm11300", "brcm,cygnus";
#
# BCM11320
# compatible = "brcm,bcm11320", "brcm,cygnus";
#
# BCM11350
# compatible = "brcm,bcm11350", "brcm,cygnus";
#
# BCM11360
# compatible = "brcm,bcm11360", "brcm,cygnus";
#
# BCM58300
# compatible = "brcm,bcm58300", "brcm,cygnus";
#
# BCM58302
# compatible = "brcm,bcm58302", "brcm,cygnus";
#
# BCM58303
# compatible = "brcm,bcm58303", "brcm,cygnus";
#
# BCM58305
# compatible = "brcm,bcm58305", "brcm,cygnus";
```

## Documentation/devicetree/bindings/arm/bcm/raspberrypi,bcm2835-firmware.yaml
```yaml
%YAML 1.2
---
version: 1

id: raspberrypi,bcm2835-firmware

title: Raspberry Pi VideoCore firmware driver

maintainer:
    -   name: Eric Anholt <eric@anholt.net>

description: >
    TODO

inherits:
    -   id: %ids%

properties:
    -   name: "compatible"
        constraint: |
            "raspberrypi,bcm2835-firmware"

    mboxes:

...

# Raspberry Pi VideoCore firmware driver
#
# Required properties:
#
# - compatible:		Should be "raspberrypi,bcm2835-firmware"
# - mboxes:		Phandle to the firmware device's Mailbox.
# 			  (See: ../mailbox/mailbox.txt for more information)
#
# Example:
#
# firmware {
# 	compatible = "raspberrypi,bcm2835-firmware";
# 	mboxes = <&mailbox>;
# };
```

## Documentation/devicetree/bindings/arm/calxeda.yaml
```yaml
%YAML 1.2
---
version: 1

id: calxeda

title: Calxeda Platforms Device Tree Bindings

maintainer:
    -   name: Rob Herring <rob.herring@calxeda.com>

description: >
    TODO

inherits:
    -   id: %ids%

properties:
    -   name: "compatible"
        constraint: |
            "calxeda,highbank"
            "calxeda,ecx-2000"

    #address-cells:
    clock-ranges:
    model:
    #size-cells:

...

# Calxeda Platforms Device Tree Bindings
# -----------------------------------------------
#
# Boards with Calxeda Cortex-A9 based ECX-1000 (Highbank) SOC shall have the
# following properties.
#
# Required root node properties:
#     - compatible = "calxeda,highbank";
#
#
# Boards with Calxeda Cortex-A15 based ECX-2000 SOC shall have the following
# properties.
#
# Required root node properties:
#     - compatible = "calxeda,ecx-2000";
```

## Documentation/devicetree/bindings/arm/calxeda/combophy.yaml
```yaml
%YAML 1.2
---
version: 1

id: combophy

title: Calxeda Highbank Combination Phys for SATA

maintainer:
    -   name: Mark Langsdorf <mark.langsdorf@calxeda.com>

description: >
    TODO

inherits:
    -   id: %ids%

properties:
    -   name: "compatible"
        constraint: |
            "calxeda,hb-combophy"

    #phy-cells:
    phydev:
    reg:

...

# Calxeda Highbank Combination Phys for SATA
#
# Properties:
# - compatible : Should be "calxeda,hb-combophy"
# - #phy-cells: Should be 1.
# - reg : Address and size for Combination Phy registers.
# - phydev: device ID for programming the combophy.
#
# Example:
#
# 	combophy5: combo-phy@fff5d000 {
# 		compatible = "calxeda,hb-combophy";
# 		#phy-cells = <1>;
# 		reg = <0xfff5d000 0x1000>;
# 		phydev = <31>;
# 	};
#
```

## Documentation/devicetree/bindings/arm/calxeda/l2ecc.yaml
```yaml
%YAML 1.2
---
version: 1

id: l2ecc

title: Calxeda Highbank L2 cache ECC

maintainer:
    -   name: Rob Herring <rob.herring@calxeda.com>

description: >
    TODO

inherits:
    -   id: %ids%

properties:
    -   name: "compatible"
        constraint: |
            "calxeda,hb-sregs-l2-ecc"

    interrupts:
    reg:

...

# Calxeda Highbank L2 cache ECC
#
# Properties:
# - compatible : Should be "calxeda,hb-sregs-l2-ecc"
# - reg : Address and size for ECC error interrupt clear registers.
# - interrupts : Should be single bit error interrupt, then double bit error
# 	interrupt.
#
# Example:
#
# 	sregs@fff3c200 {
# 		compatible = "calxeda,hb-sregs-l2-ecc";
# 		reg = <0xfff3c200 0x100>;
# 		interrupts = <0 71 4  0 72 4>;
# 	};
```

## Documentation/devicetree/bindings/arm/calxeda/mem-ctrlr.yaml
```yaml
%YAML 1.2
---
version: 1

id: mem-ctrlr

title: Calxeda DDR memory controller

maintainer:
    -   name: Rob Herring <rob.herring@calxeda.com>

description: >
    TODO

inherits:
    -   id: %ids%

properties:
    -   name: "compatible"
        constraint: |
            "calxeda,hb-ddr-ctrl"
            "calxeda,ecx-2000-ddr-ctrl"

    interrupts:
    reg:

...

# Calxeda DDR memory controller
#
# Properties:
# - compatible : Should be:
#   - "calxeda,hb-ddr-ctrl" for ECX-1000
#   - "calxeda,ecx-2000-ddr-ctrl" for ECX-2000
# - reg : Address and size for DDR controller registers.
# - interrupts : Interrupt for DDR controller.
#
# Example:
#
# 	memory-controller@fff00000 {
# 		compatible = "calxeda,hb-ddr-ctrl";
# 		reg = <0xfff00000 0x1000>;
# 		interrupts = <0 91 4>;
# 	};
```

## Documentation/devicetree/bindings/arm/davinci.yaml
```yaml
%YAML 1.2
---
version: 1

id: davinci

title: Texas Instruments DaVinci Platforms Device Tree Bindings

maintainer:
    -   name: Sekhar Nori <nsekhar@ti.com>

description: >
    TODO

inherits:
    -   id: %ids%

properties:
    -   name: "compatible"
        constraint: |
            "ti,da850-evm" && "ti,da850"
            "enbw,cmc" && "ti,da850"

    #address-cells:
    model:
    #size-cells:

...

# Texas Instruments DaVinci Platforms Device Tree Bindings
# --------------------------------------------------------
#
# DA850/OMAP-L138/AM18x Evaluation Module (EVM) board
# Required root node properties:
#     - compatible = "ti,da850-evm", "ti,da850";
#
# EnBW AM1808 based CMC board
# Required root node properties:
#     - compatible = "enbw,cmc", "ti,da850;
#
# Generic DaVinci Boards
# ----------------------
#
# DA850/OMAP-L138/AM18x generic board
# Required root node properties:
#     - compatible = "ti,da850";
```

## Documentation/devicetree/bindings/arm/digicolor.yaml
```yaml
%YAML 1.2
---
version: 1

id: digicolor

title: Conexant Digicolor Platforms Device Tree Bindings

maintainer:
    -   name: Baruch Siach <baruch@tkos.co.il>

description: >
    TODO

inherits:
    -   id: %ids%

properties:
    -   name: "compatible"
        constraint: |
            "cnxt,equinox" && "cnxt,cx92755"
            "cnxt,cx92755"


...

# Conexant Digicolor Platforms Device Tree Bindings
#
# Each device tree must specify which Conexant Digicolor SoC it uses.
# Must be the following compatible string:
#
#   cnxt,cx92755
```

## Documentation/devicetree/bindings/arm/firmware/tlm,trusted-foundations.yaml
```yaml
%YAML 1.2
---
version: 1

id: tlm,trusted-foundations

title: Trusted Foundations

maintainer:
    -   name: Alexandre Courbot <acourbot@nvidia.com>

description: >
    TODO

inherits:
    -   id: %ids%

properties:
    -   name: "compatible"
        constraint: |
            "tlm,trusted-foundations"

    tlm,version-major:
    tlm,version-minor:

...

# Trusted Foundations
# -------------------
#
# Boards that use the Trusted Foundations secure monitor can signal its
# presence by declaring a node compatible with "tlm,trusted-foundations"
# under the /firmware/ node
#
# Required properties:
# - compatible: "tlm,trusted-foundations"
# - tlm,version-major: major version number of Trusted Foundations firmware
# - tlm,version-minor: minor version number of Trusted Foundations firmware
#
# Example:
# 	firmware {
# 		trusted-foundations {
# 			compatible = "tlm,trusted-foundations";
# 			tlm,version-major = <2>;
# 			tlm,version-minor = <8>;
# 		};
# 	};
```

## Documentation/devicetree/bindings/arm/freescale/fsl,vf610-mscm-cpucfg.yaml
```yaml
%YAML 1.2
---
version: 1

id: fsl,vf610-mscm-cpucfg

title: Freescale Vybrid Miscellaneous System Control - CPU Configuration

maintainer:
    -   name: Stefan Agner <stefan@agner.ch>

description: >
    TODO

inherits:
    -   id: %ids%

properties:
    -   name: "compatible"
        constraint: |
            "fsl,vf610-mscm-cpucfg" && "syscon"

    reg:

...

# Freescale Vybrid Miscellaneous System Control - CPU Configuration
#
# The MSCM IP contains multiple sub modules, this binding describes the first
# block of registers which contains CPU configuration information.
#
# Required properties:
# - compatible:	"fsl,vf610-mscm-cpucfg", "syscon"
# - reg:		the register range of the MSCM CPU configuration registers
#
# Example:
# 	mscm_cpucfg: cpucfg@40001000 {
# 		compatible = "fsl,vf610-mscm-cpucfg", "syscon";
# 		reg = <0x40001000 0x800>;
# 	}
```
