## Documentation/devicetree/bindings/arm/fsl.yaml
```yaml
# SPDX-License-Identifier: None
%YAML 1.2
---
$id: http://devicetree.org/schemas/bindings/arm/fsl.yaml#
$schema: http://devicetree.org/meta-schemas/core.yaml#

title: Freescale i.MX Platforms Device Tree Bindings

maintainers:
  - Shawn Guo <shawn.guo@freescale.com>
  - Shaohui Xie <Shaohui.Xie@nxp.com>

properties:
  $nodename:
    const: '/'
  compatible:
    oneOf:
      - description: i.MX23 based Boards
        items:
          - enum:
              - fsl,imx23-evk
              - olimex,imx23-olinuxino
          - const: fsl,imx23

      - description: i.MX25 Product Development Kit
        items:
          - enum:
              - fsl,imx25-pdk
          - const: fsl,imx25

      - description: i.MX27 Product Development Kit
        items:
          - enum:
              - fsl,imx27-pdk
          - const: fsl,imx27

      - description: i.MX28 based Boards
        items:
          - enum:
              - fsl,imx28-evk
              - i2se,duckbill
              - i2se,duckbill-2
              - technologic,imx28-ts4600
          - const: fsl,imx28
      - items:
          - enum:
              - i2se,duckbill-2-485
              - i2se,duckbill-2-enocean
              - i2se,duckbill-2-spi
          - const: i2se,duckbill-2
          - const: fsl,imx28

      - description: i.MX51 Babbage Board
        items:
          - enum:
              - armadeus,imx51-apf51
              - fsl,imx51-babbage
              - technologic,imx51-ts4800
          - const: fsl,imx51

      - description: i.MX53 Boards
        items:
          - enum:
              - bhf,cx9020
              - fsl,imx53-ard
              - fsl,imx53-evk
              - fsl,imx53-qsb
              - fsl,imx53-smd
          - const: fsl,imx53

      - description: i.MX6Q based Boards
        items:
          - enum:
              - fsl,imx6q-arm2
              - fsl,imx6q-sabrelite
              - fsl,imx6q-sabresd
              - fsl,imx6q-sabreauto
              - technologic,imx6q-ts4900
              - technologic,imx6q-ts7970
          - const: fsl,imx6q

      - description: i.MX6DL based Boards
        items:
          - enum:
              - technologic,imx6dl-ts4900
              - technologic,imx6dl-ts7970
          - const: fsl,imx6dl

      - description: i.MX6SLL based Boards
        items:
          - enum:
              - fsl,imx6sll-evk
          - const: fsl,imx6sll

      - description:
          Compulab SBC-iMX7 is a single board computer based on the
          Freescale i.MX7 system-on-chip. SBC-iMX7 is implemented with
          the CL-SOM-iMX7 System-on-Module providing most of the functions,
          and SB-SOM-iMX7 carrier board providing additional peripheral
          functions and connectors.
        items:
          - const: compulab,sbc-imx7
          - const: compulab,cl-som-imx7
          - const: fsl,imx7d

      - description:
          Freescale Vybrid Platform Device Tree Bindings

          For the Vybrid SoC familiy all variants with DDR controller are supported,
          which is the VF5xx and VF6xx series. Out of historical reasons, in most
          places the kernel uses vf610 to refer to the whole familiy.
          The compatible string "fsl,vf610m4" is used for the secondary Cortex-M4
          core support.
        items:
          - enum:
              - fsl,vf500
              - fsl,vf510
              - fsl,vf600
              - fsl,vf610
              - fsl,vf610m4

      - description: LS1021A based Boards
        items:
          - enum:
              - fsl,ls1012a-rdb
              - fsl,ls1012a-frdm
              - fsl,ls1012a-qds
          - const: fsl,ls1021a

      - description: LS1043A based Boards
        items:
          - enum:
              - fsl,ls1043a-rdb
              - fsl,ls1043a-qds
          - const: fsl,ls1043a

      - description: LS1046A based Boards
        items:
          - enum:
              - fsl,ls1046a-qds
              - fsl,ls1046a-rdb
          - const: fsl,ls1046a

      - description: LS1088A based Boards
        items:
          - enum:
              - fsl,ls1088a-qds
              - fsl,ls1088a-rdb
          - const: fsl,ls1088a

      - description: LS2080A based Boards
        items:
          - enum:
              - fsl,ls2080a-simu
              - fsl,ls2080a-qds
              - fsl,ls2080a-rdb
          - const: fsl,ls2080a

      - description: LS2088A based Boards
        items:
          - enum:
              - fsl,ls2088a-qds
              - fsl,ls2088a-rdb
          - const: fsl,ls2088a

...
```

## Documentation/devicetree/bindings/arm/insignal-boards.yaml
```yaml
%YAML 1.2
---
version: 1

id: insignal-boards

title: Insignal's Exynos4210 based Origen evaluation board

maintainer:
    -   name: Thomas Abraham <thomas.abraham@linaro.org>

description: >
    TODO

inherits:
    -   id: %ids%

properties:
    -   name: "compatible"
        constraint: |
            "samsung,exynos4210" && "samsung,exynos4"
            "insignal,origen" && "samsung,exynos4210" && "samsung,exynos4"

    #address-cells:
    interrupt-parent:
    model:
    #size-cells:

...

# * Insignal's Exynos4210 based Origen evaluation board
#
# Origen low-cost evaluation board is based on Samsung's Exynos4210 SoC.
#
# Required root node properties:
#     - compatible = should be one or more of the following.
#         (a) "samsung,smdkv310" - for Samsung's SMDKV310 eval board.
#         (b) "samsung,exynos4210"  - for boards based on Exynos4210 SoC.
```

## Documentation/devicetree/bindings/arm/keystone/keystone.yaml
```yaml
%YAML 1.2
---
version: 1

id: keystone

title: TI Keystone Platforms Device Tree Bindings

maintainer:
    -   name: Ivan Khoronzhuk <ivan.khoronzhuk@ti.com>

description: >
    TODO

inherits:
    -   id: %ids%

properties:
    -   name: "compatible"
        constraint: |
            "ti,keystone" && "simple-bus"
            "ti,k2l-evm" && "ti,keystone"
            "ti,k2hk-evm" && "ti,keystone"
            "ti,k2e-evm" && "ti,keystone"

    #address-cells:
    interrupt-parent:
    model:
    #size-cells:

...

# TI Keystone Platforms Device Tree Bindings
# -----------------------------------------------
#
# Boards with Keystone2 based devices (TCI66xxK2H) SOC shall have the
# following properties.
#
# Required properties:
#  - compatible: All TI specific devices present in Keystone SOC should be in
#    the form "ti,keystone-*". Generic devices like gic, arch_timers, ns16550
#    type UART should use the specified compatible for those devices.
#
# Boards:
# -  Keystone 2 Hawking/Kepler EVM
#    compatible = "ti,k2hk-evm","ti,keystone"
#
# -  Keystone 2 Lamarr EVM
#    compatible = "ti,k2l-evm","ti,keystone"
#
# -  Keystone 2 Edison EVM
#    compatible = "ti,k2e-evm","ti,keystone"
```

## Documentation/devicetree/bindings/arm/lpc32xx.yaml
```yaml
%YAML 1.2
---
version: 1

id: lpc32xx

title: NXP LPC32xx Platforms Device Tree Bindings

maintainer:
    -   name: Roland Stigge <stigge@antcom.de>

description: >
    TODO

inherits:
    -   id: %ids%

properties:
    -   name: "compatible"
        constraint: |
            "phytec,phy3250" && "nxp,lpc3250"
            "nxp,lpc3220"
            "ea,ea3250" && "nxp,lpc3250"

    #address-cells:
    interrupt-parent:
    model:
    #size-cells:

...

# NXP LPC32xx Platforms Device Tree Bindings
# ------------------------------------------
#
# Boards with the NXP LPC32xx SoC shall have the following properties:
#
# Required root node property:
#
# compatible: must be "nxp,lpc3220", "nxp,lpc3230", "nxp,lpc3240" or "nxp,lpc3250"
```

## Documentation/devicetree/bindings/arm/marvell,dove.yaml
```yaml
%YAML 1.2
---
version: 1

id: marvell,dove

title: Marvell Dove Platforms Device Tree Bindings

maintainer:
    -   name: Sebastian Hesselbarth <sebastian.hesselbarth@gmail.com>

description: >
    TODO

inherits:
    -   id: %ids%

properties:
    -   name: "compatible"
        constraint: |
            "solidrun,cubox" && "marvell,dove"
            "solidrun,cubox-es" && "solidrun,cubox" && "marvell,dove"
            "marvell,dove-global-config" && "syscon"
            "marvell,dove-db" && "marvell,dove"
            "marvell,dove"
            "globalscale,d3plug" && "marvell,dove"
            "globalscale,d2plug" && "marvell,dove"
            "compulab,sbc-a510" && "compulab,cm-a510" && "marvell,dove"
            "compulab,cm-a510" && "marvell,dove"


...

# Marvell Dove Platforms Device Tree Bindings
# -----------------------------------------------
#
# Boards with a Marvell Dove SoC shall have the following properties:
#
# Required root node property:
# - compatible: must contain "marvell,dove";
#
# * Global Configuration registers
#
# Global Configuration registers of Dove SoC are shared by a syscon node.
#
# Required properties:
# - compatible: must contain "marvell,dove-global-config" and "syscon".
# - reg: base address and size of the Global Configuration registers.
#
# Example:
#
# gconf: global-config@e802c {
# 	compatible = "marvell,dove-global-config", "syscon";
# 	reg = <0xe802c 0x14>;
# };
```
