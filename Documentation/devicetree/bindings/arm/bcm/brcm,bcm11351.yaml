## Documentation/devicetree/bindings/arm/marvell,kirkwood.yaml
```yaml
%YAML 1.2
---
version: 1

id: marvell,kirkwood

title: Marvell Kirkwood SoC Family Device Tree Bindings

maintainer:
    -   name: Roger Shimizu <rogershimizu@gmail.com>

description: >
    TODO

inherits:
    -   id: %ids%

properties:
    -   name: "compatible"
        constraint: |
            "zyxel,nsa320" && "marvell,kirkwood-88f6281" && "marvell,kirkwood"
            "zyxel,nsa310" && "marvell,kirkwood-88f6281" && "marvell,kirkwood"
            "zyxel,nsa310a" && "zyxel,nsa310" && "marvell,kirkwood-88f6281" && "marvell,kirkwood"
            "usi,topkick-1281P2" && "usi,topkick" && "marvell,kirkwood-88f6282" && "marvell,kirkwood"
            "synology,rs411" && "synology,rs812" && "marvell,kirkwood"
            "synology,rs409" && "marvell,kirkwood"
            "synology,rs212" && "marvell,kirkwood"
            "synology,ds411" && "synology,ds413jv10" && "marvell,kirkwood"
            "synology,ds411slim" && "marvell,kirkwood"
            "synology,ds411j" && "marvell,kirkwood"
            "synology,ds409" && "synology,ds410j" && "marvell,kirkwood"
            "synology,ds409slim" && "marvell,kirkwood"
            "synology,ds212" && "synology,ds212pv10" && "synology,ds212pv10" && "synology,ds212pv20" && "synology,ds213airv10" && "synology,ds213v10" && "marvell,kirkwood"
            "synology,ds212jv10" && "synology,ds212jv20" && "marvell,kirkwood"
            "synology,ds210jv10" && "synology,ds210jv20" && "synology,ds210jv30" && "synology,ds211j" && "marvell,kirkwood"
            "synology,ds209" && "marvell,kirkwood"
            "synology,ds111" && "marvell,kirkwood"
            "synology,ds110jv10" && "synology,ds110jv30" && "marvell,kirkwood"
            "synology,ds109" && "synology,ds110jv20" && "synology,ds110" && "marvell,kirkwood"
            "seagate,goflexnet" && "marvell,kirkwood-88f6281" && "marvell,kirkwood"
            "seagate,dockstar" && "marvell,kirkwood-88f6281" && "marvell,kirkwood"
            "seagate,blackarmor-nas220" && "marvell,kirkwood-88f6192" && "marvell,kirkwood"
            "raidsonic,ib-nas6210-b" && "raidsonic,ib-nas6220-b" && "raidsonic,ib-nas6210" && "raidsonic,ib-nas6220" && "raidsonic,ib-nas62x0" && "marvell,kirkwood-88f6281" && "marvell,kirkwood"
            "qnap,ts419" && "marvell,kirkwood"
            "qnap,ts219" && "marvell,kirkwood"
            "plathome,openblocks-a7" && "marvell,kirkwood-88f6283" && "marvell,kirkwood"
            "plathome,openblocks-a6" && "marvell,kirkwood-88f6283" && "marvell,kirkwood"
            "netgear,readynas-nv"+"-v2" && "netgear,readynas" && "marvell,kirkwood-88f6282" && "marvell,kirkwood"
            "netgear,readynas-duo-v2" && "netgear,readynas" && "marvell,kirkwood-88f6282" && "marvell,kirkwood"
            "mpl,cec4-10" && "mpl,cec4" && "marvell,kirkwood-88f6281" && "marvell,kirkwood"
            "marvell,rd88f6281-z0" && "marvell,rd88f6281" && "marvell,kirkwood-88f6281" && "marvell,kirkwood"
            "marvell,rd88f6281-a" && "marvell,rd88f6281" && "marvell,kirkwood-88f6281" && "marvell,kirkwood"
            "marvell,rd88f6192" && "marvell,kirkwood-88f6192" && "marvell,kirkwood"
            "marvell,openrd-ultimate" && "marvell,openrd" && "marvell,kirkwood-88f6281" && "marvell,kirkwood"
            "marvell,openrd-client" && "marvell,openrd" && "marvell,kirkwood-88f6281" && "marvell,kirkwood"
            "marvell,openrd-base" && "marvell,openrd" && "marvell,kirkwood-88f6281" && "marvell,kirkwood"
            "marvell,mv88f6281gtw-ge" && "marvell,kirkwood-88f6281" && "marvell,kirkwood"
            "marvell,kirkwood"
            "marvell,db-88f6282-bp" && "marvell,kirkwood-88f6282" && "marvell,kirkwood"
            "marvell,db-88f6281-bp" && "marvell,kirkwood-88f6281" && "marvell,kirkwood"
            "lacie,netspace"_"v2" && "marvell,kirkwood-88f6281" && "marvell,kirkwood"
            "lacie,netspace"_"mini"_"v2" && "marvell,kirkwood-88f6192" && "marvell,kirkwood"
            "lacie,netspace"_"max"_"v2" && "marvell,kirkwood-88f6281" && "marvell,kirkwood"
            "lacie,netspace"_"lite"_"v2" && "marvell,kirkwood-88f6192" && "marvell,kirkwood"
            "lacie,net5big"_"v2" && "lacie,netxbig" && "marvell,kirkwood-88f6281" && "marvell,kirkwood"
            "lacie,net2big"_"v2" && "lacie,netxbig" && "marvell,kirkwood-88f6281" && "marvell,kirkwood"
            "lacie,nas2big" && "lacie,netxbig" && "marvell,kirkwood-88f6282" && "marvell,kirkwood"
            "lacie,laplug" && "marvell,kirkwood-88f6192" && "marvell,kirkwood"
            "lacie,inetspace"_"v2" && "marvell,kirkwood-88f6281" && "marvell,kirkwood"
            "lacie,d2net"_"v2" && "lacie,netxbig" && "marvell,kirkwood-88f6281" && "marvell,kirkwood"
            "lacie,cloudbox" && "marvell,kirkwood-88f6702" && "marvell,kirkwood"
            "keymile,km"_"kirkwood" && "marvell,kirkwood-98DX4122" && "marvell,kirkwood"
            "keymile,km"_"fixedeth" && "marvell,kirkwood-98DX4122" && "marvell,kirkwood"
            "iom,ix2-200" && "marvell,kirkwood-88f6281" && "marvell,kirkwood"
            "iom,iconnect-1"."1" && "iom,iconnect" && "marvell,kirkwood-88f6281" && "marvell,kirkwood"
            "hp,t5325" && "marvell,kirkwood-88f6281" && "marvell,kirkwood"
            "globalscale,sheevaplug" && "marvell,kirkwood-88f6281" && "marvell,kirkwood"
            "globalscale,sheevaplug-esata-rev13" && "globalscale,sheevaplug-esata" && "globalscale,sheevaplug" && "marvell,kirkwood-88f6281" && "marvell,kirkwood"
            "globalscale,guruplug-server-plus" && "globalscale,guruplug" && "marvell,kirkwood-88f6281" && "marvell,kirkwood"
            "globalscale,dreamplug-003-ds2001" && "globalscale,dreamplug" && "marvell,kirkwood-88f6281" && "marvell,kirkwood"
            "excito,b3" && "marvell,kirkwood-88f6281" && "marvell,kirkwood"
            "dlink,dns-kirkwood" && "marvell,kirkwood-88f6281" && "marvell,kirkwood"
            "dlink,dns-325-a1" && "dlink,dns-325" && "dlink,dns-kirkwood" && "marvell,kirkwood-88f6281" && "marvell,kirkwood"
            "dlink,dns-320-a1" && "dlink,dns-320" && "dlink,dns-kirkwood" && "marvell,kirkwood-88f6281" && "marvell,kirkwood"
            "dlink,dir-665" && "marvell,kirkwood-88f6281" && "marvell,kirkwood"
            "cloudengines,pogoe02" && "marvell,kirkwood-88f6281" && "marvell,kirkwood"
            "buffalo,lsxhl" && "buffalo,lsxl" && "marvell,kirkwood-88f6281" && "marvell,kirkwood"
            "buffalo,lswxl" && "marvell,kirkwood-88f6281" && "marvell,kirkwood"
            "buffalo,lswvl" && "buffalo,lsvl" && "marvell,kirkwood-88f6282" && "marvell,kirkwood"
            "buffalo,lschlv2" && "buffalo,lsxl" && "marvell,kirkwood-88f6281" && "marvell,kirkwood"

    #address-cells:
    interrupt-parent:
    model:
    #size-cells:

...

# Marvell Kirkwood SoC Family Device Tree Bindings
# ------------------------------------------------
#
# Boards with a SoC of the Marvell Kirkwook family, eg 88f6281
#
# * Required root node properties:
# compatible: must contain "marvell,kirkwood"
#
# In addition, the above compatible shall be extended with the specific
# SoC. Currently known SoC compatibles are:
#
# "marvell,kirkwood-88f6192"
# "marvell,kirkwood-88f6281"
# "marvell,kirkwood-88f6282"
# "marvell,kirkwood-88f6283"
# "marvell,kirkwood-88f6702"
# "marvell,kirkwood-98DX4122"
#
# And in addition, the compatible shall be extended with the specific
# board. Currently known boards are:
#
# "buffalo,lschlv2"
# "buffalo,lswvl"
# "buffalo,lswxl"
# "buffalo,lsxhl"
# "buffalo,lsxl"
# "dlink,dns-320"
# "dlink,dns-320-a1"
# "dlink,dns-325"
# "dlink,dns-325-a1"
# "dlink,dns-kirkwood"
# "excito,b3"
# "globalscale,dreamplug-003-ds2001"
# "globalscale,guruplug"
# "globalscale,guruplug-server-plus"
# "globalscale,sheevaplug"
# "globalscale,sheevaplug"
# "globalscale,sheevaplug-esata"
# "globalscale,sheevaplug-esata-rev13"
# "iom,iconnect"
# "iom,iconnect-1.1"
# "iom,ix2-200"
# "keymile,km_kirkwood"
# "lacie,cloudbox"
# "lacie,inetspace_v2"
# "lacie,laplug"
# "lacie,nas2big"
# "lacie,netspace_lite_v2"
# "lacie,netspace_max_v2"
# "lacie,netspace_mini_v2"
# "lacie,netspace_v2"
# "marvell,db-88f6281-bp"
# "marvell,db-88f6282-bp"
# "marvell,mv88f6281gtw-ge"
# "marvell,rd88f6281"
# "marvell,rd88f6281"
# "marvell,rd88f6281-a0"
# "marvell,rd88f6281-a1"
# "mpl,cec4"
# "mpl,cec4-10"
# "netgear,readynas"
# "netgear,readynas"
# "netgear,readynas-duo-v2"
# "netgear,readynas-nv+-v2"
# "plathome,openblocks-a6"
# "plathome,openblocks-a7"
# "raidsonic,ib-nas6210"
# "raidsonic,ib-nas6210-b"
# "raidsonic,ib-nas6220"
# "raidsonic,ib-nas6220-b"
# "raidsonic,ib-nas62x0"
# "seagate,dockstar"
# "seagate,goflexnet"
# "synology,ds109"
# "synology,ds110jv10"
# "synology,ds110jv20"
# "synology,ds110jv30"
# "synology,ds111"
# "synology,ds209"
# "synology,ds210jv10"
# "synology,ds210jv20"
# "synology,ds212"
# "synology,ds212jv10"
# "synology,ds212jv20"
# "synology,ds212pv10"
# "synology,ds409"
# "synology,ds409slim"
# "synology,ds410j"
# "synology,ds411"
# "synology,ds411j"
# "synology,ds411slim"
# "synology,ds413jv10"
# "synology,rs212"
# "synology,rs409"
# "synology,rs411"
# "synology,rs812"
# "usi,topkick"
# "usi,topkick-1281P2"
# "zyxel,nsa310"
# "zyxel,nsa310a"
```

## Documentation/devicetree/bindings/arm/mediatek/mediatek,infracfg.yaml
```yaml
%YAML 1.2
---
version: 1

id: mediatek,infracfg

title: Mediatek infracfg controller

maintainer:
    -   name: Sascha Hauer <s.hauer@pengutronix.de>

description: >
    TODO

inherits:
    -   id: %ids%

properties:
    -   name: "compatible"
        constraint: |
            "mediatek,mt8135-infracfg" && "syscon"

    #clock-cells:
    reg:
    #reset-cells:

...

# Mediatek infracfg controller
# ============================
#
# The Mediatek infracfg controller provides various clocks and reset
# outputs to the system.
#
# Required Properties:
#
# - compatible: Should be:
# 	- "mediatek,mt8135-infracfg", "syscon"
# 	- "mediatek,mt8173-infracfg", "syscon"
# - #clock-cells: Must be 1
# - #reset-cells: Must be 1
#
# The infracfg controller uses the common clk binding from
# Documentation/devicetree/bindings/clock/clock-bindings.txt
# The available clocks are defined in dt-bindings/clock/mt*-clk.h.
# Also it uses the common reset controller binding from
# Documentation/devicetree/bindings/reset/reset.txt.
# The available reset outputs are defined in
# dt-bindings/reset-controller/mt*-resets.h
#
# Example:
#
# infracfg: power-controller@10001000 {
# 	compatible = "mediatek,mt8173-infracfg", "syscon";
# 	reg = <0 0x10001000 0 0x1000>;
# 	#clock-cells = <1>;
# 	#reset-cells = <1>;
# };
```

## Documentation/devicetree/bindings/arm/mediatek/mediatek,pericfg.yaml
```yaml
%YAML 1.2
---
version: 1

id: mediatek,pericfg

title: Mediatek pericfg controller

maintainer:
    -   name: Sascha Hauer <s.hauer@pengutronix.de>

description: >
    TODO

inherits:
    -   id: %ids%

properties:
    -   name: "compatible"
        constraint: |
            "mediatek,mt8135-pericfg" && "syscon"

    #clock-cells:
    reg:
    #reset-cells:

...

# Mediatek pericfg controller
# ===========================
#
# The Mediatek pericfg controller provides various clocks and reset
# outputs to the system.
#
# Required Properties:
#
# - compatible: Should be:
# 	- "mediatek,mt8135-pericfg", "syscon"
# 	- "mediatek,mt8173-pericfg", "syscon"
# - #clock-cells: Must be 1
# - #reset-cells: Must be 1
#
# The pericfg controller uses the common clk binding from
# Documentation/devicetree/bindings/clock/clock-bindings.txt
# The available clocks are defined in dt-bindings/clock/mt*-clk.h.
# Also it uses the common reset controller binding from
# Documentation/devicetree/bindings/reset/reset.txt.
# The available reset outputs are defined in
# dt-bindings/reset-controller/mt*-resets.h
#
# Example:
#
# pericfg: power-controller@10003000 {
# 	compatible = "mediatek,mt8173-pericfg", "syscon";
# 	reg = <0 0x10003000 0 0x1000>;
# 	#clock-cells = <1>;
# 	#reset-cells = <1>;
# };
```

## Documentation/devicetree/bindings/arm/mediatek/mediatek,topckgen.yaml
```yaml
%YAML 1.2
---
version: 1

id: mediatek,topckgen

title: Mediatek topckgen controller

maintainer:
    -   name: Sascha Hauer <s.hauer@pengutronix.de>

description: >
    TODO

inherits:
    -   id: %ids%

properties:
    -   name: "compatible"
        constraint: |
            "mediatek,mt8135-topckgen"

    #clock-cells:
    reg:

...

# Mediatek topckgen controller
# ============================
#
# The Mediatek topckgen controller provides various clocks to the system.
#
# Required Properties:
#
# - compatible: Should be:
# 	- "mediatek,mt8135-topckgen"
# 	- "mediatek,mt8173-topckgen"
# - #clock-cells: Must be 1
#
# The topckgen controller uses the common clk binding from
# Documentation/devicetree/bindings/clock/clock-bindings.txt
# The available clocks are defined in dt-bindings/clock/mt*-clk.h.
#
# Example:
#
# topckgen: power-controller@10000000 {
# 	compatible = "mediatek,mt8173-topckgen";
# 	reg = <0 0x10000000 0 0x1000>;
# 	#clock-cells = <1>;
# };
```

## Documentation/devicetree/bindings/arm/moxart.yaml
```yaml
%YAML 1.2
---
version: 1

id: moxart

title: MOXA ART device tree bindings

maintainer:
    -   name: Jonas Jensen <jonas.jensen@gmail.com>

description: >
    TODO

inherits:
    -   id: %ids%

properties:
    -   name: "compatible"
        constraint: |
            "moxa,moxart-uc-7112-lx" && "moxa,moxart"
            "moxa,moxart"


...

# MOXA ART device tree bindings
#
# Boards with the MOXA ART SoC shall have the following properties:
#
# Required root node property:
#
# compatible = "moxa,moxart";
#
# Boards:
#
# - UC-7112-LX: embedded computer
#   compatible = "moxa,moxart-uc-7112-lx", "moxa,moxart"
```

## Documentation/devicetree/bindings/arm/mrvl/feroceon.yaml
```yaml
%YAML 1.2
---
version: 1

id: feroceon

title: Marvell Feroceon Cache

maintainer:
    -   name: Andrew Lunn <andrew@lunn.ch>

description: >
    TODO

inherits:
    -   id: %ids%

properties:
    -   name: "compatible"
        constraint: |
            "marvell,kirkwood-cache"
            "marvell,feroceon"

    clock-names:
    clocks:
    device_type:
    reg:

...

# * Marvell Feroceon Cache
#
# Required properties:
# - compatible : Should be either "marvell,feroceon-cache" or
#   	       "marvell,kirkwood-cache".
#
# Optional properties:
# - reg        : Address of the L2 cache control register. Mandatory for
#   	       "marvell,kirkwood-cache", not used by "marvell,feroceon-cache"
#
#
# Example:
# 		l2: l2-cache@20128 {
# 			compatible = "marvell,kirkwood-cache";
# 			reg = <0x20128 0x4>;
# 		};
```

## Documentation/devicetree/bindings/arm/mrvl/mrvl.yaml
```yaml
%YAML 1.2
---
version: 1

id: mrvl

title: Marvell Platforms Device Tree Bindings

maintainer:
    -   name: Haojian Zhuang <haojian.zhuang@gmail.com>

description: >
    TODO

inherits:
    -   id: %ids%

properties:
    -   name: "compatible"
        constraint: |
            "mrvl,pxa910-dkb" && "mrvl,pxa910"
            "mrvl,pxa168-aspenite" && "mrvl,pxa168"
            "mrvl,mmp2-brownstone" && "mrvl,mmp2"

    #address-cells:
    model:
    #size-cells:

...

# Marvell Platforms Device Tree Bindings
# ----------------------------------------------------
#
# PXA168 Aspenite Board
# Required root node properties:
# 	- compatible = "mrvl,pxa168-aspenite", "mrvl,pxa168";
#
# PXA910 DKB Board
# Required root node properties:
# 	- compatible = "mrvl,pxa910-dkb";
#
# MMP2 Brownstone Board
# Required root node properties:
# 	- compatible = "mrvl,mmp2-brownstone";
```
