## Documentation/devicetree/bindings/interrupt-controller/renesas,intc-irqpin.txt
```
DT bindings for the R-/SH-Mobile irqpin controller

Required properties:

- compatible: has to be "renesas,intc-irqpin"
- #interrupt-cells: has to be <2>

Optional properties:

- any properties, listed in interrupts.txt in this directory, and any standard
  resource allocation properties
- sense-bitfield-width: width of a single sense bitfield in the SENSE register,
  if different from the default 4 bits
```

## Documentation/devicetree/bindings/interrupt-controller/ti,omap-intc-irq.yaml
```yaml
%YAML 1.2
---
version: 1

id: ti,omap-intc-irq

title: Omap2/3 intc controller

maintainer:
    -   name: Tony Lindgren <tony@atomide.com>

description: >
    TODO

inherits:
    -   id: %ids%

properties:
    -   name: "compatible"
        constraint: |
            "ti,omap3-intc"
            "ti,omap2-intc"
            "ti,dm816-intc"
            "ti,dm814-intc"
            "ti,am33xx-intc"

    #interrupt-cells:
    interrupt-controller:
    reg:

...

# Omap2/3 intc controller
#
# On TI omap2 and 3 the intc interrupt controller can provide
# 96 or 128 IRQ signals to the ARM host depending on the SoC.
#
# Required Properties:
# - compatible: should be one of
# 			"ti,omap2-intc"
# 			"ti,omap3-intc"
# 			"ti,dm814-intc"
# 			"ti,dm816-intc"
# 			"ti,am33xx-intc"
#
# - interrupt-controller : Identifies the node as an interrupt controller
# - #interrupt-cells : Specifies the number of cells needed to encode interrupt
# 		     source, should be 1 for intc
# - interrupts: interrupt reference to primary interrupt controller
#
# Please refer to interrupts.txt in this directory for details of the common
# Interrupt Controllers bindings used by client devices.
#
# Example:
# 	intc: interrupt-controller@48200000 {
# 		compatible = "ti,omap3-intc";
# 		interrupt-controller;
# 		#interrupt-cells = <1>;
# 		reg = <0x48200000 0x1000>;
# 	};
```

## Documentation/devicetree/bindings/interrupts.yaml
```yaml
%YAML 1.2
---
version: 1

id: interrupts

properties:
    "interrupt-parent":
        category: required
        type: phandle
    "interrupts":
        category: required
        type: int

...
```

## Documentation/devicetree/bindings/iommu/ti,omap-iommu.yaml
```yaml
%YAML 1.2
---
version: 1

id: ti,omap-iommu

title: OMAP2+ IOMMU

maintainer:
    -   name: Florian Vaussard <florian.vaussard@epfl.ch>

description: >
    TODO

inherits:
    -   id: %ids%

properties:
    -   name: "compatible"
        constraint: |
            "ti,omap4-iommu"
            "ti,omap2-iommu"

    interrupts:
    #iommu-cells:
    reg:
    status:
    ti,hwmods:
    ti,#tlb-entries:

...

# OMAP2+ IOMMU
#
# Required properties:
# - compatible : Should be one of,
# 		"ti,omap2-iommu" for OMAP2/OMAP3 IOMMU instances
# 		"ti,omap4-iommu" for OMAP4/OMAP5 IOMMU instances
# 		"ti,dra7-iommu" for DRA7xx IOMMU instances
# - ti,hwmods  : Name of the hwmod associated with the IOMMU instance
# - reg        : Address space for the configuration registers
# - interrupts : Interrupt specifier for the IOMMU instance
# - #iommu-cells : Should be 0. OMAP IOMMUs are all "single-master" devices,
#                  and needs no additional data in the pargs specifier. Please
#                  also refer to the generic bindings document for more info
#                  on this property,
#                      Documentation/devicetree/bindings/iommu/iommu.txt
#
# Optional properties:
# - ti,#tlb-entries : Number of entries in the translation look-aside buffer.
#                     Should be either 8 or 32 (default: 32)
# - ti,iommu-bus-err-back : Indicates the IOMMU instance supports throwing
# 		          back a bus error response on MMU faults.
#
# Example:
# 	/* OMAP3 ISP MMU */
# 	mmu_isp: mmu@480bd400 {
# 		#iommu-cells = <0>;
# 		compatible = "ti,omap2-iommu";
# 		reg = <0x480bd400 0x80>;
# 		interrupts = <24>;
# 		ti,hwmods = "mmu_isp";
# 		ti,#tlb-entries = <8>;
# 	};
```

## Documentation/devicetree/bindings/mailbox/brcm,bcm2835-mbox.yaml
```yaml
%YAML 1.2
---
version: 1

id: brcm,bcm2835-mbox

title: Broadcom BCM2835 VideoCore mailbox IPC

maintainer:
    -   name: Lubomir Rintel <lkundrak@v3.sk>

description: >
    TODO

inherits:
    -   id: %ids%

properties:
    -   name: "compatible"
        constraint: |
            "brcm,bcm2835-mbox"

    interrupts:
    #mbox-cells:
    reg:

...

# Broadcom BCM2835 VideoCore mailbox IPC
#
# Required properties:
#
# - compatible:	Should be "brcm,bcm2835-mbox"
# - reg:		Specifies base physical address and size of the registers
# - interrupts:	The interrupt number
# 		  See bindings/interrupt-controller/brcm,bcm2835-armctrl-ic.txt
# - #mbox-cells:	Specifies the number of cells needed to encode a mailbox
# 		  channel. The value shall be 0, since there is only one
# 		  mailbox channel implemented by the device.
#
# Example:
#
# mailbox: mailbox@7e00b800 {
# 	compatible = "brcm,bcm2835-mbox";
# 	reg = <0x7e00b880 0x40>;
# 	interrupts = <0 1>;
# 	#mbox-cells = <0>;
# };
#
# firmware: firmware {
# 	compatible = "raspberrypi,firmware";
# 	mboxes = <&mailbox>;
# 	#power-domain-cells = <1>;
# };
```

## Documentation/devicetree/bindings/media/exynos-fimc-lite.yaml
```yaml
%YAML 1.2
---
version: 1

id: exynos-fimc-lite

title: Exynos4x12/Exynos5 SoC series camera host interface (FIMC-LITE)

maintainer:
    -   name: Sylwester Nawrocki <s.nawrocki@samsung.com>

description: >
    TODO

inherits:
    -   id: %ids%

properties:
    -   name: "compatible"
        constraint: |
            "samsung,exynos4212-fimc-lite"

    clock-names:
    clocks:
    interrupts:
    iommus:
    power-domains:
    reg:
    status:

...

# Exynos4x12/Exynos5 SoC series camera host interface (FIMC-LITE)
#
# Required properties:
#
# - compatible	: should be one of:
# 		  "samsung,exynos4212-fimc-lite" for Exynos4212/4412 SoCs,
# 		  "samsung,exynos5250-fimc-lite" for Exynos5250 compatible
# 		   devices;
# - reg		: physical base address and size of the device memory mapped
# 		  registers;
# - interrupts	: should contain FIMC-LITE interrupt;
# - clocks	: FIMC LITE gate clock should be specified in this property.
# - clock-names	: should contain "flite" entry.
#
# Each FIMC device should have an alias in the aliases node, in the form of
# fimc-lite<n>, where <n> is an integer specifying the IP block instance.
```

## Documentation/devicetree/bindings/media/exynos5-gsc.yaml
```yaml
%YAML 1.2
---
version: 1

id: exynos5-gsc

title: Samsung Exynos5 G-Scaler device

maintainer:
    -   name: Shaik Ameer Basha <shaik.ameer@samsung.com>

description: >
    TODO

inherits:
    -   id: %ids%

properties:
    -   name: "compatible"
        constraint: |
            "samsung,exynos5-gsc"

    clock-names:
    clocks:
    interrupts:
    iommu:
    iommus:
    power-domains:
    reg:

...

# * Samsung Exynos5 G-Scaler device
#
# G-Scaler is used for scaling and color space conversion on EXYNOS5 SoCs.
#
# Required properties:
# - compatible: should be "samsung,exynos5-gsc"
# - reg: should contain G-Scaler physical address location and length.
# - interrupts: should contain G-Scaler interrupt number
#
# Example:
#
# gsc_0:  gsc@0x13e00000 {
# 	compatible = "samsung,exynos5-gsc";
# 	reg = <0x13e00000 0x1000>;
# 	interrupts = <0 85 0>;
# };
#
# Aliases:
# Each G-Scaler node should have a numbered alias in the aliases node,
# in the form of gscN, N = 0...3. G-Scaler driver uses these aliases
# to retrieve the device IDs using "of_alias_get_id()" call.
#
# Example:
#
# aliases {
# 	gsc0 =&gsc_0;
# 	gsc1 =&gsc_1;
# 	gsc2 =&gsc_2;
# 	gsc3 =&gsc_3;
# };
```

## Documentation/devicetree/bindings/media/gpio-ir-receiver.yaml
```yaml
%YAML 1.2
---
version: 1

id: gpio-ir-receiver

title: Device-Tree bindings for GPIO IR receiver

maintainer:
    -   name: Sebastian Hesselbarth <sebastian.hesselbarth@gmail.com>

description: >
    TODO

inherits:
    -   id: %ids%

properties:
    -   name: "compatible"
        constraint: |
            "gpio-ir-receiver"

    gpios:
    pinctrl-0:
    pinctrl-names:

...

# Device-Tree bindings for GPIO IR receiver
#
# Required properties:
# 	- compatible: should be "gpio-ir-receiver".
# 	- gpios: specifies GPIO used for IR signal reception.
#
# Optional properties:
# 	- linux,rc-map-name: Linux specific remote control map name.
#
# Example node:
#
# 	ir: ir-receiver {
# 		compatible = "gpio-ir-receiver";
# 		gpios = <&gpio0 19 1>;
# 		linux,rc-map-name = "rc-rc6-mce";
# 	};
```

## Documentation/devicetree/bindings/media/hix5hd2-ir.yaml
```yaml
%YAML 1.2
---
version: 1

id: hix5hd2-ir

title: Device-Tree bindings for hix5hd2 ir IP

maintainer:
    -   name: Guoxiong Yan <yanguoxiong@huawei.com>

description: >
    TODO

inherits:
    -   id: %ids%

properties:
    -   name: "compatible"
        constraint: |
            "hisilicon,hix5hd2-ir"

    clocks:
    hisilicon,power-syscon:
    interrupts:
    reg:

...

# Device-Tree bindings for hix5hd2 ir IP
#
# Required properties:
# 	- compatible: Should contain "hisilicon,hix5hd2-ir".
# 	- reg: Base physical address of the controller and length of memory
# 	  mapped region.
# 	- interrupts: interrupt-specifier for the sole interrupt generated by
# 	  the device. The interrupt specifier format depends on the interrupt
# 	  controller parent.
# 	- clocks: clock phandle and specifier pair.
# 	- hisilicon,power-syscon: phandle of syscon used to control power.
#
# Optional properties:
# 	- linux,rc-map-name : Remote control map name.
#
# Example node:
#
# 	ir: ir@f8001000 {
# 		compatible = "hisilicon,hix5hd2-ir";
# 		reg = <0xf8001000 0x1000>;
# 		interrupts = <0 47 4>;
# 		clocks = <&clock HIX5HD2_FIXED_24M>;
# 		hisilicon,power-syscon = <&sysctrl>;
# 		linux,rc-map-name = "rc-tivo";
# 	};
```

## Documentation/devicetree/bindings/media/meson-ir.yaml
```yaml
%YAML 1.2
---
version: 1

id: meson-ir

title: Amlogic Meson IR remote control receiver

maintainer:
    -   name: Beniamino Galvani <b.galvani@gmail.com>

description: >
    TODO

inherits:
    -   id: %ids%

properties:
    -   name: "compatible"
        constraint: |
            "amlogic,meson6-ir"

    interrupts:
    pinctrl-0:
    pinctrl-names:
    reg:
    status:

...

# * Amlogic Meson IR remote control receiver
#
# Required properties:
#  - compatible	: should be "amlogic,meson6-ir"
#  - reg		: physical base address and length of the device registers
#  - interrupts	: a single specifier for the interrupt from the device
#
# Example:
#
# 	ir-receiver@c8100480 {
# 		compatible= "amlogic,meson6-ir";
# 		reg = <0xc8100480 0x20>;
# 		interrupts = <0 15 1>;
# 	};
```

## Documentation/devicetree/bindings/memory-controllers/renesas,h8300-bsc.yaml
```yaml
%YAML 1.2
---
version: 1

id: renesas,h8300-bsc

title: H8/300 bus controller

maintainer:
    -   name: Yoshinori Sato <ysato@users.sourceforge.jp>

description: >
    TODO

inherits:
    -   id: %ids%

properties:
    -   name: "compatible"
        constraint: |
            "renesas,h8s-bsc" && "renesas,h8300-bsc"
            "renesas,h8300h-bsc" && "renesas,h8300-bsc"


...

# * H8/300 bus controller
#
# Required properties:
#   - compatible: Must be "renesas,h8300-bsc".
#   - reg: Base address and length of BSC registers.
#
# Example.
# 	bsc: memory-controller@fee01e {
# 		compatible = "renesas,h8300h-bsc", "renesas,h8300-bsc";
# 		reg = <0xfee01e 8>;
# 	};
#
```

## Documentation/devicetree/bindings/memory-controllers/synopsys.yaml
```yaml
%YAML 1.2
---
version: 1

id: synopsys

title: Binding for Synopsys IntelliDDR Multi Protocol Memory Controller

maintainer:
    -   name: Punnaiah Choudary Kalluri <punnaiah.choudary.kalluri@xilinx.com>

description: >
    TODO

inherits:
    -   id: %ids%

properties:
    -   name: "compatible"
        constraint: |
            "xlnx,zynq-ddrc-a05"

    reg:

...

# Binding for Synopsys IntelliDDR Multi Protocol Memory Controller
#
# This controller has an optional ECC support in half-bus width (16-bit)
# configuration. The ECC controller corrects one bit error and detects
# two bit errors.
#
# Required properties:
#  - compatible: Should be 'xlnx,zynq-ddrc-a05'
#  - reg: Base address and size of the controllers memory area
#
# Example:
# 	memory-controller@f8006000 {
# 		compatible = "xlnx,zynq-ddrc-a05";
# 		reg = <0xf8006000 0x1000>;
# 	};
```

## Documentation/devicetree/bindings/mfd/atmel-gpbr.yaml
```yaml
%YAML 1.2
---
version: 1

id: atmel-gpbr

title: Device tree bindings for Atmel GPBR (General Purpose Backup Registers)

maintainer:
    -   name: Lee Jones <lee.jones@linaro.org>

description: >
    TODO

inherits:
    -   id: %ids%

properties:
    -   name: "compatible"
        constraint: |
            "atmel,at91sam9260-gpbr" && "syscon"

    reg:
    status:

...

# * Device tree bindings for Atmel GPBR (General Purpose Backup Registers)
#
# The GPBR are a set of battery-backed registers.
#
# Required properties:
# - compatible:		"atmel,at91sam9260-gpbr", "syscon"
# - reg:			contains offset/length value of the GPBR memory
# 			region.
#
# Example:
#
# gpbr: gpbr@fffffd50 {
# 	compatible = "atmel,at91sam9260-gpbr", "syscon";
# 	reg = <0xfffffd50 0x10>;
# };
```

## Documentation/devicetree/bindings/mfd/qriox.yaml
```yaml
%YAML 1.2
---
version: 1

id: qriox

title: KEYMILE qrio Board Control CPLD

maintainer:
    -   name: Valentin Longchamp <valentin.longchamp@keymile.com>

description: >
    TODO

inherits:
    -   id: %ids%

properties:
    -   name: "compatible"
        constraint: |
            "keymile,qriox"

    reg:

...

# KEYMILE qrio Board Control CPLD
#
# The qrio is a multifunction device that controls the KEYMILE boards based on
# the kmp204x design.
# It is consists of a reset controller, watchdog timer, LEDs, and 2 IRQ capable
# GPIO blocks.
#
# Required properties:
# - compatible: "keymile,qriox"
# - reg: access on the parent local bus (chip select, offset in chip select, size)
#
# Example:
#
# 	board-control@1,0 {
# 		compatible = "keymile,qriox";
# 		reg = <1 0 0x80>;
# 	};
```
