## Documentation/devicetree/bindings/mfd/syscon.yaml
```yaml
%YAML 1.2
---
version: 1

id: syscon

title: System Controller Registers R/W driver

maintainer:
    -   name: Dong Aisheng <dong.aisheng@linaro.org>

description: >
    TODO

inherits:
    -   id: %ids%

properties:
    -   name: "compatible"
        constraint: |
            "xlnx,zynq-slcr" && "syscon" && "simple-bus"
            "syscon" && "simple-mfd"
            "syscon" && "simple-bus"
            "syscon"
            "st,stih416-transport-syscfg" && "syscon"
            "st,stih416-sbc-syscfg" && "syscon"
            "st,stih416-rear-syscfg" && "syscon"
            "st,stih416-lpm-syscfg" && "syscon"
            "st,stih416-fvdp-lite-syscfg" && "syscon"
            "st,stih416-fvdp-fe-syscfg" && "syscon"
            "st,stih416-front-syscfg" && "syscon"
            "st,stih416-cpu-syscfg" && "syscon"
            "st,stih416-compo-syscfg" && "syscon"
            "st,stih415-system-syscfg" && "syscon"
            "st,stih415-sbc-syscfg" && "syscon"
            "st,stih415-right-syscfg" && "syscon"
            "st,stih415-rear-syscfg" && "syscon"
            "st,stih415-lpm-syscfg" && "syscon"
            "st,stih415-left-syscfg" && "syscon"
            "st,stih415-front-syscfg" && "syscon"
            "st,stih407-sbc-syscfg" && "syscon"
            "st,stih407-sbc-reg-syscfg" && "syscon"
            "st,stih407-rear-syscfg" && "syscon"
            "st,stih407-lpm-syscfg" && "syscon"
            "st,stih407-front-syscfg" && "syscon"
            "st,stih407-flash-syscfg" && "syscon"
            "st,stih407-core-syscfg" && "syscon"
            "socionext,uniphier-system-bus-controller-misc" && "syscon"
            "socionext,proxstream2-pinctrl" && "syscon"
            "socionext,ph1-sld8-pinctrl" && "syscon"
            "socionext,ph1-pro5-pinctrl" && "syscon"
            "socionext,ph1-pro4-pinctrl" && "syscon"
            "socionext,ph1-ld6b-pinctrl" && "syscon"
            "socionext,ph1-ld4-pinctrl" && "syscon"
            "samsung-s5pv210-pmu" && "syscon"
            "samsung,exynos4415-pmu" && "syscon"
            "samsung,exynos3-sysreg" && "syscon"
            "rockchip,rk3288-sgrf" && "syscon"
            "rockchip,rk3288-pmu" && "syscon"
            "rockchip,rk3288-grf" && "syscon"
            "fsl,vf610-anatop" && "syscon"
            "fsl,imx7d-iomuxc-gpr" && "syscon"
            "fsl,imx7d-anatop" && "fsl,imx6q-anatop" && "syscon" && "simple-bus"
            "fsl,imx6ul-iomuxc-gpr" && "syscon"
            "fsl,imx6ul-anatop" && "fsl,imx6q-anatop" && "syscon" && "simple-bus"
            "fsl,imx6sx-ocotp" && "syscon"
            "fsl,imx6sx-iomuxc-gpr" && "fsl,imx6q-iomuxc-gpr" && "syscon"
            "fsl,imx6sx-anatop" && "fsl,imx6q-anatop" && "syscon" && "simple-bus"
            "fsl,imx6sl-ocotp" && "syscon"
            "fsl,imx6sl-iomuxc-gpr" && "fsl,imx6q-iomuxc-gpr" && "syscon"
            "fsl,imx6sl-anatop" && "fsl,imx6q-anatop" && "syscon" && "simple-bus"
            "fsl,imx6q-ocotp" && "syscon"
            "fsl,imx6q-iomuxc-gpr" && "syscon"
            "fsl,imx6q-anatop" && "syscon" && "simple-bus"
            "fsl,imx53-iomuxc-gpr" && "syscon"
            "fsl,imx50-iomuxc-gpr" && "syscon"
            "cnxt,cx92755-uc" && "syscon"
            "atmel,at91sam9260-bus-matrix" && "syscon"

    reg:

...

# * System Controller Registers R/W driver
#
# System controller node represents a register region containing a set
# of miscellaneous registers. The registers are not cohesive enough to
# represent as any specific type of device. The typical use-case is for
# some other node's driver, or platform-specific code, to acquire a
# reference to the syscon node (e.g. by phandle, node path, or search
# using a specific compatible value), interrogate the node (or associated
# OS driver) to determine the location of the registers, and access the
# registers directly.
#
# Required properties:
# - compatible: Should contain "syscon".
# - reg: the register region can be accessed from syscon
#
# Examples:
# gpr: iomuxc-gpr@020e0000 {
# 	compatible = "fsl,imx6q-iomuxc-gpr", "syscon";
# 	reg = <0x020e0000 0x38>;
# };
```

## Documentation/devicetree/bindings/misc/arm-charlcd.yaml
```yaml
%YAML 1.2
---
version: 1

id: arm-charlcd

title: ARM Versatile Character LCD

maintainer:
    -   name: Rob Herring <robh@kernel.org>

description: >
    TODO

inherits:
    -   id: %ids%

properties:
    -   name: "compatible"
        constraint: |
            "arm,versatile-lcd"

    clock-names:
    clocks:
    interrupt-parent:
    interrupts:
    reg:

...

# ARM Versatile Character LCD
# -----------------------------------------------------
# This binding defines the character LCD interface found on ARM Versatile AB
# and PB reference platforms.
#
# Required properties:
# - compatible : "arm,versatile-clcd"
# - reg : Location and size of character LCD registers
#
# Optional properties:
# - interrupts - single interrupt for character LCD. The character LCD can
#   operate in polled mode without an interrupt.
#
# Example:
# 	lcd@10008000 {
# 		compatible = "arm,versatile-lcd";
# 		reg = <0x10008000 0x1000>;
# 	};
```

## Documentation/devicetree/bindings/misc/brcm,kona-smc.yaml
```yaml
%YAML 1.2
---
version: 1

id: brcm,kona-smc

title: Broadcom Secure Monitor Bounce buffer

maintainer:
    -   name: Scott Branden <sbranden@broadcom.com>

description: >
    TODO

inherits:
    -   id: %ids%

properties:
    -   name: "compatible"
        constraint: |
            "brcm,bcm21664-smc" && "brcm,kona-smc"
            "brcm,bcm11351-smc" && "brcm,kona-smc"

    reg:

...

# Broadcom Secure Monitor Bounce buffer
# -----------------------------------------------------
# This binding defines the location of the bounce buffer
# used for non-secure to secure communications.
#
# Required properties:
# - compatible : "brcm,kona-smc"
# - DEPRECATED: compatible : "bcm,kona-smc"
# - reg : Location and size of bounce buffer
#
# Example:
# 	smc@0x3404c000 {
# 		compatible = "brcm,bcm11351-smc", "brcm,kona-smc";
# 		reg = <0x3404c000 0x400>; //1 KiB in SRAM
# 	};
```

## Documentation/devicetree/bindings/misc/nvidia,tegra20-apbmisc.yaml
```yaml
%YAML 1.2
---
version: 1

id: nvidia,tegra20-apbmisc

title: NVIDIA Tegra20/Tegra30/Tegr114/Tegra124 apbmisc block

maintainer:
    -   name: Paul Walmsley <paul@pwsan.com>

description: >
    TODO

inherits:
    -   id: %ids%

properties:
    -   name: "compatible"
        constraint: |
            "nvidia,tegra30-apbmisc" && "nvidia,tegra20-apbmisc"
            "nvidia,tegra20-apbmisc"
            "nvidia,tegra124-apbmisc" && "nvidia,tegra20-apbmisc"
            "nvidia,tegra114-apbmisc" && "nvidia,tegra20-apbmisc"

    reg:

...

# NVIDIA Tegra20/Tegra30/Tegr114/Tegra124 apbmisc block
#
# Required properties:
# - compatible : For Tegra20, must be "nvidia,tegra20-apbmisc".  For Tegra30,
#   must be "nvidia,tegra30-apbmisc".  Otherwise, must contain
#   "nvidia,<chip>-apbmisc", plus one of the above, where <chip> is tegra114,
#   tegra124, tegra132.
# - reg: Should contain 2 entries: the first entry gives the physical address
#        and length of the registers which contain revision and debug features.
#        The second entry gives the physical address and length of the
#        registers indicating the strapping options.
#
# Optional properties:
# - nvidia,long-ram-code: If present, the RAM code is long (4 bit). If not, short (2 bit).
```

## Documentation/devicetree/bindings/mmc/atmel-hsmci.yaml
```yaml
%YAML 1.2
---
version: 1

id: atmel-hsmci

title: Atmel High Speed MultiMedia Card Interface

maintainer:
    -   name: Boris BREZILLON <b.brezillon@overkiz.com>

description: >
    TODO

inherits:
    -   id: %ids%

properties:
    -   name: "compatible"
        constraint: |
            "atmel,hsmci"

    #address-cells:
    clock-names:
    clocks:
    dma-names:
    dmas:
    interrupts:
    pinctrl-0:
    pinctrl-names:
    reg:
    #size-cells:
    status:
    vmmc-supply:
    vqmmc-supply:

...

# * Atmel High Speed MultiMedia Card Interface
#
# This controller on atmel products provides an interface for MMC, SD and SDIO
# types of memory cards.
#
# This file documents differences between the core properties described
# by mmc.txt and the properties used by the atmel-mci driver.
#
# 1) MCI node
#
# Required properties:
# - compatible: should be "atmel,hsmci"
# - #address-cells: should be one. The cell is the slot id.
# - #size-cells: should be zero.
# - at least one slot node
# - clock-names: tuple listing input clock names.
# 	Required elements: "mci_clk"
# - clocks: phandles to input clocks.
#
# The node contains child nodes for each slot that the platform uses
#
# Example MCI node:
#
# mmc0: mmc@f0008000 {
# 	compatible = "atmel,hsmci";
# 	reg = <0xf0008000 0x600>;
# 	interrupts = <12 4>;
# 	#address-cells = <1>;
# 	#size-cells = <0>;
# 	clock-names = "mci_clk";
# 	clocks = <&mci0_clk>;
#
# 	[ child node definitions...]
# };
#
# 2) slot nodes
#
# Required properties:
# - reg: should contain the slot id.
# - bus-width: number of data lines connected to the controller
#
# Optional properties:
# - cd-gpios: specify GPIOs for card detection
# - cd-inverted: invert the value of external card detect gpio line
# - wp-gpios: specify GPIOs for write protection
#
# Example slot node:
#
# slot@0 {
# 	reg = <0>;
# 	bus-width = <4>;
# 	cd-gpios = <&pioD 15 0>
# 	cd-inverted;
# };
#
# Example full MCI node:
# mmc0: mmc@f0008000 {
# 	compatible = "atmel,hsmci";
# 	reg = <0xf0008000 0x600>;
# 	interrupts = <12 4>;
# 	#address-cells = <1>;
# 	#size-cells = <0>;
# 	slot@0 {
# 		reg = <0>;
# 		bus-width = <4>;
# 		cd-gpios = <&pioD 15 0>
# 		cd-inverted;
# 	};
# 	slot@1 {
# 		reg = <1>;
# 		bus-width = <4>;
# 	};
# };
```

## Documentation/devicetree/bindings/mmc/orion-sdio.yaml
```yaml
%YAML 1.2
---
version: 1

id: orion-sdio

title: Marvell orion-sdio controller

maintainer:
    -   name: Thomas Petazzoni <thomas.petazzoni@free-electrons.com>

description: >
    TODO

inherits:
    -   id: %ids%

properties:
    -   name: "compatible"
        constraint: |
            "marvell,orion-sdio"

    broken-cd:
    bus-width:
    cap-mmc-highspeed:
    cap-sd-highspeed:
    cap-sdio-irq:
    cd-gpios:
    clocks:
    interrupts:
    non-removable:
    pinctrl-0:
    pinctrl-names:
    reg:
    status:
    wp-gpios:

...

# * Marvell orion-sdio controller
#
# This file documents differences between the core properties in mmc.txt
# and the properties used by the orion-sdio driver.
#
# - compatible: Should be "marvell,orion-sdio"
# - clocks: reference to the clock of the SDIO interface
#
# Example:
#
# 	mvsdio@d00d4000 {
# 		compatible = "marvell,orion-sdio";
# 		reg = <0xd00d4000 0x200>;
# 		interrupts = <54>;
# 		clocks = <&gateclk 17>;
# 		status = "disabled";
# 	};
```

## Documentation/devicetree/bindings/mmc/pxa-mmc.yaml
```yaml
%YAML 1.2
---
version: 1

id: pxa-mmc

title: PXA MMC drivers

maintainer:
    -   name: Daniel Mack <zonque@gmail.com>

description: >
    TODO

inherits:
    -   id: %ids%

properties:
    -   name: "compatible"
        constraint: |
            "marvell,pxa-mmc"


...

# * PXA MMC drivers
#
# Driver bindings for the PXA MCI (MMC/SDIO) interfaces
#
# Required properties:
# - compatible: Should be "marvell,pxa-mmc".
# - vmmc-supply: A regulator for VMMC
#
# Optional properties:
# - marvell,detect-delay-ms: sets the detection delay timeout in ms.
# - marvell,gpio-power: GPIO spec for the card power enable pin
#
# This file documents differences between the core properties in mmc.txt
# and the properties used by the pxa-mmc driver.
#
# Examples:
#
# mmc0: mmc@41100000 {
# 	compatible = "marvell,pxa-mmc";
# 	reg = <0x41100000 0x1000>;
# 	interrupts = <23>;
# 	cd-gpios = <&gpio 23 0>;
# 	wp-gpios = <&gpio 24 0>;
# };
#
```

## Documentation/devicetree/bindings/mmc/rockchip-dw-mshc.yaml
```yaml
%YAML 1.2
---
version: 1

id: rockchip-dw-mshc

title: Rockchip specific extensions to the Synopsys Designware Mobile

maintainer:
    -   name: Addy Ke <addy.ke@rock-chips.com>

description: >
    TODO

inherits:
    -   id: %ids%

properties:
    -   name: "compatible"
        constraint: |
            "rockchip,rk3288-dw-mshc"
            "rockchip,rk2928-dw-mshc"

    broken-cd:
    bus-width:
    cap-mmc-highspeed:
    clock-names:
    clocks:
    disable-wp:
    fifo-depth:
    interrupts:
    non-removable:
    num-slots:
    pinctrl-0:
    pinctrl-names:
    reg:
    status:
    vmmc-supply:
    vqmmc-supply:

...

# * Rockchip specific extensions to the Synopsys Designware Mobile
#   Storage Host Controller
#
# The Synopsys designware mobile storage host controller is used to interface
# a SoC with storage medium such as eMMC or SD/MMC cards. This file documents
# differences between the core Synopsys dw mshc controller properties described
# by synopsys-dw-mshc.txt and the properties used by the Rockchip specific
# extensions to the Synopsys Designware Mobile Storage Host Controller.
#
# Required Properties:
#
# * compatible: should be
# 	- "rockchip,rk2928-dw-mshc": for Rockchip RK2928 and following,
# 							before RK3288
# 	- "rockchip,rk3288-dw-mshc": for Rockchip RK3288
#
# Example:
#
# 	rkdwmmc0@12200000 {
# 		compatible = "rockchip,rk3288-dw-mshc";
# 		reg = <0x12200000 0x1000>;
# 		interrupts = <0 75 0>;
# 		#address-cells = <1>;
# 		#size-cells = <0>;
# 	};
```

## Documentation/devicetree/bindings/mmc/sdhci-dove.yaml
```yaml
%YAML 1.2
---
version: 1

id: sdhci-dove

title: Marvell sdhci-dove controller

maintainer:
    -   name: Sebastian Hesselbarth <sebastian.hesselbarth@googlemail.com>

description: >
    TODO

inherits:
    -   id: %ids%

properties:
    -   name: "compatible"
        constraint: |
            "marvell,dove-sdhci"

    bus-width:
    cd-gpios:
    clocks:
    interrupts:
    non-removable:
    pinctrl-0:
    pinctrl-names:
    reg:
    reset-gpio:
    status:
    vmmc-supply:
    wp-gpios:

...

# * Marvell sdhci-dove controller
#
# This file documents differences between the core properties in mmc.txt
# and the properties used by the sdhci-pxav2 and sdhci-pxav3 drivers.
#
# - compatible: Should be "marvell,dove-sdhci".
#
# Example:
#
# sdio0: sdio@92000 {
# 	compatible = "marvell,dove-sdhci";
# 	reg = <0x92000 0x100>;
# 	interrupts = <35>;
# };
```

## Documentation/devicetree/bindings/mmc/sdhci-sirf.yaml
```yaml
%YAML 1.2
---
version: 1

id: sdhci-sirf

title: SiRFprimII/marco/atlas6 SDHCI Controller

maintainer:
    -   name: Barry Song <Baohua.Song@csr.com>

description: >
    TODO

inherits:
    -   id: %ids%

properties:
    -   name: "compatible"
        constraint: |
            "sirf,prima2-sdhc"

    bus-width:
    cell-index:
    clocks:
    interrupts:
    reg:
    status:

...

# * SiRFprimII/marco/atlas6 SDHCI Controller
#
# This file documents differences between the core properties in mmc.txt
# and the properties used by the sdhci-sirf driver.
#
# Required properties:
# - compatible: sirf,prima2-sdhc
#
# Optional properties:
# - cd-gpios: card detect gpio, with zero flags.
#
# Example:
#
# 	sd0: sdhci@56000000 {
# 		compatible = "sirf,prima2-sdhc";
# 		reg = <0xcd000000 0x100000>;
# 		cd-gpios = <&gpio 6 0>;
# 	};
```
