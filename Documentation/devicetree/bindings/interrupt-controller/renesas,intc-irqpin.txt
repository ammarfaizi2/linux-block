## Documentation/devicetree/bindings/mmc/socfpga-dw-mshc.yaml
```yaml
%YAML 1.2
---
version: 1

id: socfpga-dw-mshc

title: Altera SOCFPGA specific extensions to the Synopsys Designware Mobile

maintainer:
    -   name: Dinh Nguyen <dinguyen@altera.com>

description: >
    TODO

inherits:
    -   id: %ids%

properties:
    -   name: "compatible"
        constraint: |
            "altr,socfpga-dw-mshc"

    #address-cells:
    broken-cd:
    bus-width:
    cap-mmc-highspeed:
    cap-sd-highspeed:
    card-detect-delay:
    cd-gpios:
    clock-names:
    clocks:
    fifo-depth:
    interrupts:
    num-slots:
    reg:
    #size-cells:
    status:
    vmmc-supply:
    vqmmc-supply:

...

# * Altera SOCFPGA specific extensions to the Synopsys Designware Mobile
#   Storage Host Controller
#
# The Synopsys designware mobile storage host controller is used to interface
# a SoC with storage medium such as eMMC or SD/MMC cards. This file documents
# differences between the core Synopsys dw mshc controller properties described
# by synopsys-dw-mshc.txt and the properties used by the Altera SOCFPGA specific
# extensions to the Synopsys Designware Mobile Storage Host Controller.
#
# Required Properties:
#
# * compatible: should be
# 	- "altr,socfpga-dw-mshc": for Altera's SOCFPGA platform
#
# Example:
#
# 	mmc: dwmmc0@ff704000 {
# 		compatible = "altr,socfpga-dw-mshc";
# 		reg = <0xff704000 0x1000>;
# 		interrupts = <0 129 4>;
# 		#address-cells = <1>;
# 		#size-cells = <0>;
# 	};
```
