## Documentation/devicetree/bindings/powerpc/fsl/cpm_qe/serial.yaml
```yaml
%YAML 1.2
---
version: 1

id: serial

title: Serial

maintainer:
    -   name: 

description: >
    TODO

inherits:
    -   id: %ids%

properties:
    -   name: "compatible"
        constraint: |
            "fsl,mpc885-smc-uart" && "fsl,cpm1-smc-uart"
            "fsl,mpc885-scc-uart" && "fsl,cpm1-scc-uart"
            "fsl,mpc875-smc-uart" && "fsl,cpm1-smc-uart"
            "fsl,mpc866-smc-uart" && "fsl,cpm1-smc-uart"
            "fsl,mpc860-smc-uart" && "fsl,cpm1-smc-uart"
            "fsl,mpc8560-scc-uart" && "fsl,cpm2-scc-uart"
            "fsl,mpc8280-scc-uart" && "fsl,cpm2-scc-uart"
            "fsl,mpc8272-scc-uart" && "fsl,cpm2-scc-uart"
            "fsl,mpc8248-smc-uart" && "fsl,cpm2-smc-uart"
            "fsl,mpc8248-scc-uart" && "fsl,cpm2-scc-uart"
            "fsl,mpc8247-smc-uart" && "fsl,cpm2-smc-uart"

    current-speed:
    device_type:
    fsl,cpm-brg:
    fsl,cpm-command:
    interrupt-parent:
    interrupts:
    reg:

...

# * Serial
#
# Currently defined compatibles:
# - fsl,cpm1-smc-uart
# - fsl,cpm2-smc-uart
# - fsl,cpm1-scc-uart
# - fsl,cpm2-scc-uart
# - fsl,qe-uart
#
# Modem control lines connected to GPIO controllers are listed in the gpios
# property as described in booting-without-of.txt, section IX.1 in the following
# order:
#
# CTS, RTS, DCD, DSR, DTR, and RI.
#
# The gpios property is optional and can be left out when control lines are
# not used.
#
# Example:
#
# 	serial@11a00 {
# 		device_type = "serial";
# 		compatible = "fsl,mpc8272-scc-uart",
# 			     "fsl,cpm2-scc-uart";
# 		reg = <11a00 20 8000 100>;
# 		interrupts = <28 8>;
# 		interrupt-parent = <&PIC>;
# 		fsl,cpm-brg = <1>;
# 		fsl,cpm-command = <00800000>;
# 		gpios = <&gpio_c 15 0
# 			 &gpio_d 29 0>;
# 	};
```

## Documentation/devicetree/bindings/powerpc/fsl/gtm.yaml
```yaml
%YAML 1.2
---
version: 1

id: gtm

title: Freescale General-purpose Timers Module

maintainer:
    -   name: 

description: >
    TODO

inherits:
    -   id: %ids%

properties:
    -   name: "compatible"
        constraint: |
            "fsl,mpc8360-qe-gtm" && "fsl,qe-gtm" && "fsl,gtm"
            "fsl,mpc8315-gtm" && "fsl,gtm"
            "fsl,mpc8313-gtm" && "fsl,gtm"
            "fsl,mpc8308-gtm" && "fsl,gtm"

    clock-frequency:
    interrupt-parent:
    interrupts:
    reg:

...

# * Freescale General-purpose Timers Module
#
# Required properties:
#   - compatible : should be
#     "fsl,<chip>-gtm", "fsl,gtm" for SOC GTMs
#     "fsl,<chip>-qe-gtm", "fsl,qe-gtm", "fsl,gtm" for QE GTMs
#     "fsl,<chip>-cpm2-gtm", "fsl,cpm2-gtm", "fsl,gtm" for CPM2 GTMs
#   - reg : should contain gtm registers location and length (0x40).
#   - interrupts : should contain four interrupts.
#   - interrupt-parent : interrupt source phandle.
#   - clock-frequency : specifies the frequency driving the timer.
#
# Example:
#
# timer@500 {
# 	compatible = "fsl,mpc8360-gtm", "fsl,gtm";
# 	reg = <0x500 0x40>;
# 	interrupts = <90 8 78 8 84 8 72 8>;
# 	interrupt-parent = <&ipic>;
# 	/* filled by u-boot */
# 	clock-frequency = <0>;
# };
#
# timer@440 {
# 	compatible = "fsl,mpc8360-qe-gtm", "fsl,qe-gtm", "fsl,gtm";
# 	reg = <0x440 0x40>;
# 	interrupts = <12 13 14 15>;
# 	interrupt-parent = <&qeic>;
# 	/* filled by u-boot */
# 	clock-frequency = <0>;
# };
```

## Documentation/devicetree/bindings/powerpc/fsl/lbc.yaml
```yaml
%YAML 1.2
---
version: 1

id: lbc

title: Chipselect/Local Bus

maintainer:
    -   name: John Ogness <john.ogness@linutronix.de>

description: >
    TODO

inherits:
    -   id: %ids%

properties:
    -   name: "compatible"
        constraint: |
            "jedec-flash"
            "fsl,mpc8280-localbus" && "fsl,pq2-localbus"
            "fsl,mpc8272-localbus" && "fsl,pq2-localbus"
            "fsl,mpc8272ads-bcsr"
            "fsl,mpc8248-localbus" && "fsl,pq2-localbus" && "simple-bus"
            "fsl,mpc8247-localbus" && "fsl,pq2-localbus" && "simple-bus"

    #address-cells:
    ranges:
    reg:
    #size-cells:

...

# * Chipselect/Local Bus
#
# Properties:
# - name : Should be localbus
# - #address-cells : Should be either two or three.  The first cell is the
#                    chipselect number, and the remaining cells are the
#                    offset into the chipselect.
# - #size-cells : Either one or two, depending on how large each chipselect
#                 can be.
# - ranges : Each range corresponds to a single chipselect, and cover
#            the entire access window as configured.
#
# Example:
# 	localbus@f0010100 {
# 		compatible = "fsl,mpc8272-localbus",
# 			   "fsl,pq2-localbus";
# 		#address-cells = <2>;
# 		#size-cells = <1>;
# 		reg = <0xf0010100 0x40>;
#
# 		ranges = <0x0 0x0 0xfe000000 0x02000000
# 			  0x1 0x0 0xf4500000 0x00008000
# 			  0x2 0x0 0xfd810000 0x00010000>;
#
# 		flash@0,0 {
# 			compatible = "jedec-flash";
# 			reg = <0x0 0x0 0x2000000>;
# 			bank-width = <4>;
# 			device-width = <1>;
# 		};
#
# 		board-control@1,0 {
# 			reg = <0x1 0x0 0x20>;
# 			compatible = "fsl,mpc8272ads-bcsr";
# 		};
#
# 		simple-periph@2,0 {
# 			compatible = "fsl,elbc-gpcm-uio";
# 			reg = <0x2 0x0 0x10000>;
# 			elbc-gpcm-br = <0xfd810800>;
# 			elbc-gpcm-or = <0xffff09f7>;
# 		};
# 	};
```

## Documentation/devicetree/bindings/powerpc/fsl/mcu-mpc8349emitx.yaml
```yaml
%YAML 1.2
---
version: 1

id: mcu-mpc8349emitx

title: Freescale MPC8349E-mITX-compatible Power Management Micro Controller Unit (MCU)

maintainer:
    -   name: 

description: >
    TODO

inherits:
    -   id: %ids%

properties:
    -   name: "compatible"
        constraint: |
            "fsl,mc9s08qg8-mpc8379erdb" && "fsl,mcu-mpc8349emitx"
            "fsl,mc9s08qg8-mpc8378erdb" && "fsl,mcu-mpc8349emitx"
            "fsl,mc9s08qg8-mpc8377erdb" && "fsl,mcu-mpc8349emitx"
            "fsl,mc9s08qg8-mpc8349emitx" && "fsl,mcu-mpc8349emitx"
            "fsl,mc9s08qg8-mpc8315erdb" && "fsl,mcu-mpc8349emitx"

    #gpio-cells:
    gpio-controller:
    reg:

...

# Freescale MPC8349E-mITX-compatible Power Management Micro Controller Unit (MCU)
#
# Required properties:
# - compatible : "fsl,<mcu-chip>-<board>", "fsl,mcu-mpc8349emitx".
# - reg : should specify I2C address (0x0a).
# - #gpio-cells : should be 2.
# - gpio-controller : should be present.
#
# Example:
#
# mcu@0a {
# 	#gpio-cells = <2>;
# 	compatible = "fsl,mc9s08qg8-mpc8349emitx",
# 		     "fsl,mcu-mpc8349emitx";
# 	reg = <0x0a>;
# 	gpio-controller;
# };
```

## Documentation/devicetree/bindings/pps/pps-gpio.yaml
```yaml
%YAML 1.2
---
version: 1

id: pps-gpio

title: Device-Tree Bindings for a PPS Signal on GPIO

maintainer:
    -   name: Jan Luebbe <jlu@pengutronix.de>

description: >
    TODO

inherits:
    -   id: %ids%

properties:
    -   name: "compatible"
        constraint: |
            "pps-gpio"

    gpios:
    pinctrl-0:
    pinctrl-names:
    status:

...

# Device-Tree Bindings for a PPS Signal on GPIO
#
# These properties describe a PPS (pulse-per-second) signal connected to
# a GPIO pin.
#
# Required properties:
# - compatible: should be "pps-gpio"
# - gpios: one PPS GPIO in the format described by ../gpio/gpio.txt
#
# Optional properties:
# - assert-falling-edge: when present, assert is indicated by a falling edge
#                        (instead of by a rising edge)
#
# Example:
# 	pps {
# 		compatible = "pps-gpio";
# 		gpios = <&gpio2 6 0>;
#
# 		assert-falling-edge;
# 	};
```

## Documentation/devicetree/bindings/pwm/imx-pwm.yaml
```yaml
%YAML 1.2
---
version: 1

id: imx-pwm

title: Freescale i.MX PWM controller

maintainer:
    -   name: Laurent Pinchart <laurent.pinchart+renesas@ideasonboard.com>

description: >
    TODO

inherits:
    -   id: %ids%

properties:
    -   name: "compatible"
        constraint: |
            "fsl,imx6ul-pwm" && "fsl,imx27-pwm"
            "fsl,imx6sx-pwm" && "fsl,imx27-pwm"
            "fsl,imx6sl-pwm" && "fsl,imx27-pwm"
            "fsl,imx6q-pwm" && "fsl,imx27-pwm"
            "fsl,imx53-pwm" && "fsl,imx27-pwm"
            "fsl,imx51-pwm" && "fsl,imx27-pwm"
            "fsl,imx50-pwm" && "fsl,imx27-pwm"
            "fsl,imx27-pwm"
            "fsl,imx25-pwm" && "fsl,imx27-pwm"
            "fsl,imx1-pwm"

    clock-names:
    clocks:
    interrupts:
    #pwm-cells:
    reg:

...

# Freescale i.MX PWM controller
#
# Required properties:
# - compatible : should be "fsl,<soc>-pwm" and one of the following
#    compatible strings:
#   - "fsl,imx1-pwm" for PWM compatible with the one integrated on i.MX1
#   - "fsl,imx27-pwm" for PWM compatible with the one integrated on i.MX27
# - reg: physical base address and length of the controller's registers
# - #pwm-cells: should be 2. See pwm.txt in this directory for a description of
#   the cells format.
# - clocks : Clock specifiers for both ipg and per clocks.
# - clock-names : Clock names should include both "ipg" and "per"
# See the clock consumer binding,
# 	Documentation/devicetree/bindings/clock/clock-bindings.txt
# - interrupts: The interrupt for the pwm controller
#
# Example:
#
# pwm1: pwm@53fb4000 {
# 	#pwm-cells = <2>;
# 	compatible = "fsl,imx53-pwm", "fsl,imx27-pwm";
# 	reg = <0x53fb4000 0x4000>;
# 	clocks = <&clks IMX5_CLK_PWM1_IPG_GATE>,
# 		 <&clks IMX5_CLK_PWM1_HF_GATE>;
# 	clock-names = "ipg", "per";
# 	interrupts = <61>;
# };
```

## Documentation/devicetree/bindings/pwm/lpc32xx-pwm.yaml
```yaml
%YAML 1.2
---
version: 1

id: lpc32xx-pwm

title: LPC32XX PWM controller

maintainer:
    -   name: Alexandre Pereira da Silva <aletes.xgr@gmail.com>

description: >
    TODO

inherits:
    -   id: %ids%

properties:
    -   name: "compatible"
        constraint: |
            "nxp,lpc3220-pwm"

    reg:
    status:

...

# LPC32XX PWM controller
#
# Required properties:
# - compatible: should be "nxp,lpc3220-pwm"
# - reg: physical base address and length of the controller's registers
#
# Examples:
#
# pwm@0x4005C000 {
# 	compatible = "nxp,lpc3220-pwm";
# 	reg = <0x4005C000 0x8>;
# };
```

## Documentation/devicetree/bindings/pwm/mxs-pwm.yaml
```yaml
%YAML 1.2
---
version: 1

id: mxs-pwm

title: Freescale MXS PWM controller

maintainer:
    -   name: Shawn Guo <shawn.guo@linaro.org>

description: >
    TODO

inherits:
    -   id: %ids%

properties:
    -   name: "compatible"
        constraint: |
            "fsl,imx28-pwm" && "fsl,imx23-pwm"
            "fsl,imx23-pwm"

    clocks:
    fsl,pwm-number:
    pinctrl-0:
    pinctrl-names:
    #pwm-cells:
    reg:
    status:

...

# Freescale MXS PWM controller
#
# Required properties:
# - compatible: should be "fsl,imx23-pwm"
# - reg: physical base address and length of the controller's registers
# - #pwm-cells: should be 2. See pwm.txt in this directory for a description of
#   the cells format.
# - fsl,pwm-number: the number of PWM devices
#
# Example:
#
# pwm: pwm@80064000 {
# 	compatible = "fsl,imx28-pwm", "fsl,imx23-pwm";
# 	reg = <0x80064000 0x2000>;
# 	#pwm-cells = <2>;
# 	fsl,pwm-number = <8>;
# };
```
