## Documentation/devicetree/bindings/powerpc/4xx/emac.yaml
```yaml
%YAML 1.2
---
version: 1

id: emac

title:     4xx/Axon EMAC ethernet nodes

maintainer:
    -   name: Anatol Pomozov <anatol.pomozov@gmail.com>

description: >
    TODO

inherits:
    -   id: %ids%

properties:
    -   name: "compatible"
        constraint: |
            "ibm,zmii-460gt" && "ibm,zmii"
            "ibm,zmii-460ex" && "ibm,zmii"
            "ibm,zmii-440gx" && "ibm,zmii"
            "ibm,zmii-440grx" && "ibm,zmii"
            "ibm,zmii-440gp" && "ibm,zmii"
            "ibm,zmii-440epx" && "ibm,zmii"
            "ibm,zmii-440ep" && "ibm,zmii-440gp" && "ibm,zmii"
            "ibm,rgmii-460sx" && "ibm,rgmii"
            "ibm,rgmii-460gt" && "ibm,rgmii"
            "ibm,rgmii-460ex" && "ibm,rgmii"
            "ibm,rgmii-440grx" && "ibm,rgmii"
            "ibm,rgmii-440epx" && "ibm,rgmii"
            "ibm,rgmii-405exr" && "ibm,rgmii"
            "ibm,rgmii-405ex" && "ibm,rgmii"
            "ibm,rgmii"
            "ibm,mcmal-476gtr" && "ibm,mcmal2"
            "ibm,mcmal-460sx" && "ibm,mcmal2"
            "ibm,mcmal-460gt" && "ibm,mcmal2"
            "ibm,mcmal-460ex" && "ibm,mcmal2"
            "ibm,mcmal-440spe" && "ibm,mcmal2"
            "ibm,mcmal-440gx" && "ibm,mcmal2"
            "ibm,mcmal-440grx" && "ibm,mcmal2"
            "ibm,mcmal-440gp" && "ibm,mcmal"
            "ibm,mcmal-440epx" && "ibm,mcmal2"
            "ibm,mcmal-440ep" && "ibm,mcmal-440gp" && "ibm,mcmal"
            "ibm,mcmal-405gp" && "ibm,mcmal"
            "ibm,mcmal-405ez" && "ibm,mcmal"
            "ibm,mcmal-405exr" && "ibm,mcmal2"
            "ibm,mcmal-405ex" && "ibm,mcmal2"
            "ibm,mcmal-405ep" && "ibm,mcmal"
            "ibm,mcmal2"
            "ibm,emac4" && "ibm-emac4sync"
            "ibm,emac-460sx" && "ibm,emac4"
            "ibm,emac-440spe" && "ibm,emac4"
            "ibm,emac-440gx" && "ibm,emac4"
            "ibm,emac-440grx" && "ibm,emac-440epx" && "ibm,emac4"
            "ibm,emac-440gp" && "ibm,emac"
            "ibm,emac-440epx" && "ibm,emac4"
            "ibm,emac-440ep" && "ibm,emac-440gp" && "ibm,emac"
            "ibm,emac-405gp" && "ibm,emac"
            "ibm,emac-405ez" && "ibm,emac"
            "ibm,emac-405ep" && "ibm,emac"

    cell-index:
    device_type:
    interrupt-parent:
    interrupts:
    linux,network-index:
    local-mac-address:
    mal-device:
    mal-rx-channel:
    mal-tx-channel:
    max-frame-size:
    mdio-device:
    phy-map:
    phy-mode:
    reg:
    rx-fifo-size:
    tx-fifo-size:

...

#     4xx/Axon EMAC ethernet nodes
#
#     The EMAC ethernet controller in IBM and AMCC 4xx chips, and also
#     the Axon bridge.  To operate this needs to interact with a this
#     special McMAL DMA controller, and sometimes an RGMII or ZMII
#     interface.  In addition to the nodes and properties described
#     below, the node for the OPB bus on which the EMAC sits must have a
#     correct clock-frequency property.
#
#       i) The EMAC node itself
#
#     Required properties:
#     - device_type       : "network"
#
#     - compatible        : compatible list, contains 2 entries, first is
# 			  "ibm,emac-CHIP" where CHIP is the host ASIC (440gx,
# 			  405gp, Axon) and second is either "ibm,emac" or
# 			  "ibm,emac4".  For Axon, thus, we have: "ibm,emac-axon",
# 			  "ibm,emac4"
#     - interrupts        : <interrupt mapping for EMAC IRQ and WOL IRQ>
#     - interrupt-parent  : optional, if needed for interrupt mapping
#     - reg               : <registers mapping>
#     - local-mac-address : 6 bytes, MAC address
#     - mal-device        : phandle of the associated McMAL node
#     - mal-tx-channel    : 1 cell, index of the tx channel on McMAL associated
# 			  with this EMAC
#     - mal-rx-channel    : 1 cell, index of the rx channel on McMAL associated
# 			  with this EMAC
#     - cell-index        : 1 cell, hardware index of the EMAC cell on a given
# 			  ASIC (typically 0x0 and 0x1 for EMAC0 and EMAC1 on
# 			  each Axon chip)
#     - max-frame-size    : 1 cell, maximum frame size supported in bytes
#     - rx-fifo-size      : 1 cell, Rx fifo size in bytes for 10 and 100 Mb/sec
# 			  operations.
# 			  For Axon, 2048
#     - tx-fifo-size      : 1 cell, Tx fifo size in bytes for 10 and 100 Mb/sec
# 			  operations.
# 			  For Axon, 2048.
#     - fifo-entry-size   : 1 cell, size of a fifo entry (used to calculate
# 			  thresholds).
# 			  For Axon, 0x00000010
#     - mal-burst-size    : 1 cell, MAL burst size (used to calculate thresholds)
# 			  in bytes.
# 			  For Axon, 0x00000100 (I think ...)
#     - phy-mode          : string, mode of operations of the PHY interface.
# 			  Supported values are: "mii", "rmii", "smii", "rgmii",
# 			  "tbi", "gmii", rtbi", "sgmii".
# 			  For Axon on CAB, it is "rgmii"
#     - mdio-device       : 1 cell, required iff using shared MDIO registers
# 			  (440EP).  phandle of the EMAC to use to drive the
# 			  MDIO lines for the PHY used by this EMAC.
#     - zmii-device       : 1 cell, required iff connected to a ZMII.  phandle of
# 			  the ZMII device node
#     - zmii-channel      : 1 cell, required iff connected to a ZMII.  Which ZMII
# 			  channel or 0xffffffff if ZMII is only used for MDIO.
#     - rgmii-device      : 1 cell, required iff connected to an RGMII. phandle
# 			  of the RGMII device node.
# 			  For Axon: phandle of plb5/plb4/opb/rgmii
#     - rgmii-channel     : 1 cell, required iff connected to an RGMII.  Which
# 			  RGMII channel is used by this EMAC.
# 			  Fox Axon: present, whatever value is appropriate for each
# 			  EMAC, that is the content of the current (bogus) "phy-port"
# 			  property.
#
#     Optional properties:
#     - phy-address       : 1 cell, optional, MDIO address of the PHY. If absent,
# 			  a search is performed.
#     - phy-map           : 1 cell, optional, bitmap of addresses to probe the PHY
# 			  for, used if phy-address is absent. bit 0x00000001 is
# 			  MDIO address 0.
# 			  For Axon it can be absent, though my current driver
# 			  doesn't handle phy-address yet so for now, keep
# 			  0x00ffffff in it.
#     - rx-fifo-size-gige : 1 cell, Rx fifo size in bytes for 1000 Mb/sec
# 			  operations (if absent the value is the same as
# 			  rx-fifo-size).  For Axon, either absent or 2048.
#     - tx-fifo-size-gige : 1 cell, Tx fifo size in bytes for 1000 Mb/sec
# 			  operations (if absent the value is the same as
# 			  tx-fifo-size). For Axon, either absent or 2048.
#     - tah-device        : 1 cell, optional. If connected to a TAH engine for
# 			  offload, phandle of the TAH device node.
#     - tah-channel       : 1 cell, optional. If appropriate, channel used on the
# 			  TAH engine.
#
#     Example:
#
# 	EMAC0: ethernet@40000800 {
# 		device_type = "network";
# 		compatible = "ibm,emac-440gp", "ibm,emac";
# 		interrupt-parent = <&UIC1>;
# 		interrupts = <1c 4 1d 4>;
# 		reg = <40000800 70>;
# 		local-mac-address = [00 04 AC E3 1B 1E];
# 		mal-device = <&MAL0>;
# 		mal-tx-channel = <0 1>;
# 		mal-rx-channel = <0>;
# 		cell-index = <0>;
# 		max-frame-size = <5dc>;
# 		rx-fifo-size = <1000>;
# 		tx-fifo-size = <800>;
# 		phy-mode = "rmii";
# 		phy-map = <00000001>;
# 		zmii-device = <&ZMII0>;
# 		zmii-channel = <0>;
# 	};
#
#       ii) McMAL node
#
#     Required properties:
#     - device_type        : "dma-controller"
#     - compatible         : compatible list, containing 2 entries, first is
# 			   "ibm,mcmal-CHIP" where CHIP is the host ASIC (like
# 			   emac) and the second is either "ibm,mcmal" or
# 			   "ibm,mcmal2".
# 			   For Axon, "ibm,mcmal-axon","ibm,mcmal2"
#     - interrupts         : <interrupt mapping for the MAL interrupts sources:
#                            5 sources: tx_eob, rx_eob, serr, txde, rxde>.
#                            For Axon: This is _different_ from the current
# 			   firmware.  We use the "delayed" interrupts for txeob
# 			   and rxeob. Thus we end up with mapping those 5 MPIC
# 			   interrupts, all level positive sensitive: 10, 11, 32,
# 			   33, 34 (in decimal)
#     - dcr-reg            : < DCR registers range >
#     - dcr-parent         : if needed for dcr-reg
#     - num-tx-chans       : 1 cell, number of Tx channels
#     - num-rx-chans       : 1 cell, number of Rx channels
#
#       iii) ZMII node
#
#     Required properties:
#     - compatible         : compatible list, containing 2 entries, first is
# 			   "ibm,zmii-CHIP" where CHIP is the host ASIC (like
# 			   EMAC) and the second is "ibm,zmii".
# 			   For Axon, there is no ZMII node.
#     - reg                : <registers mapping>
#
#       iv) RGMII node
#
#     Required properties:
#     - compatible         : compatible list, containing 2 entries, first is
# 			   "ibm,rgmii-CHIP" where CHIP is the host ASIC (like
# 			   EMAC) and the second is "ibm,rgmii".
#                            For Axon, "ibm,rgmii-axon","ibm,rgmii"
#     - reg                : <registers mapping>
#     - revision           : as provided by the RGMII new version register if
# 			   available.
# 			   For Axon: 0x0000012a
#
```

## Documentation/devicetree/bindings/powerpc/fsl/cpm_qe/cpm/brg.yaml
```yaml
%YAML 1.2
---
version: 1

id: brg

title: Baud Rate Generators

maintainer:
    -   name: 

description: >
    TODO

inherits:
    -   id: %ids%

properties:
    -   name: "compatible"
        constraint: |
            "fsl,mpc885-brg" && "fsl,cpm1-brg" && "fsl,cpm-brg"
            "fsl,mpc875-brg" && "fsl,cpm1-brg" && "fsl,cpm-brg"
            "fsl,mpc866-brg" && "fsl,cpm1-brg" && "fsl,cpm-brg"
            "fsl,mpc860-brg" && "fsl,cpm1-brg" && "fsl,cpm-brg"
            "fsl,mpc8560-brg" && "fsl,cpm2-brg" && "fsl,cpm-brg"
            "fsl,mpc8555-brg" && "fsl,cpm2-brg" && "fsl,cpm-brg"
            "fsl,mpc8541-brg" && "fsl,cpm2-brg" && "fsl,cpm-brg"
            "fsl,mpc8280-brg" && "fsl,cpm2-brg" && "fsl,cpm-brg"
            "fsl,mpc8272-brg" && "fsl,cpm2-brg" && "fsl,cpm-brg"
            "fsl,mpc8248-brg" && "fsl,cpm2-brg" && "fsl,cpm-brg"
            "fsl,mpc8247-brg" && "fsl,cpm2-brg" && "fsl,cpm-brg"

    reg:

...

# * Baud Rate Generators
#
# Currently defined compatibles:
# fsl,cpm-brg
# fsl,cpm1-brg
# fsl,cpm2-brg
#
# Properties:
# - reg : There may be an arbitrary number of reg resources; BRG
#   numbers are assigned to these in order.
# - clock-frequency : Specifies the base frequency driving
#   the BRG.
#
# Example:
# 	brg@119f0 {
# 		compatible = "fsl,mpc8272-brg",
# 			     "fsl,cpm2-brg",
# 			     "fsl,cpm-brg";
# 		reg = <119f0 10 115f0 10>;
# 		clock-frequency = <d#25000000>;
# 	};
```

## Documentation/devicetree/bindings/powerpc/fsl/cpm_qe/cpm/pic.yaml
```yaml
%YAML 1.2
---
version: 1

id: pic

title: Interrupt Controllers

maintainer:
    -   name: 

description: >
    TODO

inherits:
    -   id: %ids%

properties:
    -   name: "compatible"
        constraint: |
            "fsl,mpc885-pic" && "fsl,pq1-pic"
            "fsl,mpc885-cpm-pic" && "fsl,cpm1-pic"
            "fsl,mpc875-pic" && "fsl,pq1-pic"
            "fsl,mpc875-cpm-pic" && "fsl,cpm1-pic"
            "fsl,mpc866-pic" && "fsl,pq1-pic"
            "fsl,mpc866-cpm-pic" && "fsl,cpm1-pic"
            "fsl,mpc860-pic" && "fsl,pq1-pic"
            "fsl,mpc860-cpm-pic" && "fsl,cpm1-pic"
            "fsl,mpc8560-cpm-pic" && "fsl,cpm2-pic"
            "fsl,mpc8555-cpm-pic" && "fsl,cpm2-pic"
            "fsl,mpc8541-cpm-pic" && "fsl,cpm2-pic"
            "fsl,mpc8280-pic" && "fsl,cpm2-pic"
            "fsl,mpc8272-pic" && "fsl,cpm2-pic"

    #interrupt-cells:
    interrupt-controller:
    reg:

...

# * Interrupt Controllers
#
# Currently defined compatibles:
# - fsl,cpm1-pic
#   - only one interrupt cell
# - fsl,pq1-pic
# - fsl,cpm2-pic
#   - second interrupt cell is level/sense:
#     - 2 is falling edge
#     - 8 is active low
#
# Example:
# 	interrupt-controller@10c00 {
# 		#interrupt-cells = <2>;
# 		interrupt-controller;
# 		reg = <10c00 80>;
# 		compatible = "mpc8272-pic", "fsl,cpm2-pic";
# 	};
```

## Documentation/devicetree/bindings/powerpc/fsl/cpm_qe/cpm/usb.yaml
```yaml
%YAML 1.2
---
version: 1

id: usb

title: USB (Universal Serial Bus Controller)

maintainer:
    -   name: 

description: >
    TODO

inherits:
    -   id: %ids%

properties:
    -   name: "compatible"
        constraint: |
            "fsl,mpc885-usb" && "fsl,cpm1-usb"
            "fsl,mpc8280-usb" && "fsl,cpm2-usb"
            "fsl,mpc8248-usb" && "fsl,cpm2-usb"

    #address-cells:
    fsl,cpm-command:
    interrupt-parent:
    interrupts:
    reg:
    #size-cells:

...

# * USB (Universal Serial Bus Controller)
#
# Properties:
# - compatible : "fsl,cpm1-usb", "fsl,cpm2-usb", "fsl,qe-usb"
#
# Example:
# 	usb@11bc0 {
# 		#address-cells = <1>;
# 		#size-cells = <0>;
# 		compatible = "fsl,cpm2-usb";
# 		reg = <11b60 18 8b00 100>;
# 		interrupts = <b 8>;
# 		interrupt-parent = <&PIC>;
# 		fsl,cpm-command = <2e600000>;
# 	};
```

## Documentation/devicetree/bindings/powerpc/fsl/cpm_qe/network.yaml
```yaml
%YAML 1.2
---
version: 1

id: network

title: Network

maintainer:
    -   name: Grant Likely <grant.likely@linaro.org>

description: >
    TODO

inherits:
    -   id: %ids%

properties:
    -   name: "compatible"
        constraint: |
            "fsl,pq2fads-mdio-bitbang" && "fsl,mpc8280-mdio-bitbang" && "fsl,cpm2-mdio-bitbang"
            "fsl,mpc885-scc-enet" && "fsl,cpm1-scc-enet"
            "fsl,mpc885-fec-mdio" && "fsl,pq1-fec-mdio"
            "fsl,mpc875-fec-mdio" && "fsl,pq1-fec-mdio"
            "fsl,mpc866-scc-enet" && "fsl,cpm1-scc-enet"
            "fsl,mpc866-fec-mdio" && "fsl,pq1-fec-mdio"
            "fsl,mpc860-scc-enet" && "fsl,cpm1-scc-enet"
            "fsl,mpc8560-fcc-enet" && "fsl,cpm2-fcc-enet"
            "fsl,mpc8280-fcc-enet" && "fsl,cpm2-fcc-enet"
            "fsl,mpc8272-fcc-enet" && "fsl,cpm2-fcc-enet"
            "fsl,mpc8272ads-mdio-bitbang" && "fsl,mpc8272-mdio-bitbang" && "fsl,cpm2-mdio-bitbang"
            "fsl,mpc8248-fcc-enet" && "fsl,cpm2-fcc-enet"
            "fsl,mpc8247-scc-enet" && "fsl,cpm2-scc-enet"
            "fsl,cpm2-mdio-bitbang"
            "fsl,cpm2-fcc-enet"

    device_type:
    fsl,cpm-command:
    interrupt-parent:
    interrupts:
    linux,network-index:
    local-mac-address:
    phy-handle:
    reg:

...

# * Network
#
# Currently defined compatibles:
# - fsl,cpm1-scc-enet
# - fsl,cpm2-scc-enet
# - fsl,cpm1-fec-enet
# - fsl,cpm2-fcc-enet (third resource is GFEMR)
# - fsl,qe-enet
#
# Example:
#
# 	ethernet@11300 {
# 		compatible = "fsl,mpc8272-fcc-enet",
# 			     "fsl,cpm2-fcc-enet";
# 		reg = <11300 20 8400 100 11390 1>;
# 		local-mac-address = [ 00 00 00 00 00 00 ];
# 		interrupts = <20 8>;
# 		interrupt-parent = <&PIC>;
# 		phy-handle = <&PHY0>;
# 		fsl,cpm-command = <12000300>;
# 	};
#
# * MDIO
#
# Currently defined compatibles:
# fsl,pq1-fec-mdio (reg is same as first resource of FEC device)
# fsl,cpm2-mdio-bitbang (reg is port C registers)
#
# Properties for fsl,cpm2-mdio-bitbang:
# fsl,mdio-pin : pin of port C controlling mdio data
# fsl,mdc-pin : pin of port C controlling mdio clock
#
# Example:
# 	mdio@10d40 {
# 		compatible = "fsl,mpc8272ads-mdio-bitbang",
# 			     "fsl,mpc8272-mdio-bitbang",
# 			     "fsl,cpm2-mdio-bitbang";
# 		reg = <10d40 14>;
# 		#address-cells = <1>;
# 		#size-cells = <0>;
# 		fsl,mdio-pin = <12>;
# 		fsl,mdc-pin = <13>;
# 	};
```
