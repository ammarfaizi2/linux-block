## Documentation/devicetree/bindings/pinctrl/marvell,mvebu-pinctrl.yaml
```yaml
%YAML 1.2
---
version: 1

id: marvell,mvebu-pinctrl

title: Marvell SoC pinctrl core driver for mpp

maintainer:
    -   name: Sebastian Hesselbarth <sebastian.hesselbarth@gmail.com>

description: >
    TODO

inherits:
    -   id: %ids%

properties:
    -   name: "compatible"
        constraint: |
            "marvell,mv88f6928-pinctrl"
            "marvell,mv88f6920-pinctrl"
            "marvell,mv88f6828-pinctrl"
            "marvell,mv88f6820-pinctrl"
            "marvell,mv88f6810-pinctrl"
            "marvell,mv88f6720-pinctrl"
            "marvell,mv88f6710-pinctrl"
            "marvell,mv78460-pinctrl"
            "marvell,mv78260-pinctrl"
            "marvell,mv78230-pinctrl"
            "marvell,98dx4122-pinctrl"
            "marvell,88f6282-pinctrl"
            "marvell,88f6281-pinctrl"
            "marvell,88f6192-pinctrl"

    pinctrl-0:
    pinctrl-names:
    reg:

...

# * Marvell SoC pinctrl core driver for mpp
#
# The pinctrl driver enables Marvell SoCs to configure the multi-purpose pins
# (mpp) to a specific function. For each SoC family there is a SoC specific
# driver using this core driver.
#
# Please refer to pinctrl-bindings.txt in this directory for details of the
# common pinctrl bindings used by client devices, including the meaning of the
# phrase "pin configuration node".
#
# A Marvell SoC pin configuration node is a node of a group of pins which can
# be used for a specific device or function. Each node requires one or more
# mpp pins or group of pins and a mpp function common to all pins.
#
# Required properties for pinctrl driver:
# - compatible: "marvell,<soc>-pinctrl"
#   Please refer to each marvell,<soc>-pinctrl.txt binding doc for supported SoCs.
#
# Required properties for pin configuration node:
# - marvell,pins: string array of mpp pins or group of pins to be muxed.
# - marvell,function: string representing a function to mux to for all
#     marvell,pins given in this pin configuration node. The function has to be
#     common for all marvell,pins. Please refer to marvell,<soc>-pinctrl.txt for
#     valid pin/pin group names and available function names for each SoC.
#
# Examples:
#
# uart1: serial@12100 {
# 	compatible = "ns16550a";
# 	reg = <0x12100 0x100>;
# 	reg-shift = <2>;
# 	interrupts = <7>;
#
# 	pinctrl-0 = <&pmx_uart1_sw>;
# 	pinctrl-names = "default";
# };
#
# pinctrl: pinctrl@d0200 {
# 	compatible = "marvell,dove-pinctrl";
# 	reg = <0xd0200 0x14>, <0xd0440 0x04>, <0xd802c 0x08>;
#
# 	pmx_uart1_sw: pmx-uart1-sw {
# 		marvell,pins = "mpp_uart1";
# 		marvell,function = "uart1";
# 	};
# };
```

## Documentation/devicetree/bindings/pinctrl/ti,omap-pinctrl.yaml
```yaml
%YAML 1.2
---
version: 1

id: ti,omap-pinctrl

title: OMAP Pinctrl definitions

maintainer:
    -   name: Nishanth Menon <nm@ti.com>

description: >
    TODO

inherits:
    -   id: %ids%

properties:
    -   name: "compatible"
        constraint: |
            "ti,omap5-padconf" && "pinctrl-single"
            "ti,omap4-padconf" && "pinctrl-single"
            "ti,omap3-padconf" && "pinctrl-single"
            "ti,omap2430-padconf" && "pinctrl-single"
            "ti,omap2420-padconf" && "pinctrl-single"
            "ti,dra7-padconf" && "pinctrl-single"
            "ti,am437-padconf" && "pinctrl-single"

    #address-cells:
    #interrupt-cells:
    interrupt-controller:
    pinctrl-0:
    pinctrl-1:
    pinctrl-names:
    pinctrl-single,function-mask:
    pinctrl-single,register-width:
    reg:
    #size-cells:

...

# OMAP Pinctrl definitions
#
# Required properties:
# - compatible : Should be one of:
#   "ti,omap2420-padconf" - OMAP2420 compatible pinctrl
#   "ti,omap2430-padconf" - OMAP2430 compatible pinctrl
#   "ti,omap3-padconf" - OMAP3 compatible pinctrl
#   "ti,omap4-padconf" - OMAP4 compatible pinctrl
#   "ti,omap5-padconf" - OMAP5 compatible pinctrl
#   "ti,dra7-padconf" - DRA7 compatible pinctrl
#   "ti,am437-padconf" - AM437x compatible pinctrl
#
# See Documentation/devicetree/bindings/pinctrl/pinctrl-single.txt for further details.
```

## Documentation/devicetree/bindings/power/isp1704.yaml
```yaml
%YAML 1.2
---
version: 1

id: isp1704

title: Binding for NXP ISP1704 USB Charger Detection

maintainer:
    -   name: Sebastian Reichel <sre@debian.org>

description: >
    TODO

inherits:
    -   id: %ids%

properties:
    -   name: "compatible"
        constraint: |
            "nxp,isp1704"

    nxp,enable-gpio:
    usb-phy:

...

# Binding for NXP ISP1704 USB Charger Detection
#
# Required properties:
# - compatible: Should contain one of the following:
#  * "nxp,isp1704"
# - nxp,enable-gpio: Should contain a phandle + gpio-specifier
#   to the GPIO pin connected to the chip's enable pin.
# - usb-phy: Should contain a phandle to the USB PHY
#   the ISP1704 is connected to.
#
# Example:
#
# isp1704 {
# 	compatible = "nxp,isp1704";
# 	nxp,enable-gpio = <&gpio3 3 GPIO_ACTIVE_LOW>;
# 	usb-phy = <&usb2_phy>;
# };
```

## Documentation/devicetree/bindings/power/reset/st-reset.yaml
```yaml
%YAML 1.2
---
version: 1

id: st-reset

title: *Device-Tree bindings for ST SW reset functionality

maintainer:
    -   name: Lee Jones <lee.jones@linaro.org>

description: >
    TODO

inherits:
    -   id: %ids%

properties:
    -   name: "compatible"
        constraint: |
            "st,stih416-restart"
            "st,stih407-restart"

    status:
    st,syscfg:

...

# *Device-Tree bindings for ST SW reset functionality
#
# Required properties:
# - compatible: should be "st,<chip>-restart".
# - st,syscfg: should be a phandle of the syscfg node.
#
# Example node:
# 	restart {
# 		compatible = "st,stih416-restart";
# 		st,syscfg = <&syscfg_sbc>;
# 	};
```

## Documentation/devicetree/bindings/power/reset/syscon-poweroff.yaml
```yaml
%YAML 1.2
---
version: 1

id: syscon-poweroff

title: Generic SYSCON mapped register poweroff driver

maintainer:
    -   name: Moritz Fischer <moritz.fischer@ettus.com>

description: >
    TODO

inherits:
    -   id: %ids%

properties:
    -   name: "compatible"
        constraint: |
            "syscon-poweroff"

    mask:
    offset:
    regmap:
    status:

...

# Generic SYSCON mapped register poweroff driver
#
# This is a generic poweroff driver using syscon to map the poweroff register.
# The poweroff is generally performed with a write to the poweroff register
# defined by the register map pointed by syscon reference plus the offset
# with the mask defined in the poweroff node.
#
# Required properties:
# - compatible: should contain "syscon-poweroff"
# - regmap: this is phandle to the register map node
# - offset: offset in the register map for the poweroff register (in bytes)
# - mask: the poweroff value written to the poweroff register (32 bit access)
#
# Default will be little endian mode, 32 bit access only.
#
# Examples:
#
# 	poweroff {
# 	   compatible = "syscon-poweroff";
# 	   regmap = <&regmapnode>;
# 	   offset = <0x0>;
# 	   mask = <0x7a>;
# 	};
```

## Documentation/devicetree/bindings/power/rx51-battery.yaml
```yaml
%YAML 1.2
---
version: 1

id: rx51-battery

title: Binding for Nokia N900 battery

maintainer:
    -   name: Sebastian Reichel <sre@kernel.org>

description: >
    TODO

inherits:
    -   id: %ids%

properties:
    -   name: "compatible"
        constraint: |
            "nokia,n900-battery"

    io-channel-names:
    io-channels:

...

# Binding for Nokia N900 battery
#
# The Nokia N900 battery status can be read via the TWL4030's A/D converter.
#
# Required properties:
# - compatible: Should contain one of the following:
#  * "nokia,n900-battery"
# - io-channels: Should contain IIO channel specifiers
#                for each element in io-channel-names.
# - io-channel-names: Should contain the following values:
#  * "temp" - The ADC channel for temperature reading
#  * "bsi"  - The ADC channel for battery size identification
#  * "vbat" - The ADC channel to measure the battery voltage
#
# Example from Nokia N900:
#
# battery: n900-battery {
# 	compatible = "nokia,n900-battery";
# 	io-channels = <&twl4030_madc 0>,
# 		      <&twl4030_madc 4>,
# 		      <&twl4030_madc 12>;
# 	io-channel-names = "temp",
# 			   "bsi",
# 			   "vbat";
# };
```

## Documentation/devicetree/bindings/power_supply/ab8500/charger.yaml
```yaml
%YAML 1.2
---
version: 1

id: charger

title: === AB8500 Charger Driver ===

maintainer:
    -   name: Rajanikanth H.V <rajanikanth.hv@stericsson.com>

description: >
    TODO

inherits:
    -   id: %ids%

properties:
    -   name: "compatible"
        constraint: |
            "stericsson,ab8500-charger"

    battery:
    vddadc-supply:

...

# === AB8500 Charger Driver ===
#
# Required Properties:
# - compatible = Shall be "stericsson,ab8500-charger"
# - battery = Shall be battery specific information
# 	Example:
# 	ab8500_charger {
# 		compatible = "stericsson,ab8500-charger";
# 		battery	   = <&ab8500_battery>;
# 	};
#
# - vddadc-supply: Supply for USB and Main charger
# 	Example:
# 	ab8500-charger {
# 		vddadc-supply	= <&ab8500_ldo_tvout_reg>;
# 	}
# - autopower_cfg:
# 	Boolean value depicting the presence of 'automatic poweron after powerloss'
# 	Example:
# 	ab8500-charger {
# 		autopower_cfg;
# 	};
#
# For information on battery specific node, Ref:
# Documentation/devicetree/bindings/power_supply/ab8500/fg.txt
```

## Documentation/devicetree/bindings/power_supply/axxia-reset.yaml
```yaml
%YAML 1.2
---
version: 1

id: axxia-reset

title: Axxia Restart Driver

maintainer:
    -   name: Anders Berg <anders.berg@lsi.com>

description: >
    TODO

inherits:
    -   id: %ids%

properties:
    -   name: "compatible"
        constraint: |
            "lsi,axxia-syscon" && "syscon"
            "lsi,axm55xx-reset"

    syscon:

...

# Axxia Restart Driver
#
# This driver can do reset of the Axxia SoC. It uses the registers in the syscon
# block to initiate a chip reset.
#
# Required Properties:
#   -compatible: "lsi,axm55xx-reset"
#   -syscon: phandle to the syscon node.
#
# Example:
#
# 	syscon: syscon@2010030000 {
# 		compatible = "lsi,axxia-syscon", "syscon";
# 		reg = <0x20 0x10030000 0 0x2000>;
# 	};
#
# 	reset: reset@2010031000 {
# 		compatible = "lsi,axm55xx-reset";
# 		syscon = <&syscon>;
# 	};
```

## Documentation/devicetree/bindings/power_supply/gpio-charger.yaml
```yaml
%YAML 1.2
---
version: 1

id: gpio-charger

title: gpio-charger

maintainer:
    -   name: Heiko Stuebner <heiko.stuebner@bq.com>

description: >
    TODO

inherits:
    -   id: %ids%

properties:
    -   name: "compatible"
        constraint: |
            "gpio-charger"

    charger-type:
    gpios:
    pinctrl-0:
    pinctrl-names:

...

# gpio-charger
#
# Required properties :
#  - compatible : "gpio-charger"
#  - gpios : GPIO indicating the charger presence.
#    See GPIO binding in bindings/gpio/gpio.txt .
#  - charger-type : power supply type, one of
#      unknown
#      battery
#      ups
#      mains
#      usb-sdp (USB standard downstream port)
#      usb-dcp (USB dedicated charging port)
#      usb-cdp (USB charging downstream port)
#      usb-aca (USB accessory charger adapter)
#
# Example:
#
# 	usb_charger: charger {
# 		compatible = "gpio-charger";
# 		charger-type = "usb-sdp";
# 		gpios = <&gpf0 2 0 0 0>;
# 	}
#
# 	battery {
# 		power-supplies = <&usb_charger>;
# 	};
```

## Documentation/devicetree/bindings/power_supply/msm-poweroff.yaml
```yaml
%YAML 1.2
---
version: 1

id: msm-poweroff

title: MSM Restart Driver

maintainer:
    -   name: Abhimanyu Kapur <abhimany@codeaurora.org>

description: >
    TODO

inherits:
    -   id: %ids%

properties:
    -   name: "compatible"
        constraint: |
            "qcom,pshold"

    reg:

...

# MSM Restart Driver
#
# A power supply hold (ps-hold) bit is set to power the msm chipsets.
# Clearing that bit allows us to restart/poweroff. The difference
# between poweroff and restart is determined by unique power manager IC
# settings.
#
# Required Properties:
# -compatible: "qcom,pshold"
# -reg: Specifies the physical address of the ps-hold register
#
# Example:
#
# 	restart@fc4ab000 {
# 		compatible = "qcom,pshold";
# 		reg = <0xfc4ab000 0x4>;
# 	};
```

## Documentation/devicetree/bindings/power_supply/restart-poweroff.yaml
```yaml
%YAML 1.2
---
version: 1

id: restart-poweroff

title: Restart Power Off

maintainer:
    -   name: Andrew Lunn <andrew@lunn.ch>

description: >
    TODO

inherits:
    -   id: %ids%

properties:
    -   name: "compatible"
        constraint: |
            "restart-poweroff"

    "restart-poweroff"::

...

# * Restart Power Off
#
# Buffalo Linkstation LS-XHL and LS-CHLv2, and other devices power off
# by restarting and letting u-boot keep hold of the machine until the
# user presses a button.
#
# Required Properties:
# - compatible: Should be "restart-poweroff"
```

## Documentation/devicetree/bindings/power_supply/tps65090.yaml
```yaml
%YAML 1.2
---
version: 1

id: tps65090

title: TPS65090 Frontend PMU with Switchmode Charger

maintainer:
    -   name: Rhyland Klein <rklein@nvidia.com>

description: >
    TODO

inherits:
    -   id: %ids%

properties:
    -   name: "compatible"
        constraint: |
            "ti,tps65090-charger"

    ti,enable-low-current-chrg:
    "ti,tps65090-charger"::

...

# TPS65090 Frontend PMU with Switchmode Charger
#
# Required Properties:
# -compatible: "ti,tps65090-charger"
#
# Optional Properties:
# -ti,enable-low-current-chrg: Enables charging when a low current is detected
#  while the default logic is to stop charging.
#
# This node is a subnode of the tps65090 PMIC.
#
# Example:
#
# 	tps65090-charger {
# 		compatible = "ti,tps65090-charger";
# 		ti,enable-low-current-chrg;
# 	};
```
