## Documentation/devicetree/bindings/panel/auo,b116xw03.yaml
```yaml
%YAML 1.2
---
version: 1

id: auo,b116xw03

title: AU Optronics Corporation 11.6" HD (1366x768) color TFT-LCD panel

maintainer:
    -   name: Ajay Kumar <ajaykumar.rs@samsung.com>

description: >
    TODO

inherits:
    -   id: %ids%

properties:
    -   name: "compatible"
        constraint: |
            "auo,b116xw03"

    backlight:
    power-supply:

...

# AU Optronics Corporation 11.6" HD (1366x768) color TFT-LCD panel
#
# Required properties:
# - compatible: should be "auo,b116xw03"
#
# This binding is compatible with the simple-panel binding, which is specified
# in simple-panel.txt in this directory.
```

## Documentation/devicetree/bindings/panel/auo,b133htn01.yaml
```yaml
%YAML 1.2
---
version: 1

id: auo,b133htn01

title: AU Optronics Corporation 13.3" FHD (1920x1080) color TFT-LCD panel

maintainer:
    -   name: Ajay Kumar <ajaykumar.rs@samsung.com>

description: >
    TODO

inherits:
    -   id: %ids%

properties:
    -   name: "compatible"
        constraint: |
            "auo,b133htn01"

    backlight:
    power-supply:

...

# AU Optronics Corporation 13.3" FHD (1920x1080) color TFT-LCD panel
#
# Required properties:
# - compatible: should be "auo,b133htn01"
#
# This binding is compatible with the simple-panel binding, which is specified
# in simple-panel.txt in this directory.
```

## Documentation/devicetree/bindings/panel/auo,b133xtn01.yaml
```yaml
%YAML 1.2
---
version: 1

id: auo,b133xtn01

title: AU Optronics Corporation 13.3" WXGA (1366x768) TFT LCD panel

maintainer:
    -   name: Stéphane Marchesin <marcheu@chromium.org>

description: >
    TODO

inherits:
    -   id: %ids%

properties:
    -   name: "compatible"
        constraint: |
            "auo,b133xtn01"

    backlight:
    ddc-i2c-bus:

...

# AU Optronics Corporation 13.3" WXGA (1366x768) TFT LCD panel
#
# Required properties:
# - compatible: should be "auo,b133xtn01"
#
# This binding is compatible with the simple-panel binding, which is specified
# in simple-panel.txt in this directory.
```

## Documentation/devicetree/bindings/panel/chunghwa,claa101wa01a.yaml
```yaml
%YAML 1.2
---
version: 1

id: chunghwa,claa101wa01a

title: Chunghwa Picture Tubes Ltd. 10.1" WXGA TFT LCD panel

maintainer:
    -   name: Stephen Warren <swarren@nvidia.com>

description: >
    TODO

inherits:
    -   id: %ids%

properties:
    -   name: "compatible"
        constraint: |
            "chunghwa,claa101wa01a" && "simple-panel"

    backlight:
    ddc-i2c-bus:
    enable-gpios:
    power-supply:

...

# Chunghwa Picture Tubes Ltd. 10.1" WXGA TFT LCD panel
#
# Required properties:
# - compatible: should be "chunghwa,claa101wa01a"
#
# This binding is compatible with the simple-panel binding, which is specified
# in simple-panel.txt in this directory.
```

## Documentation/devicetree/bindings/panel/edt,et057090dhu.yaml
```yaml
%YAML 1.2
---
version: 1

id: edt,et057090dhu

title: Emerging Display Technology Corp. 5.7" VGA TFT LCD panel

maintainer:
    -   name: Stefan Agner <stefan@agner.ch>

description: >
    TODO

inherits:
    -   id: %ids%

properties:
    -   name: "compatible"
        constraint: |
            "edt,et057090dhu" && "simple-panel"

    backlight:

...

# Emerging Display Technology Corp. 5.7" VGA TFT LCD panel
#
# Required properties:
# - compatible: should be "edt,et057090dhu"
#
# This binding is compatible with the simple-panel binding, which is specified
# in simple-panel.txt in this directory.
```

## Documentation/devicetree/bindings/panel/foxlink,fl500wvr00-a0t.yaml
```yaml
%YAML 1.2
---
version: 1

id: foxlink,fl500wvr00-a0t

title: Foxlink Group 5" WVGA TFT LCD panel

maintainer:
    -   name: Boris BREZILLON <boris.brezillon@free-electrons.com>

description: >
    TODO

inherits:
    -   id: %ids%

properties:
    -   name: "compatible"
        constraint: |
            "foxlink,fl500wvr00-a0t" && "simple-panel"

    #address-cells:
    backlight:
    power-supply:
    #size-cells:
    status:

...

# Foxlink Group 5" WVGA TFT LCD panel
#
# Required properties:
# - compatible: should be "foxlink,fl500wvr00-a0t"
#
# This binding is compatible with the simple-panel binding, which is specified
# in simple-panel.txt in this directory.
```

## Documentation/devicetree/bindings/panel/hannstar,hsd100pxn1.yaml
```yaml
%YAML 1.2
---
version: 1

id: hannstar,hsd100pxn1

title: HannStar Display Corp. HSD100PXN1 10.1" XGA LVDS panel

maintainer:
    -   name: Eric Nelson <eric.nelson@boundarydevices.com>

description: >
    TODO

inherits:
    -   id: %ids%

properties:
    -   name: "compatible"
        constraint: |
            "hannstar,hsd100pxn1"

    backlight:

...

# HannStar Display Corp. HSD100PXN1 10.1" XGA LVDS panel
#
# Required properties:
# - compatible: should be "hannstar,hsd100pxn1"
#
# This binding is compatible with the simple-panel binding, which is specified
# in simple-panel.txt in this directory.
```

## Documentation/devicetree/bindings/panel/innolux,n156bge-l21.yaml
```yaml
%YAML 1.2
---
version: 1

id: innolux,n156bge-l21

title: InnoLux 15.6" WXGA TFT LCD panel

maintainer:
    -   name: Alban Bedel <alban.bedel@avionic-design.de>

description: >
    TODO

inherits:
    -   id: %ids%

properties:
    -   name: "compatible"
        constraint: |
            "innolux,n156bge-l21" && "simple-panel"

    backlight:
    enable-gpios:
    power-supply:

...

# InnoLux 15.6" WXGA TFT LCD panel
#
# Required properties:
# - compatible: should be "innolux,n156bge-l21"
#
# This binding is compatible with the simple-panel binding, which is specified
# in simple-panel.txt in this directory.
```

## Documentation/devicetree/bindings/panel/lg,lb070wv8.yaml
```yaml
%YAML 1.2
---
version: 1

id: lg,lb070wv8

title: LG 7" (800x480 pixels) TFT LCD panel

maintainer:
    -   name: Heiko Schocher <hs@denx.de>

description: >
    TODO

inherits:
    -   id: %ids%

properties:
    -   name: "compatible"
        constraint: |
            "lg,lb070wv8"

    backlight:
    enable-gpios:

...

# LG 7" (800x480 pixels) TFT LCD panel
#
# Required properties:
# - compatible: should be "lg,lb070wv8"
#
# This binding is compatible with the simple-panel binding, which is specified
# in simple-panel.txt in this directory.
```

## Documentation/devicetree/bindings/panel/lg,ld070wx3-sl01.yaml
```yaml
%YAML 1.2
---
version: 1

id: lg,ld070wx3-sl01

title: LG Corporation 7" WXGA TFT LCD panel

maintainer:
    -   name: Alexandre Courbot <acourbot@nvidia.com>

description: >
    TODO

inherits:
    -   id: %ids%

properties:
    -   name: "compatible"
        constraint: |
            "lg,ld070wx3-sl01"

    backlight:
    power-supply:
    reg:

...

# LG Corporation 7" WXGA TFT LCD panel
#
# Required properties:
# - compatible: should be "lg,ld070wx3-sl01"
#
# This binding is compatible with the simple-panel binding, which is specified
# in simple-panel.txt in this directory.
```

## Documentation/devicetree/bindings/panel/lg,lg4573.yaml
```yaml
%YAML 1.2
---
version: 1

id: lg,lg4573

title: LG LG4573 TFT Liquid Crystal Display with SPI control bus

maintainer:
    -   name: Heiko Schocher <hs@denx.de>

description: >
    TODO

inherits:
    -   id: %ids%

properties:
    -   name: "compatible"
        constraint: |
            "lg,lg4573"

    #address-cells:
    power-on-delay:
    reg:
    #size-cells:
    spi-max-frequency:

...

# LG LG4573 TFT Liquid Crystal Display with SPI control bus
#
# Required properties:
#   - compatible: "lg,lg4573"
#   - reg: address of the panel on the SPI bus
#
# The panel must obey rules for SPI slave device specified in document [1].
#
# [1]: Documentation/devicetree/bindings/spi/spi-bus.txt
#
# Example:
#
# 	lcd_panel: display@0 {
# 		#address-cells = <1>;
# 		#size-cells = <1>;
# 		compatible = "lg,lg4573";
# 		spi-max-frequency = <10000000>;
# 		reg = <0>;
# 	};
```

## Documentation/devicetree/bindings/panel/lg,lh500wx1-sd03.yaml
```yaml
%YAML 1.2
---
version: 1

id: lg,lh500wx1-sd03

title: LG Corporation 5" HD TFT LCD panel

maintainer:
    -   name: Alexandre Courbot <acourbot@nvidia.com>

description: >
    TODO

inherits:
    -   id: %ids%

properties:
    -   name: "compatible"
        constraint: |
            "lg,lh500wx1-sd03"

    backlight:
    power-supply:
    reg:

...

# LG Corporation 5" HD TFT LCD panel
#
# Required properties:
# - compatible: should be "lg,lh500wx1-sd03"
#
# This binding is compatible with the simple-panel binding, which is specified
# in simple-panel.txt in this directory.
```

## Documentation/devicetree/bindings/panel/lg,lp129qe.yaml
```yaml
%YAML 1.2
---
version: 1

id: lg,lp129qe

title: LG 12.9" (2560x1700 pixels) TFT LCD panel

maintainer:
    -   name: Thierry Reding <treding@nvidia.com>

description: >
    TODO

inherits:
    -   id: %ids%

properties:
    -   name: "compatible"
        constraint: |
            "lg,lp129qe" && "simple-panel"

    backlight:
    ddc-i2c-bus:

...

# LG 12.9" (2560x1700 pixels) TFT LCD panel
#
# Required properties:
# - compatible: should be "lg,lp129qe"
#
# This binding is compatible with the simple-panel binding, which is specified
# in simple-panel.txt in this directory.
```

## Documentation/devicetree/bindings/panel/panasonic,vvx10f004b00.yaml
```yaml
%YAML 1.2
---
version: 1

id: panasonic,vvx10f004b00

title: Panasonic Corporation 10.1" WUXGA TFT LCD panel

maintainer:
    -   name: Thierry Reding <treding@nvidia.com>

description: >
    TODO

inherits:
    -   id: %ids%

properties:
    -   name: "compatible"
        constraint: |
            "panasonic,vvx10f004b00" && "simple-panel"

    backlight:
    power-supply:
    reg:

...

# Panasonic Corporation 10.1" WUXGA TFT LCD panel
#
# Required properties:
# - compatible: should be "panasonic,vvx10f004b00"
#
# This binding is compatible with the simple-panel binding, which is specified
# in simple-panel.txt in this directory.
```

## Documentation/devicetree/bindings/panel/samsung,ltn101nt05.yaml
```yaml
%YAML 1.2
---
version: 1

id: samsung,ltn101nt05

title: Samsung Electronics 10.1" WSVGA TFT LCD panel

maintainer:
    -   name: Marc Dietrich <marvin24@gmx.de>

description: >
    TODO

inherits:
    -   id: %ids%

properties:
    -   name: "compatible"
        constraint: |
            "samsung,ltn101nt05" && "simple-panel"

    backlight:
    ddc-i2c-bus:
    enable-gpios:
    power-supply:

...

# Samsung Electronics 10.1" WSVGA TFT LCD panel
#
# Required properties:
# - compatible: should be "samsung,ltn101nt05"
#
# This binding is compatible with the simple-panel binding, which is specified
# in simple-panel.txt in this directory.
```

## Documentation/devicetree/bindings/panel/samsung,ltn140at29-301.yaml
```yaml
%YAML 1.2
---
version: 1

id: samsung,ltn140at29-301

title: Samsung Electronics 14" WXGA (1366x768) TFT LCD panel

maintainer:
    -   name: Stéphane Marchesin <marcheu@chromium.org>

description: >
    TODO

inherits:
    -   id: %ids%

properties:
    -   name: "compatible"
        constraint: |
            "samsung,ltn140at29-301"

    backlight:
    ddc-i2c-bus:

...

# Samsung Electronics 14" WXGA (1366x768) TFT LCD panel
#
# Required properties:
# - compatible: should be "samsung,ltn140at29-301"
#
# This binding is compatible with the simple-panel binding, which is specified
# in simple-panel.txt in this directory.
```

## Documentation/devicetree/bindings/panel/shelly,sca07010-bfn-lnn.yaml
```yaml
%YAML 1.2
---
version: 1

id: shelly,sca07010-bfn-lnn

title: Shelly SCA07010-BFN-LNN 7.0" WVGA TFT LCD panel

maintainer:
    -   name: Boris BREZILLON <boris.brezillon@free-electrons.com>

description: >
    TODO

inherits:
    -   id: %ids%

properties:
    -   name: "compatible"
        constraint: |
            "qd,qd43003c0-40" && "simple-panel"
            "chunghwa,claa101wb01" && "simple-panel"

    backlight:
    ddc-i2c-bus:
    enable-gpios:
    power-supply:

...

# Shelly SCA07010-BFN-LNN 7.0" WVGA TFT LCD panel
#
# Required properties:
# - compatible: should be "shelly,sca07010-bfn-lnn"
#
# This binding is compatible with the simple-panel binding, which is specified
# in simple-panel.txt in this directory.
```

## Documentation/devicetree/bindings/pci/fsl,imx6q-pcie.yaml
```yaml
%YAML 1.2
---
version: 1

id: fsl,imx6q-pcie

title: Freescale i.MX6 PCIe interface

maintainer:
    -   name: Lucas Stach <l.stach@pengutronix.de>

description: >
    TODO

inherits:
    -   id: %ids%

properties:
    -   name: "compatible"
        constraint: |
            "fsl,imx6q-pcie" && "snps,dw-pcie"

    #address-cells:
    clock-names:
    clocks:
    device_type:
    #interrupt-cells:
    interrupt-map:
    interrupt-map-mask:
    interrupt-names:
    interrupts:
    num-lanes:
    pinctrl-0:
    pinctrl-name:
    pinctrl-names:
    ranges:
    reg:
    reg-names:
    reset-gpio:
    #size-cells:
    status:

...

# * Freescale i.MX6 PCIe interface
#
# This PCIe host controller is based on the Synopsis Designware PCIe IP
# and thus inherits all the common properties defined in designware-pcie.txt.
#
# Required properties:
# - compatible: "fsl,imx6q-pcie"
# - reg: base addresse and length of the pcie controller
# - interrupts: A list of interrupt outputs of the controller. Must contain an
#   entry for each entry in the interrupt-names property.
# - interrupt-names: Must include the following entries:
# 	- "msi": The interrupt that is asserted when an MSI is received
# - clock-names: Must include the following additional entries:
# 	- "pcie_phy"
#
# Example:
#
# 	pcie@0x01000000 {
# 		compatible = "fsl,imx6q-pcie", "snps,dw-pcie";
# 		reg = <0x01ffc000 0x04000>,
# 		      <0x01f00000 0x80000>;
# 		reg-names = "dbi", "config";
# 		#address-cells = <3>;
# 		#size-cells = <2>;
# 		device_type = "pci";
# 		ranges = <0x00000800 0 0x01f00000 0x01f00000 0 0x00080000
# 			  0x81000000 0 0          0x01f80000 0 0x00010000
# 			  0x82000000 0 0x01000000 0x01000000 0 0x00f00000>;
# 		num-lanes = <1>;
# 		interrupts = <GIC_SPI 120 IRQ_TYPE_LEVEL_HIGH>;
# 		interrupt-names = "msi";
# 		#interrupt-cells = <1>;
# 		interrupt-map-mask = <0 0 0 0x7>;
# 		interrupt-map = <0 0 0 1 &intc GIC_SPI 123 IRQ_TYPE_LEVEL_HIGH>,
# 		                <0 0 0 2 &intc GIC_SPI 122 IRQ_TYPE_LEVEL_HIGH>,
# 		                <0 0 0 3 &intc GIC_SPI 121 IRQ_TYPE_LEVEL_HIGH>,
# 		                <0 0 0 4 &intc GIC_SPI 120 IRQ_TYPE_LEVEL_HIGH>;
# 		clocks = <&clks 144>, <&clks 206>, <&clks 189>;
# 		clock-names = "pcie", "pcie_bus", "pcie_phy";
# 	};
```
