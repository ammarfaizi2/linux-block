## Documentation/devicetree/bindings/pci/fsl,pci.yaml
```yaml
%YAML 1.2
---
version: 1

id: fsl,pci

title: Bus Enumeration by Freescale PCI-X Agent

maintainer:
    -   name: Aaron Sierra <asierra@xes-inc.com>

description: >
    TODO

inherits:
    -   id: %ids%

properties:
    -   name: "compatible"
        constraint: |
            "fsl,mpc8540-pcix" && "fsl,mpc8540-pci"
            "fsl,mpc8540-pci"

    #address-cells:
    bus-range:
    clock-frequency:
    device_type:
    #interrupt-cells:
    interrupt-map:
    interrupt-map-mask:
    interrupt-parent:
    interrupts:
    ranges:
    reg:
    #size-cells:
    sleep:
    status:

...

# * Bus Enumeration by Freescale PCI-X Agent
#
# Typically any Freescale PCI-X bridge hardware strapped into Agent mode
# is prevented from enumerating the bus. The PrPMC form-factor requires
# all mezzanines to be PCI-X Agents, but one per system may still
# enumerate the bus.
#
# The property defined below will allow a PCI-X bridge to be used for bus
# enumeration despite being strapped into Agent mode.
#
# Required properties:
# - fsl,pci-agent-force-enum : There is no value associated with this
#   property. The property itself is treated as a boolean.
#
# Example:
#
# 	/* PCI-X bridge known to be PrPMC Monarch */
# 	pci0: pci@ef008000 {
# 		fsl,pci-agent-force-enum;
# 		#interrupt-cells = <1>;
# 		#size-cells = <2>;
# 		#address-cells = <3>;
# 		compatible = "fsl,mpc8540-pcix", "fsl,mpc8540-pci";
# 		device_type = "pci";
# 		...
# 		...
# 	};
```

## Documentation/devicetree/bindings/pci/spear13xx-pcie.yaml
```yaml
%YAML 1.2
---
version: 1

id: spear13xx-pcie

title: SPEAr13XX PCIe DT detail:

maintainer:
    -   name: Pratyush Anand <pratyush.anand@gmail.com>

description: >
    TODO

inherits:
    -   id: %ids%

properties:
    -   name: "compatible"
        constraint: |
            "st,spear1340-pcie" && "snps,dw-pcie"
            "fsl,imx6sx-pcie" && "snps,dw-pcie"

    #address-cells:
    clock-names:
    clocks:
    device_type:
    interrupts:
    num-lanes:
    ranges:
    reg:
    #size-cells:
    status:

...

# SPEAr13XX PCIe DT detail:
# ================================
#
# SPEAr13XX uses synopsis designware PCIe controller and ST MiPHY as phy
# controller.
#
# Required properties:
# - compatible : should be "st,spear1340-pcie", "snps,dw-pcie".
# - phys		    : phandle to phy node associated with pcie controller
# - phy-names	    : must be "pcie-phy"
# - All other definitions as per generic PCI bindings
#
#  Optional properties:
# - st,pcie-is-gen1 indicates that forced gen1 initialization is needed.
```

## Documentation/devicetree/bindings/phy/berlin-sata-phy.yaml
```yaml
%YAML 1.2
---
version: 1

id: berlin-sata-phy

title: Berlin SATA PHY

maintainer:
    -   name: Antoine Ténart <antoine.tenart@free-electrons.com>

description: >
    TODO

inherits:
    -   id: %ids%

properties:
    -   name: "compatible"
        constraint: |
            "marvell,berlin2-sata-phy"
            "marvell,berlin2q-sata-phy"

    #address-cells:
    clocks:
    #phy-cells:
    reg:
    #size-cells:
    status:

...

# Berlin SATA PHY
# ---------------
#
# Required properties:
# - compatible: should be one of
#     "marvell,berlin2-sata-phy"
#     "marvell,berlin2q-sata-phy"
# - address-cells: should be 1
# - size-cells: should be 0
# - phy-cells: from the generic PHY bindings, must be 1
# - reg: address and length of the register
# - clocks: reference to the clock entry
#
# Sub-nodes:
# Each PHY should be represented as a sub-node.
#
# Sub-nodes required properties:
# - reg: the PHY number
#
# Example:
# 	sata_phy: phy@f7e900a0 {
# 		compatible = "marvell,berlin2q-sata-phy";
# 		reg = <0xf7e900a0 0x200>;
# 		clocks = <&chip CLKID_SATA>;
# 		#address-cells = <1>;
# 		#size-cells = <0>;
# 		#phy-cells = <1>;
#
# 		sata-phy@0 {
# 			reg = <0>;
# 		};
#
# 		sata-phy@1 {
# 			reg = <1>;
# 		};
# 	};
```

## Documentation/devicetree/bindings/phy/berlin-usb-phy.yaml
```yaml
%YAML 1.2
---
version: 1

id: berlin-usb-phy

title: Marvell Berlin USB PHY

maintainer:
    -   name: Antoine Tenart <antoine.tenart@free-electrons.com>

description: >
    TODO

inherits:
    -   id: %ids%

properties:
    -   name: "compatible"
        constraint: |
            "marvell,berlin2-usb-phy"
            "marvell,berlin2cd-usb-phy"

    #phy-cells:
    reg:
    resets:
    status:

...

# * Marvell Berlin USB PHY
#
# Required properties:
# - compatible: "marvell,berlin2-usb-phy" or "marvell,berlin2cd-usb-phy"
# - reg: base address and length of the registers
# - #phys-cells: should be 0
# - resets: reference to the reset controller
#
# Example:
#
# 	usb-phy@f774000 {
# 		compatible = "marvell,berlin2-usb-phy";
# 		reg = <0xf774000 0x128>;
# 		#phy-cells = <0>;
# 		resets = <&chip 0x104 14>;
# 	};
```

## Documentation/devicetree/bindings/phy/brcm,kona-usb2-phy.yaml
```yaml
%YAML 1.2
---
version: 1

id: brcm,kona-usb2-phy

title: BROADCOM KONA USB2 PHY

maintainer:
    -   name: Scott Branden <sbranden@broadcom.com>

description: >
    TODO

inherits:
    -   id: %ids%

properties:
    -   name: "compatible"
        constraint: |
            "brcm,kona-usb2-phy"

    #phy-cells:
    reg:
    status:

...

# BROADCOM KONA USB2 PHY
#
# Required properties:
#  - compatible: brcm,kona-usb2-phy
#  - reg: offset and length of the PHY registers
#  - #phy-cells: must be 0
# Refer to phy/phy-bindings.txt for the generic PHY binding properties
#
# Example:
#
# 	usbphy: usb-phy@3f130000 {
# 		compatible = "brcm,kona-usb2-phy";
# 		reg = <0x3f130000 0x28>;
# 		#phy-cells = <0>;
# 	};
```

## Documentation/devicetree/bindings/phy/rockchip-usb-phy.yaml
```yaml
%YAML 1.2
---
version: 1

id: rockchip-usb-phy

title: ROCKCHIP USB2 PHY

maintainer:
    -   name: Yunzhi Li <lyz@rock-chips.com>

description: >
    TODO

inherits:
    -   id: %ids%

properties:
    -   name: "compatible"
        constraint: |
            "rockchip,rk3288-usb-phy"
            "rockchip,rk3188-usb-phy" && "rockchip,rk3288-usb-phy"
            "rockchip,rk3066a-usb-phy" && "rockchip,rk3288-usb-phy"

    #address-cells:
    rockchip,grf:
    #size-cells:
    status:

...

# ROCKCHIP USB2 PHY
#
# Required properties:
#  - compatible: rockchip,rk3288-usb-phy
#  - rockchip,grf : phandle to the syscon managing the "general
#    register files"
#  - #address-cells: should be 1
#  - #size-cells: should be 0
#
# Sub-nodes:
# Each PHY should be represented as a sub-node.
#
# Sub-nodes
# required properties:
# - #phy-cells: should be 0
# - reg: PHY configure reg address offset in GRF
# 		"0x320" - for PHY attach to OTG controller
# 		"0x334" - for PHY attach to HOST0 controller
# 		"0x348" - for PHY attach to HOST1 controller
#
# Optional Properties:
# - clocks : phandle + clock specifier for the phy clocks
# - clock-names: string, clock name, must be "phyclk"
#
# Example:
#
# usbphy: phy {
# 	compatible = "rockchip,rk3288-usb-phy";
# 	rockchip,grf = <&grf>;
# 	#address-cells = <1>;
# 	#size-cells = <0>;
#
# 	usbphy0: usb-phy0 {
# 		#phy-cells = <0>;
# 		reg = <0x320>;
# 	};
# };
```

## Documentation/devicetree/bindings/phy/st-spear-miphy.yaml
```yaml
%YAML 1.2
---
version: 1

id: st-spear-miphy

title: ST SPEAr miphy DT details

maintainer:
    -   name: Pratyush Anand <pratyush.anand@gmail.com>

description: >
    TODO

inherits:
    -   id: %ids%

properties:
    -   name: "compatible"
        constraint: |
            "st,spear1340-miphy"
            "st,spear1310-miphy"

    misc:
    #phy-cells:
    phy-id:
    reg:
    status:

...

# ST SPEAr miphy DT details
# =========================
#
# ST Microelectronics SPEAr miphy is a phy controller supporting PCIe and SATA.
#
# Required properties:
# - compatible : should be "st,spear1310-miphy" or "st,spear1340-miphy"
# - reg : offset and length of the PHY register set.
# - misc: phandle for the syscon node to access misc registers
# - #phy-cells : from the generic PHY bindings, must be 1.
# 	- cell[1]: 0 if phy used for SATA, 1 for PCIe.
#
# Optional properties:
# - phy-id: Instance id of the phy. Only required when there are multiple phys
#   present on a implementation.
```
