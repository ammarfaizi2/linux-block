## Documentation/devicetree/bindings/interrupt-controller/renesas,h8300h-intc.yaml
```yaml
%YAML 1.2
---
version: 1

id: renesas,h8300h-intc

title: H8/300H Interrupt controller

maintainer:
    -   name: Yoshinori Sato <ysato@users.sourceforge.jp>

description: >
    TODO

inherits:
    -   id: %ids%

properties:
    -   name: "compatible"
        constraint: |
            "renesas,h8300h-intc" && "renesas,h8300-intc"


...

# * H8/300H Interrupt controller
#
# Required properties:
#
# - compatible: has to be "renesas,h8300h-intc", "renesas,h8300-intc" as fallback.
# - #interrupt-cells: has to be <2>: an interrupt index and flags, as defined in
#   interrupts.txt in this directory
# - regs: Base address of interrupt controller registers.
#
# Optional properties:
#
# - any properties, listed in interrupts.txt, and any standard resource allocation
#   properties
#
# Example:
#
# 	h8intc: interrupt-controller@fee012 {
# 		compatible = "renesas,h8300h-intc", "renesas,h8300-intc";
# 		#interrupt-cells = <2>;
# 		interrupt-controller;
# 		reg = <0xfee012 7>;
# 	};
```

## Documentation/devicetree/bindings/interrupt-controller/renesas,h8s-intc.yaml
```yaml
%YAML 1.2
---
version: 1

id: renesas,h8s-intc

title: H8S Interrupt controller

maintainer:
    -   name: Yoshinori Sato <ysato@users.sourceforge.jp>

description: >
    TODO

inherits:
    -   id: %ids%

properties:
    -   name: "compatible"
        constraint: |
            "renesas,h8s-intc" && "renesas,h8300-intc"


...

# * H8S Interrupt controller
#
# Required properties:
#
# - compatible: has to be "renesas,h8s-intc", "renesas,h8300-intc" as fallback.
# - #interrupt-cells: has to be <2>: an interrupt index and flags, as defined in
#   interrupts.txt in this directory
# - regs: Base address of interrupt controller registers.
#
# Optional properties:
#
# - any properties, listed in interrupts.txt, and any standard resource allocation
#   properties
#
# Example:
#
# 	h8intc: interrupt-controller@fffe00 {
# 		compatible = "renesas,h8s-intc", "renesas,h8300-intc";
# 		#interrupt-cells = <2>;
# 		interrupt-controller;
# 		reg = <0xfffe00 24>;
# 	};
```
