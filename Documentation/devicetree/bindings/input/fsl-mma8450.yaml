## Documentation/devicetree/bindings/input/touchscreen/sun4i.yaml
```yaml
%YAML 1.2
---
version: 1

id: sun4i

title: sun4i resistive touchscreen controller

maintainer:
    -   name: Hans de Goede <hdegoede@redhat.com>

description: >
    TODO

inherits:
    -   id: %ids%

properties:
    -   name: "compatible"
        constraint: |
            "allwinner,sun6i-a31-ts"
            "allwinner,sun5i-a13-ts"
            "allwinner,sun4i-a10-ts"

    interrupts:
    reg:
    #thermal-sensor-cells:

...

# sun4i resistive touchscreen controller
# --------------------------------------
#
# Required properties:
#  - compatible: "allwinner,sun4i-a10-ts", "allwinner,sun5i-a13-ts" or
#    "allwinner,sun6i-a31-ts"
#  - reg: mmio address range of the chip
#  - interrupts: interrupt to which the chip is connected
#  - #thermal-sensor-cells: shall be 0
#
# Optional properties:
#  - allwinner,ts-attached	 : boolean indicating that an actual touchscreen
# 				   is attached to the controller
#  - allwinner,tp-sensitive-adjust : integer (4 bits)
# 				   adjust sensitivity of pen down detection
# 				   between 0 (least sensitive) and 15
# 				   (defaults to 15)
#  - allwinner,filter-type	 : integer (2 bits)
# 				   select median and averaging filter
# 				   samples used for median / averaging filter
# 				   0: 4/2
# 				   1: 5/3
# 				   2: 8/4
# 				   3: 16/8
# 				   (defaults to 1)
#
# Example:
#
# 	rtp: rtp@01c25000 {
# 		compatible = "allwinner,sun4i-a10-ts";
# 		reg = <0x01c25000 0x100>;
# 		interrupts = <29>;
# 		allwinner,ts-attached;
# 		#thermal-sensor-cells = <0>;
# 		/* sensitive/noisy touch panel */
# 		allwinner,tp-sensitive-adjust = <0>;
# 		allwinner,filter-type = <3>;
# 	};
```

## Documentation/devicetree/bindings/input/twl4030-keypad.yaml
```yaml
%YAML 1.2
---
version: 1

id: twl4030-keypad

title: TWL4030's Keypad Controller device tree bindings

maintainer:
    -   name: Sebastian Reichel <sre@debian.org>

description: >
    TODO

inherits:
    -   id: %ids%

properties:
    -   name: "compatible"
        constraint: |
            "ti,twl4030-keypad"

    interrupts:
    keypad,num-columns:
    keypad,num-rows:
    linux,keymap:
    status:

...

# * TWL4030's Keypad Controller device tree bindings
#
# TWL4030's Keypad controller is used to interface a SoC with a matrix-type
# keypad device. The keypad controller supports multiple row and column lines.
# A key can be placed at each intersection of a unique row and a unique column.
# The keypad controller can sense a key-press and key-release and report the
# event using a interrupt to the cpu.
#
# This binding is based on the matrix-keymap binding with the following
# changes:
#
#  * keypad,num-rows and keypad,num-columns are required.
#
# Required SoC Specific Properties:
# - compatible: should be one of the following
#    - "ti,twl4030-keypad": For controllers compatible with twl4030 keypad
#       controller.
# - interrupt: should be one of the following
#    - <1>: For controllers compatible with twl4030 keypad controller.
#
# Example:
# 	twl_keypad: keypad {
# 		compatible = "ti,twl4030-keypad";
# 		interrupts = <1>;
# 		keypad,num-rows = <8>;
# 		keypad,num-columns = <8>;
# 	};
```

## Documentation/devicetree/bindings/interrupt-controller.yaml
```yaml
%YAML 1.2
---
version: 1

id: interrupt-controller

properties:
    "#interrupt-cells":
        category: required
        type: int
    "interrupt-controller":
        category: required
        type: empty

...
```

## Documentation/devicetree/bindings/interrupt-controller/abilis,tb10x-ictl.yaml
```yaml
%YAML 1.2
---
version: 1

id: abilis,tb10x-ictl

title: TB10x Top Level Interrupt Controller

maintainer:
    -   name: Christian Ruppert <christian.ruppert@abilis.com>

description: >
    TODO

inherits:
    -   id: %ids%

properties:
    -   name: "compatible"
        constraint: |
            "abilis,tb10x-ictl"

    #interrupt-cells:
    interrupt-controller:
    interrupt-parent:
    interrupts:
    reg:

...

# TB10x Top Level Interrupt Controller
# ====================================
#
# The Abilis TB10x SOC contains a custom interrupt controller. It performs
# one-to-one mapping of external interrupt sources to CPU interrupts and
# provides support for reconfigurable trigger modes.
#
# Required properties
# -------------------
#
# - compatible: Should be "abilis,tb10x-ictl"
# - reg: specifies physical base address and size of register range.
# - interrupt-congroller: Identifies the node as an interrupt controller.
# - #interrupt cells: Specifies the number of cells used to encode an interrupt
#   source connected to this controller. The value shall be 2.
# - interrupt-parent: Specifies the parent interrupt controller.
# - interrupts: Specifies the list of interrupt lines which are handled by
#   the interrupt controller in the parent controller's notation. Interrupts
#   are mapped one-to-one to parent interrupts.
#
# Example
# -------
#
# intc: interrupt-controller {	/* Parent interrupt controller */
# 	interrupt-controller;
# 	#interrupt-cells = <1>;	/* For example below */
# 	/* ... */
# };
#
# tb10x_ictl: pic@2000 {		/* TB10x interrupt controller */
# 	compatible = "abilis,tb10x-ictl";
# 	reg = <0x2000 0x20>;
# 	interrupt-controller;
# 	#interrupt-cells = <2>;
# 	interrupt-parent = <&intc>;
# 	interrupts = <5 6 7 8 9 10 11 12 13 14 15 16 17 18 19
# 			20 21 22 23 24 25 26 27 28 29 30 31>;
# };
```

## Documentation/devicetree/bindings/interrupt-controller/allwinner,sun4i-ic.yaml
```yaml
%YAML 1.2
---
version: 1

id: allwinner,sun4i-ic

title: Allwinner Sunxi Interrupt Controller

maintainer:
    -   name: Maxime Ripard <maxime.ripard@free-electrons.com>

description: >
    TODO

inherits:
    -   id: %ids%

properties:
    -   name: "compatible"
        constraint: |
            "allwinner,sun4i-a10-ic"

    #interrupt-cells:
    interrupt-controller:
    reg:

...

# Allwinner Sunxi Interrupt Controller
#
# Required properties:
#
# - compatible : should be "allwinner,sun4i-a10-ic"
# - reg : Specifies base physical address and size of the registers.
# - interrupt-controller : Identifies the node as an interrupt controller
# - #interrupt-cells : Specifies the number of cells needed to encode an
#   interrupt source. The value shall be 1.
#
# Example:
#
# intc: interrupt-controller {
# 	compatible = "allwinner,sun4i-a10-ic";
# 	reg = <0x01c20400 0x400>;
# 	interrupt-controller;
# 	#interrupt-cells = <1>;
# };
```

## Documentation/devicetree/bindings/interrupt-controller/apple,aic.yaml
```yaml
# SPDX-License-Identifier: (GPL-2.0-only OR BSD-2-Clause)
%YAML 1.2
---
$id: http://devicetree.org/schemas/interrupt-controller/apple,aic.yaml#
$schema: http://devicetree.org/meta-schemas/core.yaml#

title: Apple Interrupt Controller

maintainers:
  - Hector Martin <marcan@marcan.st>

description: |
  The Apple Interrupt Controller is a simple interrupt controller present on
  Apple ARM SoC platforms, including various iPhone and iPad devices and the
  "Apple Silicon" Macs.

  It provides the following features:

  - Level-triggered hardware IRQs wired to SoC blocks
    - Single mask bit per IRQ
    - Per-IRQ affinity setting (AICv1 only)
    - Automatic masking on event delivery (auto-ack)
    - Software triggering (ORed with hw line)
  - 2 per-CPU IPIs (meant as "self" and "other", but they are interchangeable
    if not symmetric) (AICv1 only)
  - Automatic prioritization (single event/ack register per CPU, lower IRQs =
    higher priority)
  - Automatic masking on ack
  - Default "this CPU" register view and explicit per-CPU views (AICv1 only)

  This device also represents the FIQ interrupt sources on platforms using AIC,
  which do not go through a discrete interrupt controller. It also handles
  FIQ-based Fast IPIs on supported chips.

properties:
  compatible:
    oneOf:
      - items:
          - const: apple,t8103-aic
          - const: apple,aic
      - items:
          - const: apple,t6000-aic
          - const: apple,aic2

  interrupt-controller: true

  '#interrupt-cells':
    minimum: 3
    maximum: 4
    description: |
      The 1st cell contains the interrupt type:
        - 0: Hardware IRQ
        - 1: FIQ

      The optional 2nd cell contains the die ID (apple,aic2 only).
      If not present, it defaults to 0.

      The next cell contains the interrupt number.
        - HW IRQs: interrupt number
        - FIQs:
          - 0: physical HV timer
          - 1: virtual HV timer
          - 2: physical guest timer
          - 3: virtual guest timer

      The last cell contains the interrupt flags. This is normally
      IRQ_TYPE_LEVEL_HIGH (4).

  reg:
    description: |
      Specifies base physical address and size of the AIC registers.
    maxItems: 1

  power-domains:
    maxItems: 1

  apple,event-reg:
    $ref: /schemas/types.yaml#/definitions/uint32
    description:
      Specifies the offset of the event register, which lies after all the
      implemented die register sets, page aligned. This is not computable from
      capability register values, so we have to specify it explicitly.

required:
  - compatible
  - '#interrupt-cells'
  - interrupt-controller
  - reg

additionalProperties: false

allOf:
  - $ref: /schemas/interrupt-controller.yaml#
  - if:
      properties:
        compatible:
          contains:
            enum:
              - apple,aic
    then:
      properties:
        '#interrupt-cells':
          const: 3

  - if:
      properties:
        compatible:
          contains:
            enum:
              - apple,aic2
    then:
      required:
        - apple,event-reg

examples:
  - |
    soc {
        #address-cells = <2>;
        #size-cells = <2>;

        aic: interrupt-controller@23b100000 {
            compatible = "apple,t8103-aic", "apple,aic";
            #interrupt-cells = <3>;
            interrupt-controller;
            reg = <0x2 0x3b100000 0x0 0x8000>;
        };
    };
```

## Documentation/devicetree/bindings/interrupt-controller/cdns,xtensa-mx.yaml
```yaml
%YAML 1.2
---
version: 1

id: cdns,xtensa-mx

title: Xtensa Interrupt Distributor and Programmable Interrupt Controller (MX)

maintainer:
    -   name: Max Filippov <jcmvbkbc@gmail.com>

description: >
    TODO

inherits:
    -   id: %ids%

properties:
    -   name: "compatible"
        constraint: |
            "cdns,xtensa-mx"

    #interrupt-cells:
    interrupt-controller:

...

# * Xtensa Interrupt Distributor and Programmable Interrupt Controller (MX)
#
# Required properties:
# - compatible: Should be "cdns,xtensa-mx".
#
# Remaining properties have exact same meaning as in Xtensa PIC
# (see cdns,xtensa-pic.txt).
#
# Examples:
# 	pic: pic {
# 		compatible = "cdns,xtensa-mx";
# 		/* one cell: internal irq number,
# 		 * two cells: second cell == 0: internal irq number
# 		 *            second cell == 1: external irq number
# 		 */
# 		#interrupt-cells = <2>;
# 		interrupt-controller;
# 	};
```

## Documentation/devicetree/bindings/interrupt-controller/digicolor-ic.yaml
```yaml
%YAML 1.2
---
version: 1

id: digicolor-ic

title: Conexant Digicolor Interrupt Controller

maintainer:
    -   name: Baruch Siach <baruch@tkos.co.il>

description: >
    TODO

inherits:
    -   id: %ids%

properties:
    -   name: "compatible"
        constraint: |
            "cnxt,cx92755-ic"

    #interrupt-cells:
    interrupt-controller:
    reg:
    syscon:

...

# Conexant Digicolor Interrupt Controller
#
# Required properties:
#
# - compatible : should be "cnxt,cx92755-ic"
# - reg : Specifies base physical address and size of the interrupt controller
#   registers (IC) area
# - interrupt-controller : Identifies the node as an interrupt controller
# - #interrupt-cells : Specifies the number of cells needed to encode an
#   interrupt source. The value shall be 1.
# - syscon: A phandle to the syscon node describing UC registers
#
# Example:
#
# 	intc: interrupt-controller@f0000040 {
# 		compatible = "cnxt,cx92755-ic";
# 		interrupt-controller;
# 		#interrupt-cells = <1>;
# 		reg = <0xf0000040 0x40>;
# 		syscon = <&uc_regs>;
# 	};
```

## Documentation/devicetree/bindings/interrupt-controller/lsi,zevio-intc.yaml
```yaml
%YAML 1.2
---
version: 1

id: lsi,zevio-intc

title: TI-NSPIRE interrupt controller

maintainer:
    -   name: Daniel Tang <dt.tangr@gmail.com>

description: >
    TODO

inherits:
    -   id: %ids%

properties:
    -   name: "compatible"
        constraint: |
            "lsi,zevio-intc"

    #interrupt-cells:
    interrupt-controller:
    reg:

...

# TI-NSPIRE interrupt controller
#
# Required properties:
# - compatible: Compatible property value should be "lsi,zevio-intc".
#
# - reg: Physical base address of the controller and length of memory mapped
# 	region.
#
# - interrupt-controller : Identifies the node as an interrupt controller
#
# Example:
#
# interrupt-controller {
# 	compatible = "lsi,zevio-intc";
# 	interrupt-controller;
# 	reg = <0xDC000000 0x1000>;
# 	#interrupt-cells = <1>;
# };
```

## Documentation/devicetree/bindings/interrupt-controller/nvidia,tegra-ictlr.yaml
```yaml
%YAML 1.2
---
version: 1

id: nvidia,tegra-ictlr

title: NVIDIA Legacy Interrupt Controller

maintainer:
    -   name: Marc Zyngier <marc.zyngier@arm.com>

description: >
    TODO

inherits:
    -   id: %ids%

properties:
    -   name: "compatible"
        constraint: |
            "nvidia,tegra30-ictlr"
            "nvidia,tegra20-ictlr"
            "nvidia,tegra124-ictlr" && "nvidia,tegra30-ictlr"
            "nvidia,tegra114-ictlr" && "nvidia,tegra30-ictlr"

    #interrupt-cells:
    interrupt-controller:
    interrupt-parent:
    reg:

...

# NVIDIA Legacy Interrupt Controller
#
# All Tegra SoCs contain a legacy interrupt controller that routes
# interrupts to the GIC, and also serves as a wakeup source. It is also
# referred to as "ictlr", hence the name of the binding.
#
# The HW block exposes a number of interrupt controllers, each
# implementing a set of 32 interrupts.
#
# Required properties:
#
# - compatible : should be: "nvidia,tegra<chip>-ictlr". The LIC on
#   subsequent SoCs remained backwards-compatible with Tegra30, so on
#   Tegra generations later than Tegra30 the compatible value should
#   include "nvidia,tegra30-ictlr".
# - reg : Specifies base physical address and size of the registers.
#   Each controller must be described separately (Tegra20 has 4 of them,
#   whereas Tegra30 and later have 5"
# - interrupt-controller : Identifies the node as an interrupt controller.
# - #interrupt-cells : Specifies the number of cells needed to encode an
#   interrupt source. The value must be 3.
# - interrupt-parent : a phandle to the GIC these interrupts are routed
#   to.
#
# Notes:
#
# - Because this HW ultimately routes interrupts to the GIC, the
#   interrupt specifier must be that of the GIC.
# - Only SPIs can use the ictlr as an interrupt parent. SGIs and PPIs
#   are explicitly forbidden.
#
# Example:
#
# 	ictlr: interrupt-controller@60004000 {
# 		compatible = "nvidia,tegra20-ictlr", "nvidia,tegra-ictlr";
# 		reg = <0x60004000 64>,
# 		      <0x60004100 64>,
# 		      <0x60004200 64>,
# 		      <0x60004300 64>;
# 		interrupt-controller;
# 		#interrupt-cells = <3>;
# 		interrupt-parent = <&intc>;
# 	};
```
