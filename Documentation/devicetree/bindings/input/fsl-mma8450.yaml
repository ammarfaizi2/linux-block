## Documentation/devicetree/bindings/input/fsl-mma8450.yaml
```yaml
%YAML 1.2
---
version: 1

id: fsl-mma8450

title: Freescale MMA8450 3-Axis Accelerometer

maintainer:
    -   name: Fabio Estevam <fabio.estevam@freescale.com>

description: >
    TODO

inherits:
    -   id: %ids%

properties:
    -   name: "compatible"
        constraint: |
            "fsl,mma8450"

    reg:

...

# * Freescale MMA8450 3-Axis Accelerometer
#
# Required properties:
# - compatible : "fsl,mma8450".
# - reg: the I2C address of MMA8450
#
# Example:
#
# accelerometer: mma8450@1c {
# 	compatible = "fsl,mma8450";
# 	reg = <0x1c>;
# };
```

## Documentation/devicetree/bindings/input/gpio-beeper.yaml
```yaml
%YAML 1.2
---
version: 1

id: gpio-beeper

title: GPIO beeper device tree bindings

maintainer:
    -   name: Alexander Shiyan <shc_work@mail.ru>

description: >
    TODO

inherits:
    -   id: %ids%

properties:
    -   name: "compatible"
        constraint: |
            "gpio-beeper"

    gpios:
    pinctrl-0:
    pinctrl-names:

...

# * GPIO beeper device tree bindings
#
# Register a beeper connected to GPIO pin.
#
# Required properties:
# - compatible:	Should be "gpio-beeper".
# - gpios:	From common gpio binding; gpio connection to beeper enable pin.
#
# Example:
# 	beeper: beeper {
# 		compatible = "gpio-beeper";
# 		gpios = <&gpio3 23 GPIO_ACTIVE_HIGH>;
# 	};
```

## Documentation/devicetree/bindings/input/pwm-beeper.yaml
```yaml
%YAML 1.2
---
version: 1

id: pwm-beeper

title: PWM beeper device tree bindings

maintainer:
    -   name: Sascha Hauer <s.hauer@pengutronix.de>

description: >
    TODO

inherits:
    -   id: %ids%

properties:
    -   name: "compatible"
        constraint: |
            "pwm-beeper"

    pinctrl-0:
    pinctrl-names:
    pwms:

...

# * PWM beeper device tree bindings
#
# Registers a PWM device as beeper.
#
# Required properties:
# - compatible: should be "pwm-beeper"
# - pwms: phandle to the physical PWM device
```

## Documentation/devicetree/bindings/input/qcom,pm8941-pwrkey.yaml
```yaml
%YAML 1.2
---
version: 1

id: qcom,pm8941-pwrkey

title: Qualcomm PM8941 PMIC Power Key

maintainer:
    -   name: Courtney Cavin <courtney.cavin@sonymobile.com>

description: >
    TODO

inherits:
    -   id: %ids%

properties:
    -   name: "compatible"
        constraint: |
            "qcom,pm8941-pwrkey"

    bias-pull-up:
    debounce:
    interrupts:
    reg:

...

# Qualcomm PM8941 PMIC Power Key
#
# PROPERTIES
#
# - compatible:
# 	Usage: required
# 	Value type: <string>
# 	Definition: must be one of:
# 		    "qcom,pm8941-pwrkey"
#
# - reg:
# 	Usage: required
# 	Value type: <prop-encoded-array>
# 	Definition: base address of registers for block
#
# - interrupts:
# 	Usage: required
# 	Value type: <prop-encoded-array>
# 	Definition: key change interrupt; The format of the specifier is
# 		    defined by the binding document describing the node's
# 		    interrupt parent.
#
# - debounce:
# 	Usage: optional
# 	Value type: <u32>
# 	Definition: time in microseconds that key must be pressed or released
# 		    for state change interrupt to trigger.
#
# - bias-pull-up:
# 	Usage: optional
# 	Value type: <empty>
# 	Definition: presence of this property indicates that the KPDPWR_N pin
# 		    should be configured for pull up.
#
# EXAMPLE
#
# 	pwrkey@800 {
# 		compatible = "qcom,pm8941-pwrkey";
# 		reg = <0x800>;
# 		interrupts = <0x0 0x8 0 IRQ_TYPE_EDGE_BOTH>;
# 		debounce = <15625>;
# 		bias-pull-up;
# 	};
```

## Documentation/devicetree/bindings/input/qcom,pm8xxx-pwrkey.yaml
```yaml
%YAML 1.2
---
version: 1

id: qcom,pm8xxx-pwrkey

title: Qualcomm PM8xxx PMIC Power Key

maintainer:
    -   name: Stephen Boyd <sboyd@codeaurora.org>

description: >
    TODO

inherits:
    -   id: %ids%

properties:
    -   name: "compatible"
        constraint: |
            "qcom,pm8921-pwrkey"
            "qcom,pm8058-pwrkey"

    debounce:
    interrupt-parent:
    interrupts:
    pull-up:
    reg:

...

# Qualcomm PM8xxx PMIC Power Key
#
# PROPERTIES
#
# - compatible:
# 	Usage: required
# 	Value type: <string>
# 	Definition: must be one of:
# 		    "qcom,pm8058-pwrkey"
# 		    "qcom,pm8921-pwrkey"
#
# - reg:
# 	Usage: required
# 	Value type: <prop-encoded-array>
# 	Definition: address of power key control register
#
# - interrupts:
# 	Usage: required
# 	Value type: <prop-encoded-array>
# 	Definition: the first interrupt specifies the key release interrupt
# 		    and the second interrupt specifies the key press interrupt.
# 		    The format of the specifier is defined by the binding
# 		    document describing the node's interrupt parent.
#
# - debounce:
# 	Usage: optional
# 	Value type: <u32>
# 	Definition: time in microseconds that key must be pressed or release
# 		    for state change interrupt to trigger.
#
# - pull-up:
# 	Usage: optional
# 	Value type: <empty>
# 	Definition: presence of this property indicates that the KPDPWR_N pin
# 		    should be configured for pull up.
#
# EXAMPLE
#
# 	pwrkey@1c {
# 		compatible = "qcom,pm8921-pwrkey";
# 		reg = <0x1c>;
# 		interrupt-parent = <&pmicintc>;
# 		interrupts = <50 1>, <51 1>;
# 		debounce = <15625>;
# 		pull-up;
# 	};
```

## Documentation/devicetree/bindings/input/regulator-haptic.yaml
```yaml
%YAML 1.2
---
version: 1

id: regulator-haptic

title: Regulator Haptic Device Tree Bindings

maintainer:
    -   name: Jaewon Kim <jaewon02.kim@samsung.com>

description: >
    TODO

inherits:
    -   id: %ids%

properties:
    -   name: "compatible"
        constraint: |
            "regulator-haptic"

    haptic-supply:
    max-microvolt:
    min-microvolt:

...

# * Regulator Haptic Device Tree Bindings
#
# Required Properties:
#  - compatible : Should be "regulator-haptic"
#  - haptic-supply : Power supply to the haptic motor.
# 	[*] refer Documentation/devicetree/bindings/regulator/regulator.txt
#
#  - max-microvolt : The maximum voltage value supplied to the haptic motor.
# 		[The unit of the voltage is a micro]
#
#  - min-microvolt : The minimum voltage value supplied to the haptic motor.
# 		[The unit of the voltage is a micro]
#
# Example:
#
# 	haptics {
# 		compatible = "regulator-haptic";
# 		haptic-supply = <&motor_regulator>;
# 		max-microvolt = <2700000>;
# 		min-microvolt = <1100000>;
# 	};
```

## Documentation/devicetree/bindings/input/touchscreen/bu21013.yaml
```yaml
%YAML 1.2
---
version: 1

id: bu21013

title: Rohm BU21013 Touch Screen

maintainer:
    -   name: Lee Jones <lee.jones@linaro.org>

description: >
    TODO

inherits:
    -   id: %ids%

properties:
    -   name: "compatible"
        constraint: |
            "rohm,bu21013"_"tp"

    avdd-supply:
    reg:
    reset-gpio:
    rohm,flip-y:
    rohm,touch-max-x:
    rohm,touch-max-y:
    touch-gpio:

...

# * Rohm BU21013 Touch Screen
#
# Required properties:
#  - compatible              : "rohm,bu21013_tp"
#  - reg                     :  I2C device address
#
# Optional properties:
#  - touch-gpio              : GPIO pin registering a touch event
#  - <supply_name>-supply    : Phandle to a regulator supply
#  - rohm,touch-max-x        : Maximum outward permitted limit in the X axis
#  - rohm,touch-max-y        : Maximum outward permitted limit in the Y axis
#  - rohm,flip-x             : Flip touch coordinates on the X axis
#  - rohm,flip-y             : Flip touch coordinates on the Y axis
#
# Example:
#
# 	i2c@80110000 {
# 		bu21013_tp@0x5c {
# 			compatible = "rohm,bu21013_tp";
# 			reg = <0x5c>;
# 			touch-gpio = <&gpio2 20 0x4>;
# 			avdd-supply = <&ab8500_ldo_aux1_reg>;
#
# 			rohm,touch-max-x = <384>;
# 			rohm,touch-max-y = <704>;
# 			rohm,flip-y;
# 		};
# 	};
```

## Documentation/devicetree/bindings/input/touchscreen/egalax-ts.yaml
```yaml
%YAML 1.2
---
version: 1

id: egalax-ts

title: EETI eGalax Multiple Touch Controller

maintainer:
    -   name: Fabio Estevam <fabio.estevam@freescale.com>

description: >
    TODO

inherits:
    -   id: %ids%

properties:
    -   name: "compatible"
        constraint: |
            "eeti,egalax"_"ts"

    interrupt-parent:
    interrupts:
    linux,wakeup:
    pinctrl-0:
    pinctrl-names:
    reg:
    wakeup-gpios:

...

# * EETI eGalax Multiple Touch Controller
#
# Required properties:
# - compatible: must be "eeti,egalax_ts"
# - reg: i2c slave address
# - interrupt-parent: the phandle for the interrupt controller
# - interrupts: touch controller interrupt
# - wakeup-gpios: the gpio pin to be used for waking up the controller
#   and also used as irq pin
#
# Example:
#
# 	egalax_ts@04 {
# 		compatible = "eeti,egalax_ts";
# 		reg = <0x04>;
# 		interrupt-parent = <&gpio1>;
# 		interrupts = <9 2>;
# 		wakeup-gpios = <&gpio1 9 0>;
# 	};
```

## Documentation/devicetree/bindings/input/touchscreen/lpc32xx-tsc.yaml
```yaml
%YAML 1.2
---
version: 1

id: lpc32xx-tsc

title: NXP LPC32xx SoC Touchscreen Controller (TSC)

maintainer:
    -   name: Roland Stigge <stigge@antcom.de>

description: >
    TODO

inherits:
    -   id: %ids%

properties:
    -   name: "compatible"
        constraint: |
            "nxp,lpc3220-tsc"

    interrupts:
    reg:
    status:

...

# * NXP LPC32xx SoC Touchscreen Controller (TSC)
#
# Required properties:
# - compatible: must be "nxp,lpc3220-tsc"
# - reg: physical base address of the controller and length of memory mapped
#   region.
# - interrupts: The TSC/ADC interrupt
#
# Example:
#
# 	tsc@40048000 {
# 		compatible = "nxp,lpc3220-tsc";
# 		reg = <0x40048000 0x1000>;
# 		interrupt-parent = <&mic>;
# 		interrupts = <39 0>;
# 	};
```

## Documentation/devicetree/bindings/input/touchscreen/mms114.yaml
```yaml
%YAML 1.2
---
version: 1

id: mms114

title: MELFAS MMS114 touchscreen controller

maintainer:
    -   name: Tomasz Figa <t.figa@samsung.com>

description: >
    TODO

inherits:
    -   id: %ids%

properties:
    -   name: "compatible"
        constraint: |
            "melfas,mms114"

    avdd-supply:
    interrupt-parent:
    interrupts:
    reg:
    vdd-supply:
    x-size:
    y-size:

...

# * MELFAS MMS114 touchscreen controller
#
# Required properties:
# - compatible: must be "melfas,mms114"
# - reg: I2C address of the chip
# - interrupts: interrupt to which the chip is connected
# - x-size: horizontal resolution of touchscreen
# - y-size: vertical resolution of touchscreen
#
# Optional properties:
# - contact-threshold:
# - moving-threshold:
# - x-invert: invert X axis
# - y-invert: invert Y axis
#
# Example:
#
# 	i2c@00000000 {
# 		/* ... */
#
# 		touchscreen@48 {
# 			compatible = "melfas,mms114";
# 			reg = <0x48>;
# 			interrupts = <39 0>;
# 			x-size = <720>;
# 			y-size = <1280>;
# 			contact-threshold = <10>;
# 			moving-threshold = <10>;
# 			x-invert;
# 			y-invert;
# 		};
#
# 		/* ... */
# 	};
```

## Documentation/devicetree/bindings/input/touchscreen/pixcir_i2c_ts.yaml
```yaml
%YAML 1.2
---
version: 1

id: pixcir_i2c_ts

title: Pixcir I2C touchscreen controllers

maintainer:
    -   name: Roger Quadros <rogerq@ti.com>

description: >
    TODO

inherits:
    -   id: %ids%

properties:
    -   name: "compatible"
        constraint: |
            "pixcir,pixcir"_"tangoc"

    attb-gpio:
    interrupt-parent:
    interrupts:
    pinctrl-0:
    pinctrl-names:
    reg:
    touchscreen-size-x:
    touchscreen-size-y:

...

# * Pixcir I2C touchscreen controllers
#
# Required properties:
# - compatible: must be "pixcir,pixcir_ts" or "pixcir,pixcir_tangoc"
# - reg: I2C address of the chip
# - interrupts: interrupt to which the chip is connected
# - attb-gpio: GPIO connected to the ATTB line of the chip
# - touchscreen-size-x: horizontal resolution of touchscreen (in pixels)
# - touchscreen-size-y: vertical resolution of touchscreen (in pixels)
#
# Optional properties:
# - reset-gpio: GPIO connected to the RESET line of the chip
#
# Example:
#
# 	i2c@00000000 {
# 		/* ... */
#
# 		pixcir_ts@5c {
# 			compatible = "pixcir,pixcir_ts";
# 			reg = <0x5c>;
# 			interrupts = <2 0>;
# 			attb-gpio = <&gpf 2 0 2>;
# 			touchscreen-size-x = <800>;
# 			touchscreen-size-y = <600>;
# 		};
#
# 		/* ... */
# 	};
```

## Documentation/devicetree/bindings/input/touchscreen/sitronix-st1232.yaml
```yaml
%YAML 1.2
---
version: 1

id: sitronix-st1232

title: Sitronix st1232 touchscreen controller

maintainer:
    -   name: Bastian Hecht <hechtb@gmail.com>

description: >
    TODO

inherits:
    -   id: %ids%

properties:
    -   name: "compatible"
        constraint: |
            "sitronix,st1232"

    gpios:
    interrupt-parent:
    interrupts:
    pinctrl-0:
    pinctrl-names:
    reg:

...

# * Sitronix st1232 touchscreen controller
#
# Required properties:
# - compatible: must be "sitronix,st1232"
# - reg: I2C address of the chip
# - interrupts: interrupt to which the chip is connected
#
# Optional properties:
# - gpios: a phandle to the reset GPIO
#
# Example:
#
# 	i2c@00000000 {
# 		/* ... */
#
# 		touchscreen@55 {
# 			compatible = "sitronix,st1232";
# 			reg = <0x55>;
# 			interrupts = <2 0>;
# 			gpios = <&gpio1 166 0>;
# 		};
#
# 		/* ... */
# 	};
```

## Documentation/devicetree/bindings/input/touchscreen/stmpe.yaml
```yaml
%YAML 1.2
---
version: 1

id: stmpe

title: STMPE Touchscreen

maintainer:
    -   name: Vipul Kumar Samar <vipulkumar.samar@st.com>

description: >
    TODO

inherits:
    -   id: %ids%

properties:
    -   name: "compatible"
        constraint: |
            "st,stmpe-ts"

    reg:
    st,adc-freq:
    st,ave-ctrl:
    st,fraction-z:
    st,i-drive:
    st,mod-12b:
    st,ref-sel:
    st,sample-time:
    st,settling:
    st,touch-det-delay:
    ts,adc-freq:
    ts,ave-ctrl:
    ts,fraction-z:
    ts,i-drive:
    ts,mod-12b:
    ts,ref-sel:
    ts,sample-time:
    ts,settling:
    ts,touch-det-delay:

...

# STMPE Touchscreen
# ----------------
#
# Required properties:
#  - compatible: "st,stmpe-ts"
#
# Optional properties:
# - st,sample-time: ADC converstion time in number of clock.  (0 -> 36 clocks, 1 ->
#   44 clocks, 2 -> 56 clocks, 3 -> 64 clocks, 4 -> 80 clocks, 5 -> 96 clocks, 6
#   -> 144 clocks), recommended is 4.
# - st,mod-12b: ADC Bit mode (0 -> 10bit ADC, 1 -> 12bit ADC)
# - st,ref-sel: ADC reference source (0 -> internal reference, 1 -> external
#   reference)
# - st,adc-freq: ADC Clock speed (0 -> 1.625 MHz, 1 -> 3.25 MHz, 2 || 3 -> 6.5 MHz)
# - st,ave-ctrl: Sample average control (0 -> 1 sample, 1 -> 2 samples, 2 -> 4
#   samples, 3 -> 8 samples)
# - st,touch-det-delay: Touch detect interrupt delay (0 -> 10 us, 1 -> 50 us, 2 ->
#   100 us, 3 -> 500 us, 4-> 1 ms, 5 -> 5 ms, 6 -> 10 ms, 7 -> 50 ms) recommended
#   is 3
# - st,settling: Panel driver settling time (0 -> 10 us, 1 -> 100 us, 2 -> 500 us, 3
#   -> 1 ms, 4 -> 5 ms, 5 -> 10 ms, 6 for 50 ms, 7 -> 100 ms) recommended is 2
# - st,fraction-z: Length of the fractional part in z (fraction-z ([0..7]) = Count of
#   the fractional part) recommended is 7
# - st,i-drive: current limit value of the touchscreen drivers (0 -> 20 mA typical 35
#   mA max, 1 -> 50 mA typical 80 mA max)
#
# Node name must be stmpe_touchscreen and should be child node of stmpe node to
# which it belongs.
#
# Example:
#
# 	stmpe_touchscreen {
# 		compatible = "st,stmpe-ts";
# 		st,sample-time = <4>;
# 		st,mod-12b = <1>;
# 		st,ref-sel = <0>;
# 		st,adc-freq = <1>;
# 		st,ave-ctrl = <1>;
# 		st,touch-det-delay = <2>;
# 		st,settling = <2>;
# 		st,fraction-z = <7>;
# 		st,i-drive = <1>;
# 	};
```
