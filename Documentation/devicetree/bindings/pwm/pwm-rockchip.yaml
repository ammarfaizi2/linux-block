## Documentation/devicetree/bindings/reset/berlin,reset.yaml
```yaml
%YAML 1.2
---
version: 1

id: berlin,reset

title: Marvell Berlin reset controller

maintainer:
    -   name: Antoine Tenart <antoine.tenart@free-electrons.com>

description: >
    TODO

inherits:
    -   id: %ids%

properties:
    -   name: "compatible"
        constraint: |
            "marvell,berlin2-reset"

    #reset-cells:

...

# Marvell Berlin reset controller
# ===============================
#
# Please also refer to reset.txt in this directory for common reset
# controller binding usage.
#
# The reset controller node must be a sub-node of the chip controller
# node on Berlin SoCs.
#
# Required properties:
# - compatible: should be "marvell,berlin2-reset"
# - #reset-cells: must be set to 2
#
# Example:
#
# chip_rst: reset {
# 	compatible = "marvell,berlin2-reset";
# 	#reset-cells = <2>;
# };
#
# &usb_phy0 {
# 	resets = <&chip_rst 0x104 12>;
# };
```

## Documentation/devicetree/bindings/reset/brcm,bcm21664-resetmgr.yaml
```yaml
%YAML 1.2
---
version: 1

id: brcm,bcm21664-resetmgr

title: Broadcom Kona Family Reset Manager

maintainer:
    -   name: Scott Branden <sbranden@broadcom.com>

description: >
    TODO

inherits:
    -   id: %ids%

properties:
    -   name: "compatible"
        constraint: |
            "brcm,bcm21664-resetmgr"

    reg:

...

# Broadcom Kona Family Reset Manager
# ----------------------------------
#
# The reset manager is used on the Broadcom BCM21664 SoC.
#
# Required properties:
#   - compatible: brcm,bcm21664-resetmgr
#   - reg: memory address & range
#
# Example:
# 	brcm,resetmgr@35001f00 {
# 		compatible = "brcm,bcm21664-resetmgr";
# 		reg = <0x35001f00 0x24>;
# 	};
```

## Documentation/devicetree/bindings/reset/gpio-reset.txt
```
GPIO reset controller
=====================

A GPIO reset controller controls a number of GPIOs that are connected
to reset pins of peripheral ICs.

Please also refer to reset.txt in this directory for common reset
controller binding usage.

Required properties:
- compatible: Should be "gpio-reset"
- reset-gpios: List of gpios used as reset lines. The gpio specifier for this
               property depends on the gpio controller that provides the gpio.
- #reset-cells: 1, see below

Optional properties:
- reset-delays: List of delays in microseconds. The corresponding gpio reset
                line should be asserted for this duration to reset.
- initially-in-reset: List of integers. Zero if the initial state should be
                      a deasserted reset line, nonzero if the line should be
                      kept in reset.

example:

gpio_reset: gpio-reset {
	compatible = "gpio-reset";
	reset-gpios = <&gpio5 0 1>; /* active-low */
	reset-delays = <10000>; /* 10 ms */
	initially-in-reset = <1>;
	#reset-cells = <1>;
};

/* Device with nRESET pin connected to GPIO5_0 */
sii902x@39 {
	/* ... */
	resets = <&gpio_reset 0>; /* active-low GPIO5_0, 10 ms reset delay */
};
```

## Documentation/devicetree/bindings/reset/socfpga-reset.yaml
```yaml
%YAML 1.2
---
version: 1

id: socfpga-reset

title: Altera SOCFPGA Reset Manager

maintainer:
    -   name: Dinh Nguyen <dinguyen@opensource.altera.com>

description: >
    TODO

inherits:
    -   id: %ids%

properties:
    -   name: "compatible"
        constraint: |
            "altr,rst-mgr"

    altr,modrst-offset:
    reg:
    #reset-cells:

...

# Altera SOCFPGA Reset Manager
#
# Required properties:
# - compatible : "altr,rst-mgr"
# - reg : Should contain 1 register ranges(address and length)
# - altr,modrst-offset : Should contain the offset of the first modrst register.
# - #reset-cells: 1
#
# Example:
# 	 rstmgr@ffd05000 {
# 		#reset-cells = <1>;
# 		compatible = "altr,rst-mgr";
# 		reg = <0xffd05000 0x1000>;
# 		altr,modrst-offset = <0x10>;
# 	};
```

## Documentation/devicetree/bindings/rng/brcm,bcm2835.yaml
```yaml
%YAML 1.2
---
version: 1

id: brcm,bcm2835

title: BCM2835 Random number generator

maintainer:
    -   name: Lubomir Rintel <lkundrak@v3.sk>

description: >
    TODO

inherits:
    -   id: %ids%

properties:
    -   name: "compatible"
        constraint: |
            "brcm,bcm2835-rng"

    reg:

...

# BCM2835 Random number generator
#
# Required properties:
#
# - compatible : should be "brcm,bcm2835-rng"
# - reg : Specifies base physical address and size of the registers.
#
# Example:
#
# rng {
#         compatible = "brcm,bcm2835-rng";
#         reg = <0x7e104000 0x10>;
# };
```

## Documentation/devicetree/bindings/rtc/atmel,at91rm9200-rtc.yaml
```yaml
%YAML 1.2
---
version: 1

id: atmel,at91rm9200-rtc

title: Atmel AT91RM9200 Real Time Clock

maintainer:
    -   name: Alexandre Belloni <alexandre.belloni@free-electrons.com>

description: >
    TODO

inherits:
    -   id: %ids%

properties:
    -   name: "compatible"
        constraint: |
            "atmel,at91sam9x5-rtc"
            "atmel,at91rm9200-rtc"

    clocks:
    interrupts:
    reg:
    status:

...

# Atmel AT91RM9200 Real Time Clock
#
# Required properties:
# - compatible: should be: "atmel,at91rm9200-rtc" or "atmel,at91sam9x5-rtc"
# - reg: physical base address of the controller and length of memory mapped
#   region.
# - interrupts: rtc alarm/event interrupt
# - clocks: phandle to input clock.
#
# Example:
#
# rtc@fffffe00 {
# 	compatible = "atmel,at91rm9200-rtc";
# 	reg = <0xfffffe00 0x100>;
# 	interrupts = <1 4 7>;
# 	clocks = <&clk32k>;
# };
```

## Documentation/devicetree/bindings/rtc/atmel,at91sam9-rtc.yaml
```yaml
%YAML 1.2
---
version: 1

id: atmel,at91sam9-rtc

title: Atmel AT91SAM9260 Real Time Timer

maintainer:
    -   name: Boris BREZILLON <boris.brezillon@free-electrons.com>

description: >
    TODO

inherits:
    -   id: %ids%

properties:
    -   name: "compatible"
        constraint: |
            "atmel,at91sam9260-rtt"

    atmel,rtt-rtc-time-reg:
    clocks:
    interrupts:
    reg:
    status:

...

# Atmel AT91SAM9260 Real Time Timer
#
# Required properties:
# - compatible: should be: "atmel,at91sam9260-rtt"
# - reg: should encode the memory region of the RTT controller
# - interrupts: rtt alarm/event interrupt
# - clocks: should contain the 32 KHz slow clk that will drive the RTT block.
# - atmel,rtt-rtc-time-reg: should encode the GPBR register used to store
# 	the time base when the RTT is used as an RTC.
# 	The first cell should point to the GPBR node and the second one
# 	encode the offset within the GPBR block (or in other words, the
# 	GPBR register used to store the time base).
#
#
# Example:
#
# rtt@fffffd20 {
# 	compatible = "atmel,at91sam9260-rtt";
# 	reg = <0xfffffd20 0x10>;
# 	interrupts = <1 4 7>;
# 	clocks = <&clk32k>;
# 	atmel,rtt-rtc-time-reg = <&gpbr 0x0>;
# };
```

## Documentation/devicetree/bindings/rtc/dallas,ds1339.yaml
```yaml
%YAML 1.2
---
version: 1

id: dallas,ds1339

title: Dallas DS1339		I2C Serial Real-Time Clock

maintainer:
    -   name: Matti Vaittinen <matti.vaittinen@nsn.com>

description: >
    TODO

inherits:
    -   id: %ids%

properties:
    -   name: "compatible"
        constraint: |
            "dallas,ds1339"

    interrupt-parent:
    interrupts:
    pinctrl-0:
    pinctrl-names:
    reg:
    status:

...

# * Dallas DS1339		I2C Serial Real-Time Clock
#
# Required properties:
# - compatible: Should contain "dallas,ds1339".
# - reg: I2C address for chip
#
# Optional properties:
# - trickle-resistor-ohms : Selected resistor for trickle charger
# 	Values usable for ds1339 are 250, 2000, 4000
# 	Should be given if trickle charger should be enabled
# - trickle-diode-disable : Do not use internal trickle charger diode
# 	Should be given if internal trickle charger diode should be disabled
# Example:
# 	ds1339: rtc@68 {
# 		compatible = "dallas,ds1339";
# 		trickle-resistor-ohms = <250>;
# 		reg = <0x68>;
# 	};
```

## Documentation/devicetree/bindings/rtc/digicolor-rtc.yaml
```yaml
%YAML 1.2
---
version: 1

id: digicolor-rtc

title: Conexant Digicolor Real Time Clock controller

maintainer:
    -   name: Baruch Siach <baruch@tkos.co.il>

description: >
    TODO

inherits:
    -   id: %ids%

properties:
    -   name: "compatible"
        constraint: |
            "cnxt,cx92755-rtc"

    interrupts:
    reg:

...

# Conexant Digicolor Real Time Clock controller
#
# This binding currently supports the CX92755 SoC.
#
# Required properties:
# - compatible: should be "cnxt,cx92755-rtc"
# - reg: physical base address of the controller and length of memory mapped
#   region.
# - interrupts: rtc alarm interrupt
#
# Example:
#
# 	rtc@f0000c30 {
# 		compatible = "cnxt,cx92755-rtc";
# 		reg = <0xf0000c30 0x18>;
# 		interrupts = <25>;
# 	};
```

## Documentation/devicetree/bindings/rtc/haoyu,hym8563.yaml
```yaml
%YAML 1.2
---
version: 1

id: haoyu,hym8563

title: Haoyu Microelectronics HYM8563 Real Time Clock

maintainer:
    -   name: Heiko Stuebner <heiko@sntech.de>

description: >
    TODO

inherits:
    -   id: %ids%

properties:
    -   name: "compatible"
        constraint: |
            "haoyu,hym8563"

    #clock-cells:
    clock-frequency:
    clock-output-names:
    interrupt-parent:
    interrupts:
    pinctrl-0:
    pinctrl-names:
    reg:

...

# Haoyu Microelectronics HYM8563 Real Time Clock
#
# The HYM8563 provides basic rtc and alarm functionality
# as well as a clock output of up to 32kHz.
#
# Required properties:
# - compatible: should be: "haoyu,hym8563"
# - reg: i2c address
# - #clock-cells: the value should be 0
#
# Optional properties:
# - clock-output-names: From common clock binding
# - interrupts: rtc alarm/event interrupt
#
# Example:
#
# hym8563: hym8563@51 {
# 	compatible = "haoyu,hym8563";
# 	reg = <0x51>;
#
# 	interrupts = <13 IRQ_TYPE_EDGE_FALLING>;
#
# 	#clock-cells = <0>;
# };
#
# device {
# ...
# 	clocks = <&hym8563>;
# ...
# };
```

## Documentation/devicetree/bindings/rtc/lpc32xx-rtc.yaml
```yaml
%YAML 1.2
---
version: 1

id: lpc32xx-rtc

title: NXP LPC32xx SoC Real Time Clock controller

maintainer:
    -   name: Roland Stigge <stigge@antcom.de>

description: >
    TODO

inherits:
    -   id: %ids%

properties:
    -   name: "compatible"
        constraint: |
            "nxp,lpc3220-rtc"

    interrupts:
    reg:

...

# * NXP LPC32xx SoC Real Time Clock controller
#
# Required properties:
# - compatible: must be "nxp,lpc3220-rtc"
# - reg: physical base address of the controller and length of memory mapped
#   region.
# - interrupts: The RTC interrupt
#
# Example:
#
# 	rtc@40024000 {
# 		compatible = "nxp,lpc3220-rtc";
# 		reg = <0x40024000 0x1000>;
# 		interrupts = <52 0>;
# 	};
```

## Documentation/devicetree/bindings/rtc/moxa,moxart-rtc.yaml
```yaml
%YAML 1.2
---
version: 1

id: moxa,moxart-rtc

title: MOXA ART real-time clock

maintainer:
    -   name: Jonas Jensen <jonas.jensen@gmail.com>

description: >
    TODO

inherits:
    -   id: %ids%

properties:
    -   name: "compatible"
        constraint: |
            "moxa,moxart-rtc"

    gpio-rtc-data:
    gpio-rtc-reset:
    gpio-rtc-sclk:

...

# MOXA ART real-time clock
#
# Required properties:
#
# - compatible : Should be "moxa,moxart-rtc"
# - gpio-rtc-sclk : RTC sclk gpio, with zero flags
# - gpio-rtc-data : RTC data gpio, with zero flags
# - gpio-rtc-reset : RTC reset gpio, with zero flags
#
# Example:
#
# 	rtc: rtc {
# 		compatible = "moxa,moxart-rtc";
# 		gpio-rtc-sclk = <&gpio 5 0>;
# 		gpio-rtc-data = <&gpio 6 0>;
# 		gpio-rtc-reset = <&gpio 7 0>;
# 	};
```

## Documentation/devicetree/bindings/rtc/orion-rtc.yaml
```yaml
%YAML 1.2
---
version: 1

id: orion-rtc

title: Mvebu Real Time Clock

maintainer:
    -   name: Gregory CLEMENT <gregory.clement@free-electrons.com>

description: >
    TODO

inherits:
    -   id: %ids%

properties:
    -   name: "compatible"
        constraint: |
            "marvell,orion-rtc"
            "marvell,kirkwood-rtc" && "marvell,orion-rtc"

    clocks:
    interrupts:
    reg:
    status:

...

# * Mvebu Real Time Clock
#
# RTC controller for the Kirkwood, the Dove, the Armada 370 and the
# Armada XP SoCs
#
# Required properties:
# - compatible : Should be "marvell,orion-rtc"
# - reg: physical base address of the controller and length of memory mapped
#   region.
# - interrupts: IRQ line for the RTC.
#
# Example:
#
# rtc@10300 {
#         compatible = "marvell,orion-rtc";
#         reg = <0xd0010300 0x20>;
#         interrupts = <50>;
# };
```

## Documentation/devicetree/bindings/rtc/pxa-rtc.yaml
```yaml
%YAML 1.2
---
version: 1

id: pxa-rtc

title: PXA RTC

maintainer:
    -   name: Daniel Mack <zonque@gmail.com>

description: >
    TODO

inherits:
    -   id: %ids%

properties:
    -   name: "compatible"
        constraint: |
            "marvell,pxa-rtc"


...

# * PXA RTC
#
# PXA specific RTC driver.
#
# Required properties:
# - compatible : Should be "marvell,pxa-rtc"
#
# Examples:
#
# rtc@40900000 {
# 	compatible = "marvell,pxa-rtc";
# 	reg = <0x40900000 0x3c>;
# 	interrupts = <30 31>;
# };
```
