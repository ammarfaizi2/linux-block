## Documentation/devicetree/bindings/pwm/pwm-rockchip.yaml
```yaml
%YAML 1.2
---
version: 1

id: pwm-rockchip

title: Rockchip PWM controller

maintainer:
    -   name: Beniamino Galvani <b.galvani@gmail.com>

description: >
    TODO

inherits:
    -   id: %ids%

properties:
    -   name: "compatible"
        constraint: |
            "rockchip,rk3288-pwm"
            "rockchip,rk2928-pwm"

    clocks:
    pinctrl-0:
    pinctrl-names:
    #pwm-cells:
    reg:
    status:

...

# Rockchip PWM controller
#
# Required properties:
#  - compatible: should be "rockchip,<name>-pwm"
#    "rockchip,rk2928-pwm": found on RK29XX,RK3066 and RK3188 SoCs
#    "rockchip,rk3288-pwm": found on RK3288 SoC
#    "rockchip,vop-pwm": found integrated in VOP on RK3288 SoC
#  - reg: physical base address and length of the controller's registers
#  - clocks: phandle and clock specifier of the PWM reference clock
#  - #pwm-cells: must be 2 (rk2928) or 3 (rk3288). See pwm.txt in this directory
#    for a description of the cell format.
#
# Example:
#
# 	pwm0: pwm@20030000 {
# 		compatible = "rockchip,rk2928-pwm";
# 		reg = <0x20030000 0x10>;
# 		clocks = <&cru PCLK_PWM01>;
# 		#pwm-cells = <2>;
# 	};
```

## Documentation/devicetree/bindings/pwm/ti,twl-pwm.yaml
```yaml
%YAML 1.2
---
version: 1

id: ti,twl-pwm

title: Texas Instruments TWL series PWM drivers

maintainer:
    -   name: Laurent Pinchart <laurent.pinchart+renesas@ideasonboard.com>

description: >
    TODO

inherits:
    -   id: %ids%

properties:
    -   name: "compatible"
        constraint: |
            "ti,twl6030-pwm"
            "ti,twl4030-pwm"

    #pwm-cells:

...

# Texas Instruments TWL series PWM drivers
#
# Supported PWMs:
# On TWL4030 series: PWM1 and PWM2
# On TWL6030 series: PWM0 and PWM1
#
# Required properties:
# - compatible: "ti,twl4030-pwm" or "ti,twl6030-pwm"
# - #pwm-cells: should be 2. See pwm.txt in this directory for a description of
#   the cells format.
#
# Example:
#
# twl_pwm: pwm {
# 	compatible = "ti,twl6030-pwm";
# 	#pwm-cells = <2>;
# };
```

## Documentation/devicetree/bindings/pwm/ti,twl-pwmled.yaml
```yaml
%YAML 1.2
---
version: 1

id: ti,twl-pwmled

title: Texas Instruments TWL series PWM drivers connected to LED terminals

maintainer:
    -   name: Laurent Pinchart <laurent.pinchart+renesas@ideasonboard.com>

description: >
    TODO

inherits:
    -   id: %ids%

properties:
    -   name: "compatible"
        constraint: |
            "ti,twl6030-pwmled"
            "ti,twl4030-pwmled"

    #pwm-cells:

...

# Texas Instruments TWL series PWM drivers connected to LED terminals
#
# Supported PWMs:
# On TWL4030 series: PWMA and PWMB (connected to LEDA and LEDB terminals)
# On TWL6030 series: LED PWM (mainly used as charging indicator LED)
#
# Required properties:
# - compatible: "ti,twl4030-pwmled" or "ti,twl6030-pwmled"
# - #pwm-cells: should be 2. See pwm.txt in this directory for a description of
#   the cells format.
#
# Example:
#
# twl_pwmled: pwmled {
# 	compatible = "ti,twl6030-pwmled";
# 	#pwm-cells = <2>;
# };
```

## Documentation/devicetree/bindings/regulator/88pm860x.yaml
```yaml
%YAML 1.2
---
version: 1

id: 88pm860x

title: Marvell 88PM860x regulator

maintainer:
    -   name: Haojian Zhuang <haojian.zhuang@gmail.com>

description: >
    TODO

inherits:
    -   id: %ids%

properties:
    -   name: "compatible"
        constraint: |
            "marvell,88pm860x"

    #interrupt-cells:
    interrupt-controller:
    interrupt-parent:
    interrupts:
    marvell,88pm860x-irq-read-clr:
    marvell,88pm860x-slave-addr:
    reg:

...

# Marvell 88PM860x regulator
#
# Required properties:
# - compatible: "marvell,88pm860x"
# - reg: I2C slave address
# - regulators: A node that houses a sub-node for each regulator within the
#   device. Each sub-node is identified using the regulator-compatible
#   property, with valid values listed below.
#
# Example:
#
# 	pmic: 88pm860x@34 {
# 		compatible = "marvell,88pm860x";
# 		reg = <0x34>;
#
# 		regulators {
# 			BUCK1 {
# 			        regulator-min-microvolt = <1000000>;
# 			        regulator-max-microvolt = <1500000>;
# 			        regulator-boot-on;
# 			        regulator-always-on;
# 			};
# 			BUCK3 {
# 			        regulator-min-microvolt = <1000000>;
# 			        regulator-max-microvolt = <3000000>;
# 			        regulator-boot-on;
# 			        regulator-always-on;
# 			};
# 		};
# 	};
```

## Documentation/devicetree/bindings/regulator/da9210.yaml
```yaml
%YAML 1.2
---
version: 1

id: da9210

title: Dialog Semiconductor DA9210 Voltage Regulator

maintainer:
    -   name: Geert Uytterhoeven <geert+renesas@glider.be>

description: >
    TODO

inherits:
    -   id: %ids%

properties:
    -   name: "compatible"
        constraint: |
            "dlg,da9210"

    interrupt-parent:
    interrupts:
    reg:
    regulator-always-on:
    regulator-boot-on:
    regulator-max-microvolt:
    regulator-min-microvolt:

...

# * Dialog Semiconductor DA9210 Voltage Regulator
#
# Required properties:
#
# - compatible:	must be "dlg,da9210"
# - reg:		the i2c slave address of the regulator. It should be 0x68.
#
# Optional properties:
#
# - interrupts:	a reference to the DA9210 interrupt, if available.
#
# Any standard regulator properties can be used to configure the single da9210
# DCDC.
#
# Example:
#
# 	da9210@68 {
# 		compatible = "dlg,da9210";
# 		reg = <0x68>;
#
# 		regulator-min-microvolt = <900000>;
# 		regulator-max-microvolt = <1000000>;
# 		regulator-boot-on;
# 		regulator-always-on;
# 	};
```

## Documentation/devicetree/bindings/regulator/fan53555.yaml
```yaml
%YAML 1.2
---
version: 1

id: fan53555

title: Binding for Fairchild FAN53555 regulators

maintainer:
    -   name: Heiko Stuebner <heiko@sntech.de>

description: >
    TODO

inherits:
    -   id: %ids%

properties:
    -   name: "compatible"
        constraint: |
            "silergy,syr828"
            "silergy,syr827"

    fcs,suspend-voltage-selector:
    reg:
    regulator-always-on:
    regulator-boot-on:
    regulator-enable-ramp-delay:
    regulator-max-microvolt:
    regulator-min-microvolt:
    regulator-name:
    regulator-ramp-delay:
    vin-supply:

...

# Binding for Fairchild FAN53555 regulators
#
# Required properties:
#   - compatible: one of "fcs,fan53555", "silergy,syr827", "silergy,syr828"
#   - reg: I2C address
#
# Optional properties:
#   - fcs,suspend-voltage-selector: declare which of the two available
# 		voltage selector registers should be used for the suspend
# 		voltage. The other one is used for the runtime voltage setting
# 		Possible values are either <0> or <1>
#   - vin-supply: regulator supplying the vin pin
#
# Example:
#
# 	regulator@40 {
# 		compatible = "fcs,fan53555";
# 		regulator-name = "fan53555";
# 		regulator-min-microvolt = <1000000>;
# 		regulator-max-microvolt = <1800000>;
# 		vin-supply = <&parent_reg>;
# 		fcs,suspend-voltage-selector = <1>;
# 	};
```

## Documentation/devicetree/bindings/regulator/max8907.yaml
```yaml
%YAML 1.2
---
version: 1

id: max8907

title: MAX8907 regulator

maintainer:
    -   name: Stephen Warren <swarren@nvidia.com>

description: >
    TODO

inherits:
    -   id: %ids%

properties:
    -   name: "compatible"
        constraint: |
            "maxim,max8907"

    in10-supply:
    in11-supply:
    in12-supply:
    in13-supply:
    in14-supply:
    in15-supply:
    in16-supply:
    in17-supply:
    in18-supply:
    in19-supply:
    in1-supply:
    in20-supply:
    in2-supply:
    in3-supply:
    in4-supply:
    in5-supply:
    in6-supply:
    in7-supply:
    in8-supply:
    in9-supply:
    interrupts:
    in-v1-supply:
    in-v2-supply:
    in-v3-supply:
    maxim,system-power-controller:
    mbatt-supply:
    reg:

...

# MAX8907 regulator
#
# Required properties:
# - compatible: "maxim,max8907"
# - reg: I2C slave address
# - interrupts: The interrupt output of the controller
# - mbatt-supply: The input supply for MBATT, BBAT, SDBY, VRTC.
# - in-v1-supply: The input supply for SD1.
# - in-v2-supply: The input supply for SD2.
# - in-v3-supply: The input supply for SD3.
# - in1-supply: The input supply for LDO1.
# ...
# - in20-supply: The input supply for LDO20.
# - regulators: A node that houses a sub-node for each regulator within the
#   device. Each sub-node is identified using the node's name (or the deprecated
#   regulator-compatible property if present), with valid values listed below.
#   The content of each sub-node is defined by the standard binding for
#   regulators; see regulator.txt.
#
# Optional properties:
# - maxim,system-power-controller: Boolean property indicating that the PMIC
#   controls the overall system power.
#
# The valid names for regulators are:
#
#   sd1, sd2, sd3, ldo1, ldo2, ldo3, ldo4, ldo5, ldo6, ldo7, ldo8, ldo9, ldo10,
#   ldo11, ldo12, ldo13, ldo14, ldo15, ldo16, ldo17, ldo18, ldo19, ldo20, out5v,
#   out33v, bbat, sdby, vrtc.
#
# Example:
#
# 		max8907@3c {
# 			compatible = "maxim,max8907";
# 			reg = <0x3c>;
# 			interrupts = <0 86 0x4>;
#
# 			maxim,system-power-controller;
#
# 			mbatt-supply = <&some_reg>;
# 			in-v1-supply = <&mbatt_reg>;
# 			...
# 			in1-supply = <&mbatt_reg>;
# 			...
#
# 			regulators {
# 				mbatt_reg: mbatt {
# 					regulator-name = "vbat_pmu";
# 					regulator-min-microvolt = <5000000>;
# 					regulator-max-microvolt = <5000000>;
# 					regulator-always-on;
# 				};
#
# 				sd1 {
# 					regulator-name = "nvvdd_sv1,vdd_cpu_pmu";
# 					regulator-min-microvolt = <1000000>;
# 					regulator-max-microvolt = <1000000>;
# 					regulator-always-on;
# 				};
#
# 				sd2 {
# 					regulator-name = "nvvdd_sv2,vdd_core";
# 					regulator-min-microvolt = <1200000>;
# 					regulator-max-microvolt = <1200000>;
# 					regulator-always-on;
# 				};
# ...
# 			};
# 		};
# 	};
```

## Documentation/devicetree/bindings/regulator/pbias-regulator.yaml
```yaml
%YAML 1.2
---
version: 1

id: pbias-regulator

title: PBIAS internal regulator for SD card dual voltage i/o pads on OMAP SoCs.

maintainer:
    -   name: Balaji T K <balajitk@ti.com>

description: >
    TODO

inherits:
    -   id: %ids%

properties:
    -   name: "compatible"
        constraint: |
            "ti,pbias-omap5" && "ti,pbias-omap"
            "ti,pbias-omap4" && "ti,pbias-omap"
            "ti,pbias-omap3" && "ti,pbias-omap"
            "ti,pbias-omap2" && "ti,pbias-omap"
            "ti,pbias-dra7" && "ti,pbias-omap"

    reg:
    syscon:

...

# PBIAS internal regulator for SD card dual voltage i/o pads on OMAP SoCs.
#
# Required properties:
# - compatible:
#   - should be "ti,pbias-dra7" for DRA7
#   - should be "ti,pbias-omap2" for OMAP2
#   - should be "ti,pbias-omap3" for OMAP3
#   - should be "ti,pbias-omap4" for OMAP4
#   - should be "ti,pbias-omap5" for OMAP5
#   - "ti,pbias-omap" is deprecated
# - reg: pbias register offset from syscon base and size of pbias register.
# - syscon : phandle of the system control module
# - regulator-name : should be
# 			pbias_mmc_omap2430 for OMAP2430, OMAP3 SoCs
# 			pbias_sim_omap3 for OMAP3 SoCs
# 			pbias_mmc_omap4 for OMAP4 SoCs
# 			pbias_mmc_omap5 for OMAP5 and DRA7 SoC
#
# Optional properties:
# - Any optional property defined in bindings/regulator/regulator.txt
#
# Example:
#
# 		pbias_regulator: pbias_regulator {
# 			compatible = "ti,pbias-omap";
# 			reg = <0 0x4>;
# 			syscon = <&omap5_padconf_global>;
# 			pbias_mmc_reg: pbias_mmc_omap5 {
# 				regulator-name = "pbias_mmc_omap5";
# 				regulator-min-microvolt = <1800000>;
# 				regulator-max-microvolt = <3000000>;
# 			};
```

## Documentation/devicetree/bindings/regulator/tps65218.yaml
```yaml
%YAML 1.2
---
version: 1

id: tps65218

title: TPS65218 family of regulators

maintainer:
    -   name: Keerthy <j-keerthy@ti.com>

description: >
    TODO

inherits:
    -   id: %ids%

properties:
    -   name: "compatible"
        constraint: |
            "ti,tps65218-ldo1"
            "ti,tps65218-dcdc6"
            "ti,tps65218-dcdc5"
            "ti,tps65218-dcdc4"
            "ti,tps65218-dcdc3"
            "ti,tps65218-dcdc2"
            "ti,tps65218-dcdc1"
            "ti,tps65218"

    #interrupt-cells:
    interrupt-controller:
    interrupts:
    reg:

...

# TPS65218 family of regulators
#
# Required properties:
# For tps65218 regulators/LDOs
# - compatible:
#   - "ti,tps65218-dcdc1" for DCDC1
#   - "ti,tps65218-dcdc2" for DCDC2
#   - "ti,tps65218-dcdc3" for DCDC3
#   - "ti,tps65218-dcdc4" for DCDC4
#   - "ti,tps65218-dcdc5" for DCDC5
#   - "ti,tps65218-dcdc6" for DCDC6
#   - "ti,tps65218-ldo1" for LDO1
#
# Optional properties:
# - Any optional property defined in bindings/regulator/regulator.txt
#
# Example:
#
# 	xyz: regulator@0 {
# 		compatible = "ti,tps65218-dcdc1";
# 		regulator-min-microvolt  = <1000000>;
# 		regulator-max-microvolt  = <3000000>;
# 	};
```

## Documentation/devicetree/bindings/regulator/vexpress.yaml
```yaml
%YAML 1.2
---
version: 1

id: vexpress

title: Versatile Express voltage regulators

maintainer:
    -   name: Pawel Moll <pawel.moll@arm.com>

description: >
    TODO

inherits:
    -   id: %ids%

properties:
    -   name: "compatible"
        constraint: |
            "arm,vexpress-volt"

    arm,vexpress-sysreg,func:
    label:
    regulator-always-on:
    regulator-max-microvolt:
    regulator-min-microvolt:
    regulator-name:

...

# Versatile Express voltage regulators
# ------------------------------------
#
# Requires node properties:
# - "compatible" value: "arm,vexpress-volt"
# - "arm,vexpress-sysreg,func" when controlled via vexpress-sysreg
#   (see Documentation/devicetree/bindings/arm/vexpress-sysreg.txt
#   for more details)
#
# Required regulator properties:
# - "regulator-name"
# - "regulator-always-on"
#
# Optional regulator properties:
# - "regulator-min-microvolt"
# - "regulator-max-microvolt"
#
# See Documentation/devicetree/bindings/regulator/regulator.txt
# for more details about the regulator properties.
#
# When no "regulator-[min|max]-microvolt" properties are defined,
# the device is treated as fixed (or rather "read-only") regulator.
#
# Example:
# 	volt@0 {
# 		compatible = "arm,vexpress-volt";
# 		arm,vexpress-sysreg,func = <2 0>;
# 		regulator-name = "Cores";
# 		regulator-min-microvolt = <800000>;
# 		regulator-max-microvolt = <1050000>;
# 		regulator-always-on;
# 	};
```

## Documentation/devicetree/bindings/reset/allwinner,sunxi-clock-reset.yaml
```yaml
%YAML 1.2
---
version: 1

id: allwinner,sunxi-clock-reset

title: Allwinner sunxi Peripheral Reset Controller

maintainer:
    -   name: Boris BREZILLON <boris.brezillon@free-electrons.com>

description: >
    TODO

inherits:
    -   id: %ids%

properties:
    -   name: "compatible"
        constraint: |
            "allwinner,sun6i-a31-clock-reset"
            "allwinner,sun6i-a31-ahb1-reset"

    reg:
    #reset-cells:

...

# Allwinner sunxi Peripheral Reset Controller
# ===========================================
#
# Please also refer to reset.txt in this directory for common reset
# controller binding usage.
#
# Required properties:
# - compatible: Should be one of the following:
#   "allwinner,sun6i-a31-ahb1-reset"
#   "allwinner,sun6i-a31-clock-reset"
# - reg: should be register base and length as documented in the
#   datasheet
# - #reset-cells: 1, see below
#
# example:
#
# ahb1_rst: reset@01c202c0 {
# 	#reset-cells = <1>;
# 	compatible = "allwinner,sun6i-a31-ahb1-reset";
# 	reg = <0x01c202c0 0xc>;
# };
```
