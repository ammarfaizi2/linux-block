## Documentation/devicetree/bindings/watchdog/stericsson-coh901327.yaml
```yaml
%YAML 1.2
---
version: 1

id: stericsson-coh901327

title: ST-Ericsson COH 901 327 Watchdog timer

maintainer:
    -   name: Linus Walleij <linus.walleij@linaro.org>

description: >
    TODO

inherits:
    -   id: %ids%

properties:
    -   name: "compatible"
        constraint: |
            "stericsson,coh901327"

    clocks:
    interrupt-parent:
    interrupts:
    reg:

...

# ST-Ericsson COH 901 327 Watchdog timer
#
# Required properties:
# - compatible: must be "stericsson,coh901327".
# - reg: physical base address of the controller and length of memory mapped
#   region.
# - interrupts: the interrupt used for the watchdog timeout warning.
#
# Optional properties:
# - timeout-sec: contains the watchdog timeout in seconds.
#
# Example:
#
# watchdog: watchdog@c0012000 {
# 	compatible = "stericsson,coh901327";
# 	reg = <0xc0012000 0x1000>;
# 	interrupts = <3>;
# 	timeout-sec = <60>;
# };
```

## Documentation/devicetree/bindings/watchdog/sunxi-wdt.yaml
```yaml
%YAML 1.2
---
version: 1

id: sunxi-wdt

title: Allwinner SoCs Watchdog timer

maintainer:
    -   name: Maxime Ripard <maxime.ripard@free-electrons.com>

description: >
    TODO

inherits:
    -   id: %ids%

properties:
    -   name: "compatible"
        constraint: |
            "allwinner,sun6i-a31-wdt"
            "allwinner,sun4i-a10-wdt"

    reg:

...

# Allwinner SoCs Watchdog timer
#
# Required properties:
#
# - compatible : should be either "allwinner,sun4i-a10-wdt" or
#                "allwinner,sun6i-a31-wdt"
# - reg : Specifies base physical address and size of the registers.
#
# Example:
#
# wdt: watchdog@01c20c90 {
# 	compatible = "allwinner,sun4i-a10-wdt";
# 	reg = <0x01c20c90 0x10>;
# };
```

## Documentation/devicetree/bindings/watchdog/twl4030-wdt.yaml
```yaml
%YAML 1.2
---
version: 1

id: twl4030-wdt

title: Device tree bindings for twl4030-wdt driver (TWL4030 watchdog)

maintainer:
    -   name: Aaro Koskinen <aaro.koskinen@iki.fi>

description: >
    TODO

inherits:
    -   id: %ids%

properties:
    -   name: "compatible"
        constraint: |
            "ti,twl4030-wdt"

    "ti,twl4030-wdt"::

...

# Device tree bindings for twl4030-wdt driver (TWL4030 watchdog)
#
# Required properties:
# 	compatible = "ti,twl4030-wdt";
#
# Example:
#
# watchdog {
# 	compatible = "ti,twl4030-wdt";
# };
```

## arch/s390/Kconfig.debug
```kconfig
# SPDX-License-Identifier: GPL-2.0

config TRACE_IRQFLAGS_SUPPORT
	def_bool y

config EARLY_PRINTK
	def_bool y


config CIO_INJECT
       bool "CIO Inject interfaces"
       depends on DEBUG_KERNEL && DEBUG_FS
       help
	This option provides a debugging facility to inject certain artificial events
	and instruction responses to the CIO layer of Linux kernel. The newly created
	debugfs user-interfaces will be at /sys/kernel/debug/s390/cio/*
```

## drivers/clk/versatile/Kconfig
```kconfig
# SPDX-License-Identifier: GPL-2.0-only
config ICST
	bool "Clock driver for ARM Reference designs ICST" if COMPILE_TEST
	default y if (ARCH_INTEGRATOR || ARCH_REALVIEW || ARCH_VERSATILE)
	select REGMAP_MMIO
	---help---
	  Supports clocking on ARM Reference designs:
	  - Integrator/AP and Integrator/CP
	  - RealView PB1176, EB, PB11MP and PBX

config CLK_SP810
	bool "Clock driver for ARM SP810 System Controller"
	depends on ARCH_REALVIEW || ARCH_VEXPRESS
	default y if (ARCH_VEXPRESS && ARM)
	---help---
	  Supports clock muxing (REFCLK/TIMCLK to TIMERCLKEN0-3) capabilities
	  of the ARM SP810 System Controller cell.

config CLK_VEXPRESS_OSC
	bool "Clock driver for Versatile Express OSC clock generators" if COMPILE_TEST
	depends on VEXPRESS_CONFIG
	default y if ARCH_VEXPRESS
	---help---
	  Simple regmap-based driver driving clock generators on Versatile
	  Express platforms hidden behind its configuration infrastructure,
	  commonly known as OSCs.
```

## drivers/gpu/drm/panfrost/Kconfig
```kconfig
# SPDX-License-Identifier: GPL-2.0

config DRM_PANFROST
	tristate "Panfrost (DRM support for ARM Mali Midgard/Bifrost GPUs)"
	depends on DRM
	depends on ARCH_ROCKCHIP
	depends on MMU
	select DRM_SCHED
	select IOMMU_SUPPORT
	select IOMMU_IO_PGTABLE_LPAE
	select DRM_GEM_SHMEM_HELPER
	help
	  DRM driver for ARM Mali Midgard (t6xx, t7xx, t8xx) and
	  Bifrost (G3x, G5x, G7x) GPUs.
```

## drivers/gpu/drm/zte/Kconfig
```kconfig
config DRM_ZTE
	tristate "DRM Support for ZTE SoCs"
	depends on DRM
	depends on ARCH_ZX || COMPILE_TEST
	select DRM_KMS_CMA_HELPER
	select DRM_KMS_FB_HELPER
	select DRM_KMS_HELPER
	help
	  Choose this option to enable DRM on ZTE ZX SoCs.
```

## drivers/infiniband/ulp/isert/Kconfig
```kconfig
config INFINIBAND_ISERT
	tristate "InfiniBand iSCSI Extentions for RDMA (iSER) Target support"
	depends on INFINIBAND && TARGET_CORE && ISCSI_TARGET
	---help---

	Support for iSCSI Extentions for RDMA (iSER) Target on Infiniband fabrics.
```

## drivers/interconnect/riscv/Kconfig
```kconfig
# SPDX-License-Identifier: GPL-2.0-only
config INTERCONNECT_RISCV
	tristate "RISC-V Interconnect Drivers"
	depends on RISCV
	help
	  Support for RISC-V interconnect hardware.

	  If in doubt, say Y.

config INTERCONNECT_RISCV_QOS
	tristate "RISC-V QoS (Ssqosid) Support"
	depends on INTERCONNECT_RISCV
	help
	  Support for Ssqosid, the RISC-V extension for QOS IDs.

	  Please say N, this is a joke.
```

## drivers/net/wireless/ath/ath11k/Kconfig
```kconfig
# SPDX-License-Identifier: BSD-3-Clause-Clear
config ATH11K
	tristate "Qualcomm Technologies 802.11ax chipset support"
	depends on MAC80211 && HAS_DMA
	depends on REMOTEPROC
	select ATH_COMMON
	select QCOM_QMI_HELPERS
	---help---
	  This module adds support for Qualcomm Technologies 802.11ax family of
	  chipsets.

	  If you choose to build a module, it'll be called ath11k.

config ATH11K_AHB
	tristate "Atheros ath11k AHB support"
	depends on ATH11K
	---help---
	  This module adds support for AHB bus

config ATH11K_PCI
	tristate "Atheros ath11k PCI support"
	depends on ATH11K && PCI
	---help---
	  This module adds support for PCIE bus

config ATH11K_DEBUG
	bool "QCA ath11k debugging"
	depends on ATH11K
	---help---
	  Enables debug support

	  If unsure, say Y to make it easier to debug problems.

config ATH11K_DEBUGFS
	bool "QCA ath11k debugfs support"
	depends on ATH11K && DEBUG_FS
	---help---
	  Enable ath11k debugfs support

	  If unsure, say Y to make it easier to debug problems.

config ATH11K_TRACING
	bool "ath11k tracing support"
	depends on ATH11K && EVENT_TRACING
	---help---
	  Select this to use ath11k tracing infrastructure.
```

## drivers/net/wireless/ath/ath12k/Kconfig
```kconfig
# SPDX-License-Identifier: BSD-3-Clause-Clear
config ATH12K
	tristate "Qualcomm Technologies 802.11be chipset support"
	depends on MAC80211 && HAS_DMA && PCI
	depends on CRYPTO_MICHAEL_MIC
	select ATH_COMMON
	select QCOM_QMI_HELPERS
	select MHI_BUS
	select QRTR
	select QRTR_MHI
	help
	  This module adds support for Qualcomm Technologies 802.11be family of
	  chipsets.

	  If you choose to build a module, it'll be called ath12k.

config ATH12K_DEBUG
	bool "QCA ath12k debugging"
	depends on ATH12K
	help
	  Enables debug support

	  If unsure, say Y to make it easier to debug problems.

config ATH12K_DEBUGFS
	bool "QCA ath12k debugfs support"
	depends on ATH12K && DEBUG_FS && MAC80211_DEBUGFS
	help
	  Enable ath12k debugfs support

	  If unsure, say Y to make it easier to debug problems.

config ATH12K_TRACING
	bool "ath12k tracing support"
	depends on ATH12K && EVENT_TRACING
	help
	  Select this to use ath12k tracing infrastructure.

config ATH12K_SPECTRAL
	bool "QCA ath12k spectral scan support"
	depends on ATH12K_DEBUGFS
	depends on RELAY
	help
	  Enable ath12k spectral scan support

	  Say Y to enable access to the FFT/spectral data via debugfs.
```

## drivers/scsi/bnx2fc/Kconfig
```kconfig
config SCSI_BNX2X_FCOE
	tristate "Broadcom NetXtreme II FCoE support"
	depends on PCI
	depends on BROKEN
	select NETDEVICES
	select NETDEV_1000
	select LIBFC
	select LIBFCOE
	select CNIC
	---help---
	This driver supports FCoE offload for the Broadcom NetXtreme II
	devices.
```

## drivers/soc/qcom/Kconfig
```kconfig
#
# QCOM Soc drivers
#
config QCOM_GSBI
        tristate "QCOM General Serial Bus Interface"
        depends on ARCH_QCOM
        select MFD_SYSCON
        help
          Say y here to enable GSBI support.  The GSBI provides control
          functions for connecting the underlying serial UART, SPI, and I2C
          devices to the output pins.

config QCOM_PM
	bool "Qualcomm Power Management"
	depends on ARCH_QCOM && !ARM64
	select ARM_CPU_SUSPEND
	select QCOM_SCM
	help
	  QCOM Platform specific power driver to manage cores and L2 low power
	  modes. It interface with various system drivers to put the cores in
	  low power modes.

config QCOM_SMEM
	tristate "Qualcomm Shared Memory Manager (SMEM)"
	depends on ARCH_QCOM
	depends on HWSPINLOCK
	help
	  Say y here to enable support for the Qualcomm Shared Memory Manager.
	  The driver provides an interface to items in a heap shared among all
	  processors in a Qualcomm platform.

config QCOM_SMD
	tristate "Qualcomm Shared Memory Driver (SMD)"
	depends on QCOM_SMEM
	help
	  Say y here to enable support for the Qualcomm Shared Memory Driver
	  providing communication channels to remote processors in Qualcomm
	  platforms.

config QCOM_SMD_RPM
	tristate "Qualcomm Resource Power Manager (RPM) over SMD"
	depends on QCOM_SMD && OF
	help
	  If you say yes to this option, support will be included for the
	  Resource Power Manager system found in the Qualcomm 8974 based
	  devices.

	  This is required to access many regulators, clocks and bus
	  frequencies controlled by the RPM on these devices.

	  Say M here if you want to include support for the Qualcomm RPM as a
	  module. This will build a module called "qcom-smd-rpm".

config QCOM_SMEM_STATE
	bool

config QCOM_SMP2P
	tristate "Qualcomm Shared Memory Point to Point support"
	depends on QCOM_SMEM
	select QCOM_SMEM_STATE
	help
	  Say yes here to support the Qualcomm Shared Memory Point to Point
	  protocol.

config QCOM_SMSM
	tristate "Qualcomm Shared Memory State Machine"
	depends on QCOM_SMEM
	select QCOM_SMEM_STATE
	help
	  Say yes here to support the Qualcomm Shared Memory State Machine.
	  The state machine is represented by bits in shared memory.

config QCOM_WCNSS_CTRL
	tristate "Qualcomm WCNSS control driver"
	depends on QCOM_SMD
	help
	  Client driver for the WCNSS_CTRL SMD channel, used to download nv
	  firmware to a newly booted WCNSS chip.
	  Say y here to enable support for the Qualcomm Shared Memory Manager.
	  The driver provides an interface to items in a heap shared among all
	  processors in a Qualcomm platform.

config MSM_BUS_SCALING
	bool "Bus scaling driver"
	default n
	help
		This option enables bus scaling on MSM devices.  Bus scaling
		allows devices to request the clocks be set to rates sufficient
		for the active devices needs without keeping the clocks at max
		frequency when a slower speed is sufficient.

config MSM_BUSPM_DEV
	tristate "MSM Bus Performance Monitor Kernel Module"
	depends on MSM_BUS_SCALING
	default n
	help
	  This kernel module is used to mmap() hardware registers for the
	  performance monitors, counters, etc. The module can also be used to
	  allocate physical memory which is used by bus performance hardware to
	  dump performance data

config BUS_TOPOLOGY_ADHOC
	bool "ad-hoc bus scaling topology"
	default n
	help
		This option enables a driver that can handle adhoc bus topologies.
		Adhoc bus topology driver allows one to many connections and maintains
		directionality of connections by explicitly listing device connections
		thus avoiding illegal routes.
```

## fs/cachefiles_old/Kconfig
```kconfig
# SPDX-License-Identifier: GPL-2.0-only

config CACHEFILES_OLD
	tristate "Filesystem caching on files (old driver)"
	depends on FSCACHE_OLD && BLOCK && !FSCACHE
	help
	  This permits use of a mounted filesystem as a cache for other
	  filesystems - primarily networking filesystems - thus allowing fast
	  local disk to enhance the speed of slower devices.

	  [!] Note that this is mutually exclusive with the new cachefiles
	  driver.  Only one may be built as they share a lot of the same
	  symbols and also want to register the same device file.

	  See Documentation/filesystems/caching/cachefiles.rst for more
	  information.

config CACHEFILES_OLD_DEBUG
	bool "Debug CacheFiles"
	depends on CACHEFILES_OLD
	help
	  This permits debugging to be dynamically enabled in the filesystem
	  caching on files module.  If this is set, the debugging output may be
	  enabled by setting bits in /sys/modules/cachefiles/parameter/debug or
	  by including a debugging specifier in /etc/cachefilesd.conf.
```
