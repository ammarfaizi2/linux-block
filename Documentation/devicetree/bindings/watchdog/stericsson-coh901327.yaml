## kernel/Kconfig.locks
```kconfig
# SPDX-License-Identifier: GPL-2.0-only
#
# The ARCH_INLINE foo is necessary because select ignores "depends on"
#
config ARCH_INLINE_SPIN_TRYLOCK
	bool

config ARCH_INLINE_SPIN_TRYLOCK_BH
	bool

config ARCH_INLINE_SPIN_LOCK
	bool

config ARCH_INLINE_SPIN_LOCK_BH
	bool

config ARCH_INLINE_SPIN_LOCK_IRQ
	bool

config ARCH_INLINE_SPIN_LOCK_IRQSAVE
	bool

config ARCH_INLINE_SPIN_UNLOCK
	bool

config ARCH_INLINE_SPIN_UNLOCK_BH
	bool

config ARCH_INLINE_SPIN_UNLOCK_IRQ
	bool

config ARCH_INLINE_SPIN_UNLOCK_IRQRESTORE
	bool


config ARCH_INLINE_READ_TRYLOCK
	bool

config ARCH_INLINE_READ_LOCK
	bool

config ARCH_INLINE_READ_LOCK_BH
	bool

config ARCH_INLINE_READ_LOCK_IRQ
	bool

config ARCH_INLINE_READ_LOCK_IRQSAVE
	bool

config ARCH_INLINE_READ_UNLOCK
	bool

config ARCH_INLINE_READ_UNLOCK_BH
	bool

config ARCH_INLINE_READ_UNLOCK_IRQ
	bool

config ARCH_INLINE_READ_UNLOCK_IRQRESTORE
	bool


config ARCH_INLINE_WRITE_TRYLOCK
	bool

config ARCH_INLINE_WRITE_LOCK
	bool

config ARCH_INLINE_WRITE_LOCK_BH
	bool

config ARCH_INLINE_WRITE_LOCK_IRQ
	bool

config ARCH_INLINE_WRITE_LOCK_IRQSAVE
	bool

config ARCH_INLINE_WRITE_UNLOCK
	bool

config ARCH_INLINE_WRITE_UNLOCK_BH
	bool

config ARCH_INLINE_WRITE_UNLOCK_IRQ
	bool

config ARCH_INLINE_WRITE_UNLOCK_IRQRESTORE
	bool

config UNINLINE_SPIN_UNLOCK
	bool

#
# lock_* functions are inlined when:
#   - DEBUG_SPINLOCK=n and GENERIC_LOCKBREAK=n and ARCH_INLINE_*LOCK=y
#
# trylock_* functions are inlined when:
#   - DEBUG_SPINLOCK=n and ARCH_INLINE_*LOCK=y
#
# unlock and unlock_irq functions are inlined when:
#   - DEBUG_SPINLOCK=n and ARCH_INLINE_*LOCK=y
#  or
#   - DEBUG_SPINLOCK=n and PREEMPTION=n
#
# unlock_bh and unlock_irqrestore functions are inlined when:
#   - DEBUG_SPINLOCK=n and ARCH_INLINE_*LOCK=y
#

if !DEBUG_SPINLOCK

config INLINE_SPIN_TRYLOCK
	def_bool y
	depends on ARCH_INLINE_SPIN_TRYLOCK

config INLINE_SPIN_TRYLOCK_BH
	def_bool y
	depends on ARCH_INLINE_SPIN_TRYLOCK_BH

config INLINE_SPIN_LOCK
	def_bool y
	depends on !GENERIC_LOCKBREAK && ARCH_INLINE_SPIN_LOCK

config INLINE_SPIN_LOCK_BH
	def_bool y
	depends on !GENERIC_LOCKBREAK && ARCH_INLINE_SPIN_LOCK_BH

config INLINE_SPIN_LOCK_IRQ
	def_bool y
	depends on !GENERIC_LOCKBREAK && ARCH_INLINE_SPIN_LOCK_IRQ

config INLINE_SPIN_LOCK_IRQSAVE
	def_bool y
	depends on !GENERIC_LOCKBREAK && ARCH_INLINE_SPIN_LOCK_IRQSAVE

config INLINE_SPIN_UNLOCK_BH
	def_bool y
	depends on ARCH_INLINE_SPIN_UNLOCK_BH

config INLINE_SPIN_UNLOCK_IRQ
	def_bool y
	depends on !PREEMPTION || ARCH_INLINE_SPIN_UNLOCK_IRQ

config INLINE_SPIN_UNLOCK_IRQRESTORE
	def_bool y
	depends on ARCH_INLINE_SPIN_UNLOCK_IRQRESTORE


config INLINE_READ_TRYLOCK
	def_bool y
	depends on ARCH_INLINE_READ_TRYLOCK

config INLINE_READ_LOCK
	def_bool y
	depends on !GENERIC_LOCKBREAK && ARCH_INLINE_READ_LOCK

config INLINE_READ_LOCK_BH
	def_bool y
	depends on !GENERIC_LOCKBREAK && ARCH_INLINE_READ_LOCK_BH

config INLINE_READ_LOCK_IRQ
	def_bool y
	depends on !GENERIC_LOCKBREAK && ARCH_INLINE_READ_LOCK_IRQ

config INLINE_READ_LOCK_IRQSAVE
	def_bool y
	depends on !GENERIC_LOCKBREAK && ARCH_INLINE_READ_LOCK_IRQSAVE

config INLINE_READ_UNLOCK
	def_bool y
	depends on !PREEMPTION || ARCH_INLINE_READ_UNLOCK

config INLINE_READ_UNLOCK_BH
	def_bool y
	depends on ARCH_INLINE_READ_UNLOCK_BH

config INLINE_READ_UNLOCK_IRQ
	def_bool y
	depends on !PREEMPTION || ARCH_INLINE_READ_UNLOCK_IRQ

config INLINE_READ_UNLOCK_IRQRESTORE
	def_bool y
	depends on ARCH_INLINE_READ_UNLOCK_IRQRESTORE


config INLINE_WRITE_TRYLOCK
	def_bool y
	depends on ARCH_INLINE_WRITE_TRYLOCK

config INLINE_WRITE_LOCK
	def_bool y
	depends on !GENERIC_LOCKBREAK && ARCH_INLINE_WRITE_LOCK

config INLINE_WRITE_LOCK_BH
	def_bool y
	depends on !GENERIC_LOCKBREAK && ARCH_INLINE_WRITE_LOCK_BH

config INLINE_WRITE_LOCK_IRQ
	def_bool y
	depends on !GENERIC_LOCKBREAK && ARCH_INLINE_WRITE_LOCK_IRQ

config INLINE_WRITE_LOCK_IRQSAVE
	def_bool y
	depends on !GENERIC_LOCKBREAK && ARCH_INLINE_WRITE_LOCK_IRQSAVE

config INLINE_WRITE_UNLOCK
	def_bool y
	depends on !PREEMPTION || ARCH_INLINE_WRITE_UNLOCK

config INLINE_WRITE_UNLOCK_BH
	def_bool y
	depends on ARCH_INLINE_WRITE_UNLOCK_BH

config INLINE_WRITE_UNLOCK_IRQ
	def_bool y
	depends on !PREEMPTION || ARCH_INLINE_WRITE_UNLOCK_IRQ

config INLINE_WRITE_UNLOCK_IRQRESTORE
	def_bool y
	depends on ARCH_INLINE_WRITE_UNLOCK_IRQRESTORE

endif

config ARCH_SUPPORTS_ATOMIC_RMW
	bool

config MUTEX_SPIN_ON_OWNER
	def_bool y
	depends on SMP && ARCH_SUPPORTS_ATOMIC_RMW

config RWSEM_SPIN_ON_OWNER
       def_bool y
       depends on SMP && ARCH_SUPPORTS_ATOMIC_RMW

config LOCK_SPIN_ON_OWNER
       def_bool y
       depends on MUTEX_SPIN_ON_OWNER || RWSEM_SPIN_ON_OWNER

#
# Selects between the various flavors of spinlocks.  The arch Kconfigs can
# select two different config entries for each spinlock flavor:
# ARCH_HAS_*_SPINLOCKS indicates that the architecture _can_ use the
# corresponding style of spinlocks, while ARCH_DEFAULT_*_SPINLOCKS allows
# architectures to indicate which of the spinlock flavors should be enabled by
# default.  Architectures may select multiple ARCH_HAS_*_SPINLOCKS configs, but
# should only select one ARCH_DEFAULT_*_SPINLOCKS.
#
# Architectures that don't support either of the more generic lock flavors will
# fall back to a bespoke, architecture-specific spinlock implementation.
#
config ARCH_HAS_QUEUED_SPINLOCKS
	bool

config ARCH_DEFAULT_QUEUED_SPINLOCKS
	bool

config ARCH_HAS_TICKET_SPINLOCKS
	bool

config ARCH_DEFAULT_TICKET_SPINLOCKS
	bool

# Architectures that
config ARCH_HAS_BESPOKE_SPINLOCKS
	bool
	default !ARCH_HAS_QUEUED_SPINLOCKS && !ARCH_HAS_TICKET_SPINLOCKS

config ARCH_DEFAULT_BESPOKE_SPINLOCKS
	bool
	default ARCH_HAS_BESPOKE_SPINLOCKS

# A temporary config entry that avoids a bunch of churn in the arch kconfigs.
config ARCH_USE_QUEUED_SPINLOCKS
	bool
	select ARCH_HAS_QUEUED_SPINLOCKS
	select ARCH_DEFAULT_QUEUED_SPINLOCKS

choice
	prompt "Spin Lock Style"
	default QUEUED_SPINLOCKS  if ARCH_DEFAULT_QUEUED_SPINLOCKS
	default TICKET_SPINLOCKS  if ARCH_DEFAULT_TICKET_SPINLOCKS
	default BESPOKE_SPINLOCKS if ARCH_DEFAULT_BESPOKE_SPINLOCKS
	help
	  This selects the style of spinlocks that this kernel will use.  As a
	  general rule of thumb: queued spinlocks will perform better on larger
	  machines, while ticket spinlocks perform better on smaller machines
	  and use less memory.  The exact transition point will heavily depend
	  on both the processor implementation and the workload.

config QUEUED_SPINLOCKS
	bool "Queued Spinlocks"
	depends on SMP
	depends on ARCH_HAS_QUEUED_SPINLOCKS
	help
	  Queued spinlocks, where each waiter spins on a distinct address.

config TICKET_SPINLOCKS
	bool "Ticket Spinlocks"
	depends on SMP
	depends on ARCH_HAS_TICKET_SPINLOCKS
	help
	  Ticket-based spinlocks, where each waiter spins on the same address.

config BESPOKE_SPINLOCKS
	bool "Architecture-Specific Spinlocks"
	depends on SMP
	depends on ARCH_HAS_BESPOKE_SPINLOCKS
	help
	  An architecture-specific flavor of spinlock.

endchoice

config BPF_ARCH_SPINLOCK
	bool

config ARCH_USE_QUEUED_RWLOCKS
	bool

config QUEUED_RWLOCKS
	def_bool y if ARCH_USE_QUEUED_RWLOCKS
	depends on SMP

config ARCH_HAS_MMIOWB
	bool

config MMIOWB
	def_bool y if ARCH_HAS_MMIOWB
	depends on SMP
```

## sound/soc/apple/Kconfig
```kconfig
config SND_SOC_APPLE_SILICON
	tristate "ASoC machine driver for Apple Silicon Macs"
	select SND_SOC_APPLE_MCA
	help
	  This option enables an ASoC machine driver for Apple Silicon Macs.

config SND_SOC_APPLE_MCA
	tristate "Apple Silicon MCA driver"
	select SND_DMAENGINE_PCM
	select CONFIG_COMMON_CLK
	select APPLE_ADMAC
	select APPLE_NCO
	help
	  This option enables an ASoC platform driver for MCA blocks found
	  on Apple Silicon SoCs.
```

## sound/soc/intel/Kconfig
```kconfig
config SND_SOC_INTEL_SST_TOPLEVEL
	bool "Intel ASoC SST drivers"
	default y
	depends on X86 || COMPILE_TEST
	help
          Intel ASoC SST Platform Drivers. If you have a Intel machine that
          has audio controller with a DSP and I2S or DMIC port, then
          enable this option by saying Y

	  Note that the answer to this question doesn't directly affect the
	  kernel: saying N will just cause the configurator to skip all
	  the questions about Intel SST drivers.

if SND_SOC_INTEL_SST_TOPLEVEL

config SND_SST_IPC
	tristate
	help
	  This option controls the IPC core for HiFi2 platforms

config SND_SST_IPC_PCI
	tristate
	select SND_SST_IPC
	help
	  This option controls the PCI-based IPC for HiFi2 platforms
	  (Medfield, Merrifield).

config SND_SST_IPC_ACPI
	tristate
	select SND_SST_IPC
	help
	 This option controls the ACPI-based IPC for HiFi2 platforms
	 (Baytrail, Cherrytrail)

config SND_SOC_INTEL_SST_ACPI
	tristate
	help
	  This option controls ACPI-based probing on Haswell/Broadwell/
	  Baytrail legacy and will be set when these platforms are enabled

config SND_SOC_INTEL_SST
	tristate

config SND_SOC_INTEL_SST_FIRMWARE
	tristate
	select DW_DMAC_CORE
	help
	  This option controls firmware download on Haswell/Broadwell/
	  Baytrail legacy and will be set when these platforms are enabled

config SND_SOC_INTEL_HASWELL
	tristate "Intel ASoC SST driver for Haswell/Broadwell"
	depends on SND_DMA_SGBUF && ACPI
	depends on DMADEVICES
	select SND_SOC_INTEL_SST
	select SND_SOC_INTEL_SST_ACPI
	select SND_SOC_INTEL_SST_FIRMWARE
	select SND_SOC_INTEL_COMMON

config SND_SOC_INTEL_BAYTRAIL
	tristate "Intel ASoC SST driver for Baytrail (legacy)"
	depends on DMADEVICES && ACPI
	select SND_SOC_INTEL_SST
	select SND_SOC_INTEL_SST_ACPI
	select SND_SOC_INTEL_SST_FIRMWARE
	select SND_SOC_INTEL_COMMON

config SND_SST_ATOM_HIFI2_PLATFORM_PCI
	tristate "Intel ASoC SST driver for PCI HiFi2 platforms (Medfield, Merrifield)"
	depends on X86 && PCI
	select SND_SST_IPC_PCI
	select SND_SOC_COMPRESS
	select SND_SOC_INTEL_COMMON

config SND_SST_ATOM_HIFI2_PLATFORM
	tristate "Intel ASoC SST driver for ACPI HiFi2 platforms (Baytrail, Cherrytrail)"
	depends on X86 && ACPI
	select SND_SST_IPC_ACPI
	select IOSF_MBI
	select SND_SOC_COMPRESS
	select SND_SOC_INTEL_COMMON

config SND_SOC_INTEL_SKYLAKE
	tristate "Intel ASoC SST driver for SKL/BXT/KBL/GLK/CNL"
	depends on PCI && ACPI
	select SND_HDA_EXT_CORE
	select SND_HDA_DSP_LOADER
	select SND_SOC_TOPOLOGY
	select SND_SOC_INTEL_SST
	select SND_SOC_INTEL_COMMON

endif ## SND_SOC_INTEL_SST_TOPLEVEL

# ASoC codec drivers
source "sound/soc/intel/boards/Kconfig"

# configs common to SST and SOF to compile sound/soc/intel/common
# directory and use matching tables

config SND_SOC_INTEL_COMMON
	tristate
	select SND_SOC_ACPI_INTEL_MATCH if ACPI

config SND_SOC_ACPI_INTEL_MATCH
	tristate
	select SND_SOC_ACPI if ACPI
```
