## Documentation/devicetree/bindings/timer/marvell,orion-timer.yaml
```yaml
%YAML 1.2
---
version: 1

id: marvell,orion-timer

title: Marvell Orion SoC timer

maintainer:
    -   name: Sebastian Hesselbarth <sebastian.hesselbarth@gmail.com>

description: >
    TODO

inherits:
    -   id: %ids%

properties:
    -   name: "compatible"
        constraint: |
            "marvell,orion-timer"

    clocks:
    interrupt-parent:
    interrupts:
    reg:

...

# Marvell Orion SoC timer
#
# Required properties:
# - compatible: shall be "marvell,orion-timer"
# - reg: base address of the timer register starting with TIMERS CONTROL register
# - interrupt-parent: phandle of the bridge interrupt controller
# - interrupts: should contain the interrupts for Timer0 and Timer1
# - clocks: phandle of timer reference clock (tclk)
#
# Example:
# 	timer: timer {
# 		compatible = "marvell,orion-timer";
# 		reg = <0x20300 0x20>;
# 		interrupt-parent = <&bridge_intc>;
# 		interrupts = <1>, <2>;
# 		clocks = <&core_clk 0>;
# 	};
```

## Documentation/devicetree/bindings/timer/mediatek,mtk-timer.yaml
```yaml
%YAML 1.2
---
version: 1

id: mediatek,mtk-timer

title: Mediatek MT6577, MT6572 and MT6589 Timers

maintainer:
    -   name: Mars Cheng <mars.cheng@mediatek.com>

description: >
    TODO

inherits:
    -   id: %ids%

properties:
    -   name: "compatible"
        constraint: |
            "mediatek,mt8135-timer" && "mediatek,mt6577-timer"
            "mediatek,mt8127-timer" && "mediatek,mt6577-timer"
            "mediatek,mt6580-timer" && "mediatek,mt6577-timer"
            "mediatek,mt6577-timer"

    clock-names:
    clocks:
    interrupts:
    reg:

...

# Mediatek MT6577, MT6572 and MT6589 Timers
# ---------------------------------------
#
# Required properties:
# - compatible should contain:
# 	* "mediatek,mt6589-timer" for MT6589 compatible timers
# 	* "mediatek,mt6580-timer" for MT6580 compatible timers
# 	* "mediatek,mt6577-timer" for all compatible timers (MT6589, MT6580,
# 		MT6577)
# - reg: Should contain location and length for timers register.
# - clocks: Clocks driving the timer hardware. This list should include two
# 	clocks. The order is system clock and as second clock the RTC clock.
#
# Examples:
#
# 	timer@10008000 {
# 		compatible = "mediatek,mt6577-timer";
# 		reg = <0x10008000 0x80>;
# 		interrupts = <GIC_SPI 113 IRQ_TYPE_LEVEL_LOW>;
# 		clocks = <&system_clk>, <&rtc_clk>;
# 	};
```

## Documentation/devicetree/bindings/timer/moxa,moxart-timer.yaml
```yaml
%YAML 1.2
---
version: 1

id: moxa,moxart-timer

title: MOXA ART timer

maintainer:
    -   name: Jonas Jensen <jonas.jensen@gmail.com>

description: >
    TODO

inherits:
    -   id: %ids%

properties:
    -   name: "compatible"
        constraint: |
            "moxa,moxart-timer"

    clocks:
    interrupts:
    reg:

...

# MOXA ART timer
#
# Required properties:
#
# - compatible : Must be "moxa,moxart-timer"
# - reg : Should contain registers location and length
# - interrupts : Should contain the timer interrupt number
# - clocks : Should contain phandle for the clock that drives the counter
#
# Example:
#
# 	timer: timer@98400000 {
# 		compatible = "moxa,moxart-timer";
# 		reg = <0x98400000 0x42>;
# 		interrupts = <19 1>;
# 		clocks = <&coreclk>;
# 	};
```

## Documentation/devicetree/bindings/timer/st,stih407-lpc.yaml
```yaml
%YAML 1.2
---
version: 1

id: st,stih407-lpc

title: STMicroelectronics Low Power Controller (LPC) - Clocksource

maintainer:
    -   name: Lee Jones <lee.jones@linaro.org>

description: >
    TODO

inherits:
    -   id: %ids%

properties:
    -   name: "compatible"
        constraint: |
            "st,stih407-lpc"

    clocks:
    interrupts:
    reg:
    st,lpc-mode:
    st,syscfg:
    timeout-sec:

...

# STMicroelectronics Low Power Controller (LPC) - Clocksource
# ===========================================================
#
# LPC currently supports Watchdog OR Real Time Clock OR Clocksource
# functionality.
#
# [See: ../watchdog/st_lpc_wdt.txt for Watchdog options]
# [See: ../rtc/rtc-st-lpc.txt for RTC options]
#
# Required properties
#
# - compatible   : Must be: "st,stih407-lpc"
# - reg          : LPC registers base address + size
# - interrupts   : LPC interrupt line number and associated flags
# - clocks       : Clock used by LPC device (See: ../clock/clock-bindings.txt)
# - st,lpc-mode  : The LPC can run either one of three modes:
#                   ST_LPC_MODE_RTC    [0]
#                   ST_LPC_MODE_WDT    [1]
#                   ST_LPC_MODE_CLKSRC [2]
# 		 One (and only one) mode must be selected.
#
# Example:
#        lpc@fde05000 {
#                compatible      = "st,stih407-lpc";
#                reg             = <0xfde05000 0x1000>;
#                clocks          = <&clk_s_d3_flexgen CLK_LPC_0>;
#                st,lpc-mode     = <ST_LPC_MODE_CLKSRC>;
#        };
```

## Documentation/devicetree/bindings/timer/st,stm32-timer.yaml
```yaml
%YAML 1.2
---
version: 1

id: st,stm32-timer

title: . STMicroelectronics STM32 timer

maintainer:
    -   name: Maxime Coquelin <mcoquelin.stm32@gmail.com>

description: >
    TODO

inherits:
    -   id: %ids%

properties:
    -   name: "compatible"
        constraint: |
            "st,stm32-timer"

    clocks:
    interrupts:
    reg:
    status:

...

# . STMicroelectronics STM32 timer
#
# The STM32 MCUs family has several general-purpose 16 and 32 bits timers.
#
# Required properties:
# - compatible : Should be "st,stm32-timer"
# - reg : Address and length of the register set
# - clocks : Reference on the timer input clock
# - interrupts : Reference to the timer interrupt
#
# Optional properties:
# - resets: Reference to a reset controller asserting the timer
#
# Example:
#
# timer5: timer@40000c00 {
# 	compatible = "st,stm32-timer";
# 	reg = <0x40000c00 0x400>;
# 	interrupts = <50>;
# 	resets = <&rrc 259>;
# 	clocks = <&clk_pmtr1>;
# };
```

## Documentation/devicetree/bindings/usb/ehci-orion.yaml
```yaml
%YAML 1.2
---
version: 1

id: ehci-orion

title: EHCI controller, Orion Marvell variants

maintainer:
    -   name: Andrew Lunn <andrew@lunn.ch>

description: >
    TODO

inherits:
    -   id: %ids%

properties:
    -   name: "compatible"
        constraint: |
            "marvell,orion-ehci"

    clocks:
    interrupts:
    phy-names:
    phys:
    reg:
    status:
    vbus-supply:
    vcc-supply:

...

# * EHCI controller, Orion Marvell variants
#
# Required properties:
# - compatible: must be "marvell,orion-ehci"
# - reg: physical base address of the controller and length of memory mapped
#   region.
# - interrupts: The EHCI interrupt
#
# Optional properties:
# - clocks: reference to the clock
# - phys: reference to the USB PHY
# - phy-names: name of the USB PHY, should be "usb"
#
# Example:
#
# 	ehci@50000 {
# 		compatible = "marvell,orion-ehci";
# 		reg = <0x50000 0x1000>;
# 		interrupts = <19>;
# 	};
```

## Documentation/devicetree/bindings/usb/keystone-usb.yaml
```yaml
%YAML 1.2
---
version: 1

id: keystone-usb

title: TI Keystone Soc USB Controller

maintainer:
    -   name: WingMan Kwok <w-kwok2@ti.com>

description: >
    TODO

inherits:
    -   id: %ids%

properties:
    -   name: "compatible"
        constraint: |
            "ti,keystone-dwc3"
            "synopsys,dwc3"

    dr_mode:
    interrupt-names:
    interrupts:
    maximum-speed:
    phy-names:
    phys:
    pinctrl-0:
    pinctrl-names:
    reg:
    snps,dis_u2_susphy_quirk:
    snps,dis_u3_susphy_quirk:
    status:
    usb-phy:

...

# TI Keystone Soc USB Controller
#
# DWC3 GLUE
#
# Required properties:
#  - compatible: should be "ti,keystone-dwc3".
#  - #address-cells, #size-cells : should be '1' if the device has sub-nodes
#    with 'reg' property.
#  - reg : Address and length of the register set for the USB subsystem on
#    the SOC.
#  - interrupts : The irq number of this device that is used to interrupt the
#    MPU.
#  - ranges: allows valid 1:1 translation between child's address space and
#    parent's address space.
#  - clocks: Clock IDs array as required by the controller.
#  - clock-names: names of clocks correseponding to IDs in the clock property.
#
# Sub-nodes:
# The dwc3 core should be added as subnode to Keystone DWC3 glue.
# - dwc3 :
#    The binding details of dwc3 can be found in:
#    Documentation/devicetree/bindings/usb/dwc3.txt
#
# Example:
# 	usb: usb@2680000 {
# 		compatible = "ti,keystone-dwc3";
# 		#address-cells = <1>;
# 		#size-cells = <1>;
# 		reg = <0x2680000 0x10000>;
# 		clocks = <&clkusb>;
# 		clock-names = "usb";
# 		interrupts = <GIC_SPI 393 IRQ_TYPE_EDGE_RISING>;
# 		ranges;
# 		status = "disabled";
#
# 		dwc3@2690000 {
# 			compatible = "synopsys,dwc3";
# 			reg = <0x2690000 0x70000>;
# 			interrupts = <GIC_SPI 393 IRQ_TYPE_EDGE_RISING>;
# 			usb-phy = <&usb_phy>, <&usb_phy>;
# 		};
# 	};
```

## Documentation/devicetree/bindings/usb/mxs-phy.yaml
```yaml
%YAML 1.2
---
version: 1

id: mxs-phy

title: Freescale MXS USB Phy Device

maintainer:
    -   name: Peter Chen <peter.chen@freescale.com>

description: >
    TODO

inherits:
    -   id: %ids%

properties:
    -   name: "compatible"
        constraint: |
            "fsl,vf610-usbphy"
            "fsl,imx6ul-usbphy" && "fsl,imx23-usbphy"
            "fsl,imx6sx-usbphy" && "fsl,imx23-usbphy"
            "fsl,imx6sl-usbphy" && "fsl,imx23-usbphy"
            "fsl,imx6q-usbphy" && "fsl,imx23-usbphy"
            "fsl,imx28-usbphy" && "fsl,imx23-usbphy"
            "fsl,imx23-usbphy"

    clocks:
    reg:
    status:

...

# * Freescale MXS USB Phy Device
#
# Required properties:
# - compatible: should contain:
# 	* "fsl,imx23-usbphy" for imx23 and imx28
# 	* "fsl,imx6q-usbphy" for imx6dq and imx6dl
# 	* "fsl,imx6sl-usbphy" for imx6sl
# 	* "fsl,vf610-usbphy" for Vybrid vf610
# 	* "fsl,imx6sx-usbphy" for imx6sx
#   "fsl,imx23-usbphy" is still a fallback for other strings
# - reg: Should contain registers location and length
# - interrupts: Should contain phy interrupt
# - fsl,anatop: phandle for anatop register, it is only for imx6 SoC series
#
# Example:
# usbphy1: usbphy@020c9000 {
# 	compatible = "fsl,imx6q-usbphy", "fsl,imx23-usbphy";
# 	reg = <0x020c9000 0x1000>;
# 	interrupts = <0 44 0x04>;
# 	fsl,anatop = <&anatop>;
# };
```

## Documentation/devicetree/bindings/usb/ohci-nxp.yaml
```yaml
%YAML 1.2
---
version: 1

id: ohci-nxp

title: OHCI controller, NXP ohci-nxp variant

maintainer:
    -   name: Roland Stigge <stigge@antcom.de>

description: >
    TODO

inherits:
    -   id: %ids%

properties:
    -   name: "compatible"
        constraint: |
            "nxp,ohci-nxp" && "usb-ohci"

    interrupts:
    reg:
    status:
    transceiver:

...

# * OHCI controller, NXP ohci-nxp variant
#
# Required properties:
# - compatible: must be "nxp,ohci-nxp"
# - reg: physical base address of the controller and length of memory mapped
#   region.
# - interrupts: The OHCI interrupt
# - transceiver: phandle of the associated ISP1301 device - this is necessary for
#                the UDC controller for connecting to the USB physical layer
#
# Example (LPC32xx):
#
# 	isp1301: usb-transceiver@2c {
# 		compatible = "nxp,isp1301";
# 		reg = <0x2c>;
# 	};
#
# 	ohci@31020000 {
# 		compatible = "nxp,ohci-nxp";
# 		reg = <0x31020000 0x300>;
# 		interrupt-parent = <&mic>;
# 		interrupts = <0x3b 0>;
# 		transceiver = <&isp1301>;
# 	};
```

## Documentation/devicetree/bindings/usb/ohci-st.yaml
```yaml
%YAML 1.2
---
version: 1

id: ohci-st

title: ST USB OHCI controller

maintainer:
    -   name: Peter Griffin <peter.griffin@linaro.org>

description: >
    TODO

inherits:
    -   id: %ids%

properties:
    -   name: "compatible"
        constraint: |
            "st,st-ohci-300x"

    clock-names:
    clocks:
    interrupts:
    phy-names:
    phys:
    reg:
    reset-names:
    resets:
    status:

...

# ST USB OHCI controller
#
# Required properties:
#
#  - compatible		: must be "st,st-ohci-300x"
#  - reg			: physical base addresses of the controller and length of memory mapped
# 			  region
#  - interrupts		: one OHCI controller interrupt should be described here
#  - clocks		: phandle list of usb clocks
#  - clock-names		: should be "ic" for interconnect clock and "clk48"
# See: Documentation/devicetree/bindings/clock/clock-bindings.txt
#
#  - phys			: phandle for the PHY device
#  - phy-names		: should be "usb"
#
#  - resets		: phandle to the powerdown and reset controller for the USB IP
#  - reset-names		: should be "power" and "softreset".
# See: Documentation/devicetree/bindings/reset/st,sti-powerdown.txt
# See: Documentation/devicetree/bindings/reset/reset.txt
#
# Example:
#
# 	ohci0: usb@0xfe1ffc00 {
# 		compatible = "st,st-ohci-300x";
# 		reg = <0xfe1ffc00 0x100>;
# 		interrupts = <GIC_SPI 149 IRQ_TYPE_NONE>;
# 		clocks = <&clk_s_a1_ls 0>,
# 			 <&clockgen_b0 0>;
# 		clock-names = "ic", "clk48";
# 		phys = <&usb2_phy>;
# 		phy-names = "usb";
# 		status = "okay";
#
# 		resets = <&powerdown STIH416_USB0_POWERDOWN>,
# 			 <&softreset STIH416_USB0_SOFTRESET>;
# 		reset-names = "power", "softreset";
# 	};
```

## Documentation/devicetree/bindings/usb/samsung-hsotg.yaml
```yaml
%YAML 1.2
---
version: 1

id: samsung-hsotg

title: Samsung High Speed USB OTG controller

maintainer:
    -   name: Tomasz Figa <t.figa@samsung.com>

description: >
    TODO

inherits:
    -   id: %ids%

properties:
    -   name: "compatible"
        constraint: |
            "samsung,s3c6400-hsotg"

    clock-names:
    clocks:
    dr_mode:
    interrupt-parent:
    interrupts:
    phy-names:
    phys:
    reg:
    status:
    vusb_a-supply:
    vusb_d-supply:

...

# Samsung High Speed USB OTG controller
# -----------------------------
#
# The Samsung HSOTG IP can be found on Samsung SoCs, from S3C6400 onwards.
# It gives functionality of OTG-compliant USB 2.0 host and device with
# support for USB 2.0 high-speed (480Mbps) and full-speed (12 Mbps)
# operation.
#
# Currently only device mode is supported.
#
# Binding details
# -----
#
# Required properties:
# - compatible: "samsung,s3c6400-hsotg" should be used for all currently
#     supported SoC,
# - interrupt-parent: phandle for the interrupt controller to which the
#     interrupt signal of the HSOTG block is routed,
# - interrupts: specifier of interrupt signal of interrupt controller,
#     according to bindings of interrupt controller,
# - clocks: contains an array of clock specifiers:
#     - first entry: OTG clock
# - clock-names: contains array of clock names:
#     - first entry: must be "otg"
# - vusb_d-supply: phandle to voltage regulator of digital section,
# - vusb_a-supply: phandle to voltage regulator of analog section.
#
# Example
# -----
#
# 	hsotg@12480000 {
# 		compatible = "samsung,s3c6400-hsotg";
# 		reg = <0x12480000 0x20000>;
# 		interrupts = <0 71 0>;
# 		clocks = <&clock 305>;
# 		clock-names = "otg";
# 		vusb_d-supply = <&vusb_reg>;
# 		vusb_a-supply = <&vusbdac_reg>;
# 	};
#
```
