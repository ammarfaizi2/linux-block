## Documentation/devicetree/bindings/spi/spi-xtensa-xtfpga.yaml
```yaml
%YAML 1.2
---
version: 1

id: spi-xtensa-xtfpga

title: Cadence Xtensa XTFPGA platform SPI controller.

maintainer:
    -   name: Max Filippov <jcmvbkbc@gmail.com>

description: >
    TODO

inherits:
    -   id: %ids%

properties:
    -   name: "compatible"
        constraint: |
            "cdns,xtfpga-spi"

    #address-cells:
    reg:
    #size-cells:

...

# Cadence Xtensa XTFPGA platform SPI controller.
#
# This simple SPI master controller is built into xtfpga bitstreams and is used
# to control daughterboard audio codec.
#
# Required properties:
# - compatible: should be "cdns,xtfpga-spi".
# - reg: physical base address of the controller and length of memory mapped
#   region.
```

## Documentation/devicetree/bindings/spi/ti_qspi.yaml
```yaml
%YAML 1.2
---
version: 1

id: ti_qspi

title: TI QSPI controller.

maintainer:
    -   name: Sourav Poddar <sourav.poddar@ti.com>

description: >
    TODO

inherits:
    -   id: %ids%

properties:
    -   name: "compatible"
        constraint: |
            "ti,dra7xxx-qspi"
            "ti,am4372-qspi"

    #address-cells:
    interrupts:
    num-cs:
    pinctrl-0:
    pinctrl-1:
    pinctrl-names:
    reg:
    #size-cells:
    spi-max-frequency:
    status:
    ti,hwmods:

...

# TI QSPI controller.
#
# Required properties:
# - compatible : should be "ti,dra7xxx-qspi" or "ti,am4372-qspi".
# - reg: Should contain QSPI registers location and length.
# - reg-names: Should contain the resource reg names.
# 	- qspi_base: Qspi configuration register Address space
# 	- qspi_mmap: Memory mapped Address space
# 	- (optional) qspi_ctrlmod: Control module Address space
# - interrupts: should contain the qspi interrupt number.
# - #address-cells, #size-cells : Must be present if the device has sub-nodes
# - ti,hwmods: Name of the hwmod associated to the QSPI
#
# Recommended properties:
# - spi-max-frequency: Definition as per
#                      Documentation/devicetree/bindings/spi/spi-bus.txt
#
# Example:
#
# qspi: qspi@4b300000 {
# 	compatible = "ti,dra7xxx-qspi";
# 	reg = <0x47900000 0x100>, <0x30000000 0x3ffffff>;
# 	reg-names = "qspi_base", "qspi_mmap";
# 	#address-cells = <1>;
# 	#size-cells = <0>;
# 	spi-max-frequency = <25000000>;
# 	ti,hwmods = "qspi";
# };
```

## Documentation/devicetree/bindings/staging/iio/adc/lpc32xx-adc.yaml
```yaml
%YAML 1.2
---
version: 1

id: lpc32xx-adc

title: NXP LPC32xx SoC ADC controller

maintainer:
    -   name: Roland Stigge <stigge@antcom.de>

description: >
    TODO

inherits:
    -   id: %ids%

properties:
    -   name: "compatible"
        constraint: |
            "nxp,lpc3220-adc"

    interrupts:
    reg:
    status:

...

# * NXP LPC32xx SoC ADC controller
#
# Required properties:
# - compatible: must be "nxp,lpc3220-adc"
# - reg: physical base address of the controller and length of memory mapped
#   region.
# - interrupts: The ADC interrupt
#
# Example:
#
# 	adc@40048000 {
# 		compatible = "nxp,lpc3220-adc";
# 		reg = <0x40048000 0x1000>;
# 		interrupt-parent = <&mic>;
# 		interrupts = <39 0>;
# 	};
```

## Documentation/devicetree/bindings/thermal/db8500-thermal.yaml
```yaml
%YAML 1.2
---
version: 1

id: db8500-thermal

title: ST-Ericsson DB8500 Thermal

maintainer:
    -   name: hongbo.zhang <hongbo.zhang@linaro.com>

description: >
    TODO

inherits:
    -   id: %ids%

properties:
    -   name: "compatible"
        constraint: |
            "stericsson,db8500-thermal"

    interrupt-names:
    interrupts:
    num-trips:
    reg:
    status:
    trip0-cdev-name0:
    trip0-cdev-num:
    trip0-temp:
    trip0-type:
    trip1-cdev-name0:
    trip1-cdev-num:
    trip1-temp:
    trip1-type:
    trip2-cdev-name0:
    trip2-cdev-num:
    trip2-temp:
    trip2-type:
    trip3-cdev-num:
    trip3-temp:
    trip3-type:

...

# * ST-Ericsson DB8500 Thermal
#
# ** Thermal node properties:
#
# - compatible : "stericsson,db8500-thermal";
# - reg : address range of the thermal sensor registers;
# - interrupts : interrupts generated from PRCMU;
# - interrupt-names : "IRQ_HOTMON_LOW" and "IRQ_HOTMON_HIGH";
# - num-trips : number of total trip points, this is required, set it 0 if none,
#   if greater than 0, the following properties must be defined;
# - tripN-temp : temperature of trip point N, should be in ascending order;
# - tripN-type : type of trip point N, should be one of "active" "passive" "hot"
#   "critical";
# - tripN-cdev-num : number of the cooling devices which can be bound to trip
#   point N, this is required if trip point N is defined, set it 0 if none,
#   otherwise the following cooling device names must be defined;
# - tripN-cdev-nameM : name of the No. M cooling device of trip point N;
#
# Usually the num-trips and tripN-*** are separated in board related dts files.
#
# Example:
# thermal@801573c0 {
# 	compatible = "stericsson,db8500-thermal";
# 	reg = <0x801573c0 0x40>;
# 	interrupts = <21 0x4>, <22 0x4>;
# 	interrupt-names = "IRQ_HOTMON_LOW", "IRQ_HOTMON_HIGH";
#
# 	num-trips = <3>;
#
# 	trip0-temp = <75000>;
# 	trip0-type = "active";
# 	trip0-cdev-num = <1>;
# 	trip0-cdev-name0 = "thermal-cpufreq-0";
#
# 	trip1-temp = <80000>;
# 	trip1-type = "active";
# 	trip1-cdev-num = <2>;
# 	trip1-cdev-name0 = "thermal-cpufreq-0";
# 	trip1-cdev-name1 = "thermal-fan";
#
# 	trip2-temp = <85000>;
# 	trip2-type = "critical";
# 	trip2-cdev-num = <0>;
# }
```

## Documentation/devicetree/bindings/thermal/dove-thermal.yaml
```yaml
%YAML 1.2
---
version: 1

id: dove-thermal

title: Dove Thermal

maintainer:
    -   name: Andrew Lunn <andrew@lunn.ch>

description: >
    TODO

inherits:
    -   id: %ids%

properties:
    -   name: "compatible"
        constraint: |
            "marvell,dove-thermal"

    reg:

...

# * Dove Thermal
#
# This driver is for Dove SoCs which contain a thermal sensor.
#
# Required properties:
# - compatible : "marvell,dove-thermal"
# - reg : Address range of the thermal registers
#
# The reg properties should contain two ranges. The first is for the
# three Thermal Manager registers, while the second range contains the
# Thermal Diode Control Registers.
#
# Example:
#
# 	thermal@10078 {
# 		compatible = "marvell,dove-thermal";
# 		reg = <0xd001c 0x0c>, <0xd005c 0x08>;
# 	};
```

## Documentation/devicetree/bindings/thermal/kirkwood-thermal.yaml
```yaml
%YAML 1.2
---
version: 1

id: kirkwood-thermal

title: Kirkwood Thermal

maintainer:
    -   name: Nobuhiro Iwamatsu <iwamatsu@nigauri.org>

description: >
    TODO

inherits:
    -   id: %ids%

properties:
    -   name: "compatible"
        constraint: |
            "marvell,kirkwood-thermal"

    reg:
    status:

...

# * Kirkwood Thermal
#
# This version is for Kirkwood 88F8262 & 88F6283 SoCs. Other kirkwoods
# don't contain a thermal sensor.
#
# Required properties:
# - compatible : "marvell,kirkwood-thermal"
# - reg : Address range of the thermal registers
#
# Example:
#
# 	thermal@10078 {
# 		compatible = "marvell,kirkwood-thermal";
# 		reg = <0x10078 0x4>;
# 	};
```

## Documentation/devicetree/bindings/thermal/spear-thermal.yaml
```yaml
%YAML 1.2
---
version: 1

id: spear-thermal

title: SPEAr Thermal

maintainer:
    -   name: Viresh Kumar <vireshk@kernel.org>

description: >
    TODO

inherits:
    -   id: %ids%

properties:
    -   name: "compatible"
        constraint: |
            "st,thermal-spear1340"

    reg:
    st,thermal-flags:
    thermal_flags:

...

# * SPEAr Thermal
#
# Required properties:
# - compatible : "st,thermal-spear1340"
# - reg : Address range of the thermal registers
# - st,thermal-flags: flags used to enable thermal sensor
#
# Example:
#
# 	thermal@fc000000 {
# 		compatible = "st,thermal-spear1340";
# 		reg = <0xfc000000 0x1000>;
# 		st,thermal-flags = <0x7000>;
# 	};
```

## Documentation/devicetree/bindings/timer/allwinner,sun4i-timer.yaml
```yaml
%YAML 1.2
---
version: 1

id: allwinner,sun4i-timer

title: Allwinner A1X SoCs Timer Controller

maintainer:
    -   name: Maxime Ripard <maxime.ripard@free-electrons.com>

description: >
    TODO

inherits:
    -   id: %ids%

properties:
    -   name: "compatible"
        constraint: |
            "allwinner,sun4i-a10-timer"

    clocks:
    interrupts:
    reg:

...

# Allwinner A1X SoCs Timer Controller
#
# Required properties:
#
# - compatible : should be "allwinner,sun4i-a10-timer"
# - reg : Specifies base physical address and size of the registers.
# - interrupts : The interrupt of the first timer
# - clocks: phandle to the source clock (usually a 24 MHz fixed clock)
#
# Example:
#
# timer {
# 	compatible = "allwinner,sun4i-a10-timer";
# 	reg = <0x01c20c00 0x400>;
# 	interrupts = <22>;
# 	clocks = <&osc>;
# };
```

## Documentation/devicetree/bindings/timer/amlogic,meson6-timer.yaml
```yaml
%YAML 1.2
---
version: 1

id: amlogic,meson6-timer

title: Amlogic Meson6 SoCs Timer Controller

maintainer:
    -   name: Carlo Caione <carlo@caione.org>

description: >
    TODO

inherits:
    -   id: %ids%

properties:
    -   name: "compatible"
        constraint: |
            "amlogic,meson6-timer"

    interrupts:
    reg:

...

# Amlogic Meson6 SoCs Timer Controller
#
# Required properties:
#
# - compatible : should be "amlogic,meson6-timer"
# - reg : Specifies base physical address and size of the registers.
# - interrupts : The interrupt of the first timer
#
# Example:
#
# timer@c1109940 {
# 	compatible = "amlogic,meson6-timer";
# 	reg = <0xc1109940 0x14>;
# 	interrupts = <0 10 1>;
# };
```

## Documentation/devicetree/bindings/timer/brcm,bcm2835-system-timer.yaml
```yaml
%YAML 1.2
---
version: 1

id: brcm,bcm2835-system-timer

title: BCM2835 System Timer

maintainer:
    -   name: Simon Arlott <simon@fire.lp0.eu>

description: >
    TODO

inherits:
    -   id: %ids%

properties:
    -   name: "compatible"
        constraint: |
            "brcm,bcm2835-system-timer"

    clock-frequency:
    interrupts:
    reg:

...

# BCM2835 System Timer
#
# The System Timer peripheral provides four 32-bit timer channels and a
# single 64-bit free running counter. Each channel has an output compare
# register, which is compared against the 32 least significant bits of the
# free running counter values, and generates an interrupt.
#
# Required properties:
#
# - compatible : should be "brcm,bcm2835-system-timer"
# - reg : Specifies base physical address and size of the registers.
# - interrupts : A list of 4 interrupt sinks; one per timer channel.
# - clock-frequency : The frequency of the clock that drives the counter, in Hz.
#
# Example:
#
# timer {
# 	compatible = "brcm,bcm2835-system-timer";
# 	reg = <0x7e003000 0x1000>;
# 	interrupts = <1 0>, <1 1>, <1 2>, <1 3>;
# 	clock-frequency = <1000000>;
# };
```

## Documentation/devicetree/bindings/timer/fsl,imxgpt.yaml
```yaml
%YAML 1.2
---
version: 1

id: fsl,imxgpt

title: Freescale i.MX General Purpose Timer (GPT)

maintainer:
    -   name: Sascha Hauer <s.hauer@pengutronix.de>

description: >
    TODO

inherits:
    -   id: %ids%

properties:
    -   name: "compatible"
        constraint: |
            "fsl,mpc5200-gpt"
            "fsl,mpc5200b-gpt" && "fsl,mpc5200-gpt"
            "fsl,imx7d-gpt" && "fsl,imx6sx-gpt"
            "fsl,imx6ul-gpt" && "fsl,imx6sx-gpt"
            "fsl,imx6sx-gpt" && "fsl,imx31-gpt"
            "fsl,imx6sl-gpt"
            "fsl,imx6q-gpt" && "fsl,imx31-gpt"
            "fsl,imx6dl-gpt" && "fsl,imx6q-gpt"
            "fsl,imx53-gpt" && "fsl,imx31-gpt"
            "fsl,imx51-gpt" && "fsl,imx31-gpt"
            "fsl,imx50-gpt" && "fsl,imx31-gpt"
            "fsl,imx35-gpt" && "fsl,imx31-gpt"
            "fsl,imx31-gpt"
            "fsl,imx27-gpt" && "fsl,imx21-gpt"
            "fsl,imx25-gpt" && "fsl,imx31-gpt"
            "fsl,imx1-gpt"

    clock-names:
    clocks:
    interrupts:
    reg:

...

# Freescale i.MX General Purpose Timer (GPT)
#
# Required properties:
#
# - compatible : should be "fsl,<soc>-gpt"
# - reg : Specifies base physical address and size of the registers.
# - interrupts : A list of 4 interrupts; one per timer channel.
# - clocks : The clocks provided by the SoC to drive the timer.
#
# Example:
#
# gpt1: timer@10003000 {
# 	compatible = "fsl,imx27-gpt", "fsl,imx1-gpt";
# 	reg = <0x10003000 0x1000>;
# 	interrupts = <26>;
# 	clocks = <&clks 46>, <&clks 61>;
# 	clock-names = "ipg", "per";
# };
```

## Documentation/devicetree/bindings/timer/lsi,zevio-timer.yaml
```yaml
%YAML 1.2
---
version: 1

id: lsi,zevio-timer

title: TI-NSPIRE timer

maintainer:
    -   name: Daniel Tang <dt.tangr@gmail.com>

description: >
    TODO

inherits:
    -   id: %ids%

properties:
    -   name: "compatible"
        constraint: |
            "lsi,zevio-timer"

    clocks:
    interrupts:
    reg:

...

# TI-NSPIRE timer
#
# Required properties:
#
# - compatible : should be "lsi,zevio-timer".
# - reg : The physical base address and size of the timer (always first).
# - clocks: phandle to the source clock.
#
# Optional properties:
#
# - interrupts : The interrupt number of the first timer.
# - reg : The interrupt acknowledgement registers
# 	(always after timer base address)
#
# If any of the optional properties are not given, the timer is added as a
# clock-source only.
#
# Example:
#
# timer {
# 	compatible = "lsi,zevio-timer";
# 	reg = <0x900D0000 0x1000>, <0x900A0020 0x8>;
# 	interrupts = <19>;
# 	clocks = <&timer_clk>;
# };
#
# Example (no clock-events):
#
# timer {
# 	compatible = "lsi,zevio-timer";
# 	reg = <0x900D0000 0x1000>;
# 	clocks = <&timer_clk>;
# };
```

## Documentation/devicetree/bindings/timer/marvell,armada-370-xp-timer.yaml
```yaml
%YAML 1.2
---
version: 1

id: marvell,armada-370-xp-timer

title: Marvell Armada 370 and Armada XP Timers

maintainer:
    -   name: Ezequiel Garcia <ezequiel.garcia@free-electrons.com>

description: >
    TODO

inherits:
    -   id: %ids%

properties:
    -   name: "compatible"
        constraint: |
            "marvell,armada-xp-timer"
            "marvell,armada-380-timer" && "marvell,armada-xp-timer"
            "marvell,armada-375-timer" && "marvell,armada-370-timer"
            "marvell,armada-370-timer"

    clock-frequency:
    clocks:
    interrupts:
    reg:
    status:

...

# Marvell Armada 370 and Armada XP Timers
# ---------------------------------------
#
# Required properties:
# - compatible: Should be one of the following
#               "marvell,armada-370-timer",
# 	      "marvell,armada-375-timer",
# 	      "marvell,armada-xp-timer".
# - interrupts: Should contain the list of Global Timer interrupts and
#   then local timer interrupts
# - reg: Should contain location and length for timers register. First
#   pair for the Global Timer registers, second pair for the
#   local/private timers.
#
# Clocks required for compatible = "marvell,armada-370-timer":
# - clocks : Must contain a single entry describing the clock input
#
# Clocks required for compatibles = "marvell,armada-xp-timer",
# 				  "marvell,armada-375-timer":
# - clocks : Must contain an entry for each entry in clock-names.
# - clock-names : Must include the following entries:
#   "nbclk" (L2/coherency fabric clock),
#   "fixed" (Reference 25 MHz fixed-clock).
#
# Examples:
#
# - Armada 370:
#
# 	timer {
# 		compatible = "marvell,armada-370-timer";
# 		reg = <0x20300 0x30>, <0x21040 0x30>;
# 		interrupts = <37>, <38>, <39>, <40>, <5>, <6>;
# 		clocks = <&coreclk 2>;
# 	};
#
# - Armada XP:
#
# 	timer {
# 		compatible = "marvell,armada-xp-timer";
# 		reg = <0x20300 0x30>, <0x21040 0x30>;
# 		interrupts = <37>, <38>, <39>, <40>, <5>, <6>;
# 		clocks = <&coreclk 2>, <&refclk>;
# 		clock-names = "nbclk", "fixed";
# 	};
```
