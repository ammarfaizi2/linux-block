## Documentation/devicetree/bindings/usb/spear-usb.yaml
```yaml
%YAML 1.2
---
version: 1

id: spear-usb

title: ST SPEAr SoC USB controllers:

maintainer:
    -   name: Stefan Roese <sr@denx.de>

description: >
    TODO

inherits:
    -   id: %ids%

properties:
    -   name: "compatible"
        constraint: |
            "st,spear600-ohci" && "usb-ohci"
            "st,spear600-ehci" && "usb-ehci"

    interrupt-parent:
    interrupts:
    reg:
    status:
    usbh0_id:
    usbh1_id:

...

# ST SPEAr SoC USB controllers:
# -----------------------------
#
# EHCI:
# -----
#
# Required properties:
# - compatible: "st,spear600-ehci"
# - interrupt-parent: Should be the phandle for the interrupt controller
#   that services interrupts for this device
# - interrupts: Should contain the EHCI interrupt
#
# Example:
#
# 	ehci@e1800000 {
# 		compatible = "st,spear600-ehci", "usb-ehci";
# 		reg = <0xe1800000 0x1000>;
# 		interrupt-parent = <&vic1>;
# 		interrupts = <27>;
# 	};
#
#
# OHCI:
# -----
#
# Required properties:
# - compatible: "st,spear600-ohci"
# - interrupt-parent: Should be the phandle for the interrupt controller
#   that services interrupts for this device
# - interrupts: Should contain the OHCI interrupt
#
# Example:
#
# 	ohci@e1900000 {
# 		compatible = "st,spear600-ohci", "usb-ohci";
# 		reg = <0xe1800000 0x1000>;
# 		interrupt-parent = <&vic1>;
# 		interrupts = <26>;
# 	};
```
