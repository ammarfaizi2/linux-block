## Documentation/devicetree/bindings/dma/fsl-imx-dma.yaml
```yaml
%YAML 1.2
---
version: 1

id: fsl-imx-dma

title: Freescale Direct Memory Access (DMA) Controller for i.MX

maintainer:
    -   name: Markus Pargmann <mpa@pengutronix.de>

description: >
    TODO

inherits:
    -   id: %ids%

properties:
    -   name: "compatible"
        constraint: |
            "fsl,mpc8641-dma" && "fsl,eloplus-dma"
            "fsl,mpc8610-dma" && "fsl,eloplus-dma"
            "fsl,mpc8572-dma" && "fsl,eloplus-dma"
            "fsl,mpc8560-dma" && "fsl,eloplus-dma"
            "fsl,mpc8555-dma" && "fsl,eloplus-dma"
            "fsl,mpc8548-dma" && "fsl,eloplus-dma"
            "fsl,mpc8541-dma" && "fsl,eloplus-dma"
            "fsl,mpc8379-dma" && "fsl,elo-dma"
            "fsl,mpc8378-dma" && "fsl,elo-dma"
            "fsl,mpc8377-dma" && "fsl,elo-dma"
            "fsl,mpc8360-dma" && "fsl,elo-dma"
            "fsl,mpc8347-dma" && "fsl,elo-dma"
            "fsl,mpc8323-dma" && "fsl,elo-dma"
            "fsl,mpc8315-dma" && "fsl,elo-dma"
            "fsl,mpc8313-dma" && "fsl,elo-dma"
            "fsl,imx27-dma"
            "fsl,imx1-dma"

    clock-names:
    clocks:
    #dma-cells:
    interrupts:
    reg:

...

# * Freescale Direct Memory Access (DMA) Controller for i.MX
#
# This document will only describe differences to the generic DMA Controller and
# DMA request bindings as described in dma/dma.txt .
#
# * DMA controller
#
# Required properties:
# - compatible : Should be "fsl,<chip>-dma". chip can be imx1, imx21 or imx27
# - reg : Should contain DMA registers location and length
# - interrupts : First item should be DMA interrupt, second one is optional and
#     should contain DMA Error interrupt
# - #dma-cells : Has to be 1. imx-dma does not support anything else.
#
# Optional properties:
# - #dma-channels : Number of DMA channels supported. Should be 16.
# - #dma-requests : Number of DMA requests supported.
#
# Example:
#
# 	dma: dma@10001000 {
# 		compatible = "fsl,imx27-dma";
# 		reg = <0x10001000 0x1000>;
# 		interrupts = <32 33>;
# 		#dma-cells = <1>;
# 		#dma-channels = <16>;
# 	};
#
#
# * DMA client
#
# Clients have to specify the DMA requests with phandles in a list.
#
# Required properties:
# - dmas: List of one or more DMA request specifiers. One DMA request specifier
#     consists of a phandle to the DMA controller followed by the integer
#     specifying the request line.
# - dma-names: List of string identifiers for the DMA requests. For the correct
#     names, have a look at the specific client driver.
#
# Example:
#
# 	sdhci1: sdhci@10013000 {
# 		...
# 		dmas = <&dma 7>;
# 		dma-names = "rx-tx";
# 		...
# 	};
```

## Documentation/devicetree/bindings/drm/i2c/tda998x.yaml
```yaml
%YAML 1.2
---
version: 1

id: tda998x

title: Device-Tree bindings for the NXP TDA998x HDMI transmitter

maintainer:
    -   name: Jean-Francois Moine <moinejf@free.fr>

description: >
    TODO

inherits:
    -   id: %ids%

properties:
    -   name: "compatible"
        constraint: |
            "nxp,tda998x"

    pinctrl-0:
    pinctrl-1:
    pinctrl-names:
    reg:

...

# Device-Tree bindings for the NXP TDA998x HDMI transmitter
#
# Required properties;
#   - compatible: must be "nxp,tda998x"
#
#   - reg: I2C address
#
# Optional properties:
#   - interrupts: interrupt number and trigger type
# 	default: polling
#
#   - pinctrl-0: pin control group to be used for
# 	screen plug/unplug interrupt.
#
#   - pinctrl-names: must contain a "default" entry.
#
#   - video-ports: 24 bits value which defines how the video controller
# 	output is wired to the TDA998x input - default: <0x230145>
#
# Example:
#
# 	tda998x: hdmi-encoder {
# 		compatible = "nxp,tda998x";
# 		reg = <0x70>;
# 		interrupt-parent = <&gpio0>;
# 		interrupts = <27 2>;		/* falling edge */
# 		pinctrl-0 = <&pmx_camera>;
# 		pinctrl-names = "default";
# 	};
```

## Documentation/devicetree/bindings/dt-binding-format.txt
```
--------------------------
Device Tree Binding Format
--------------------------

Background
----------

DT bindings historically were written as text in prose format which
led to issues in usability of that source documentation. Some of
these issues include the need to programmatically process binding
source documentation to do DTS validation, perform mass updates to
format/style, and to generate publishable documentation in HTML or
PDF form.

Overview
--------

The DT binding format is based on the YAML text markup language.
Although there are many text markup options available, YAML
fulfills all requirements considered for a DT binding source format
which include:

1) Must be human readable
2) Must be easily translated to other data formats (XML, JSON, etc).
3) Must have sufficient tools and libraries to enable developers to
   build new tools for DT binding processing
4) Must have a complete spec to refer to syntax

YAML is documentated in the specification found at
http://www.yaml.org/spec/1.2/spec.html

The required YAML DT binding tag format and syntax are defined in
the following sections.

YAML DT Binding Syntax
----------------------

* Lines starting with "#" are comments and not part of the binding itself
* "%YAML 1.2" starts a file, indicating the version of YAML in use
* "---" starts a binding document
* "..." ends a binding document
* Multiple binding documents may exist in a single file
* Tabs are not permitted
* Scope is denoted by indentation of four spaces
* Key value pairs are denoted by "key: value"
* Sequences are denoted by "-"
* Scalar values may convert newlines to spaces and preserve blank
  lines for long description formatting using ">"
* Scalar values may escape all reserved characters and preserve
  newlines by using "|" to denote literal style

For additional information on YAML syntax, refer to the specification
at http://www.yaml.org/spec/1.2/spec.html

YAML DT Binding Format
----------------------

The DT binding format is based on the YAML Core schema defined in the
specification. The following YAML sequences and keys are supported in
the DT binding format:

[Note: [R] and [O] denote required and optional sequences/keys,respectively]

* [R] version: DT binding format version. Currently 1.

* [R] id: unique identifier in property form (e.g. skel-device)

* [R] title: title of the binding

* [R] maintainer: sequence of maintainers
      [R] name: name and email of maintainer or mailing list in RFC822
                form.

* [O] description: full description of the binding

* [O] inherits: sequence of inherited bindings
      [R] id: unique identifier of inherited binding

* [R] properties: sequence of properties
      [R] name: name of property surrounded in double quotes
      [R} category: category of property. One of "required",
                    "optional", or "deprecated".
      [R] type: type of property. One of "string", "int", "empty",
                "phandle", or "array".
      [O] constraint: constraint expression using C syntax
      [O] deprecated: C syntax expression of deprecated compatible
                      strings.
      [O] description: description of the property

* [O] notes: Any additional notes about properties in this binding.

* [O] example: sequence of examples:
      [R] dts: DT source of example usage. The example text must use
               literal style ("|") so that it retains indentation and
               newlines.
      [O] description: description of the example

Skeleton Binding
----------------

The skeleton.yaml binding found in the top of the DT binding tree
is the canonical example of syntax and format to use when writing
a DT binding document. It is maintained with the latest formatting
conventions, making it the best starting point when writing a new DT
binding.
```

## Documentation/devicetree/bindings/extcon/extcon-palmas.yaml
```yaml
%YAML 1.2
---
version: 1

id: extcon-palmas

title: EXTCON FOR PALMAS/TWL CHIPS

maintainer:
    -   name: Laxman Dewangan <ldewangan@nvidia.com>

description: >
    TODO

inherits:
    -   id: %ids%

properties:
    -   name: "compatible"
        constraint: |
            "ti,palmas-usb-vid"

    id-gpios:
    ti,enable-id-detection:
    ti,enable-vbus-detection:
    ti,wakeup:

...

# EXTCON FOR PALMAS/TWL CHIPS
#
# PALMAS USB COMPARATOR
# Required Properties:
#  - compatible: should contain one of:
#    * "ti,palmas-usb-vid".
#    * "ti,twl6035-usb-vid".
#    * "ti,palmas-usb" (DEPRECATED - use "ti,palmas-usb-vid").
#    * "ti,twl6035-usb" (DEPRECATED - use "ti,twl6035-usb-vid").
#
# Optional Properties:
#  - ti,wakeup : To enable the wakeup comparator in probe
#  - ti,enable-id-detection: Perform ID detection. If id-gpio is specified
# 		it performs id-detection using GPIO else using OTG core.
#  - ti,enable-vbus-detection: Perform VBUS detection.
#  - id-gpio: gpio for GPIO ID detection. See gpio binding.
#  - debounce-delay-ms: debounce delay for GPIO ID pin in milliseconds.
#
# palmas-usb {
#        compatible = "ti,twl6035-usb", "ti,palmas-usb";
#        ti,wakeup;
# };
```

## Documentation/devicetree/bindings/gpio/gpio-74x164.yaml
```yaml
%YAML 1.2
---
version: 1

id: gpio-74x164

title: Generic 8-bits shift register GPIO driver

maintainer:
    -   name: Maxime Ripard <maxime.ripard@free-electrons.com>

description: >
    TODO

inherits:
    -   id: %ids%

properties:
    -   name: "compatible"
        constraint: |
            "fairchild,74hc595"

    #gpio-cells:
    gpio-controller:
    reg:
    registers-number:
    spi-max-frequency:

...

# * Generic 8-bits shift register GPIO driver
#
# Required properties:
# - compatible : Should be "fairchild,74hc595"
# - reg : chip select number
# - gpio-controller : Marks the device node as a gpio controller.
# - #gpio-cells : Should be two.  The first cell is the pin number and
#   the second cell is used to specify the gpio polarity:
#       0 = active high
#       1 = active low
# - registers-number: Number of daisy-chained shift registers
#
# Example:
#
# gpio5: gpio5@0 {
# 	compatible = "fairchild,74hc595";
# 	reg = <0>;
# 	gpio-controller;
# 	#gpio-cells = <2>;
# 	registers-number = <4>;
# 	spi-max-frequency = <100000>;
# };
```

## Documentation/devicetree/bindings/gpio/gpio-stericsson-coh901.yaml
```yaml
%YAML 1.2
---
version: 1

id: gpio-stericsson-coh901

title: ST-Ericsson COH 901 571/3 GPIO controller

maintainer:
    -   name: Linus Walleij <linus.walleij@linaro.org>

description: >
    TODO

inherits:
    -   id: %ids%

properties:
    -   name: "compatible"
        constraint: |
            "stericsson,gpio-coh901"

    clocks:
    #gpio-cells:
    gpio-controller:
    #interrupt-cells:
    interrupt-controller:
    interrupt-names:
    interrupt-parent:
    interrupts:
    reg:

...

# ST-Ericsson COH 901 571/3 GPIO controller
#
# Required properties:
# - compatible: Compatible property value should be "stericsson,gpio-coh901"
# - reg: Physical base address of the controller and length of memory mapped
#   region.
# - interrupts: the 0...n interrupts assigned to the different GPIO ports/banks.
```

## Documentation/devicetree/bindings/gpio/gpio-stmpe.yaml
```yaml
%YAML 1.2
---
version: 1

id: gpio-stmpe

title: STMPE gpio

maintainer:
    -   name: Vipul Kumar Samar <vipulkumar.samar@st.com>

description: >
    TODO

inherits:
    -   id: %ids%

properties:
    -   name: "compatible"
        constraint: |
            "st,stmpe-gpio"

    #gpio-cells:
    gpio-controller:
    #interrupt-cells:
    interrupt-controller:
    st,norequest-mask:

...

# STMPE gpio
# ----------
#
# Required properties:
#  - compatible: "st,stmpe-gpio"
#
# Optional properties:
#  - st,norequest-mask: bitmask specifying which GPIOs should _not_ be requestable
#    due to different usage (e.g. touch, keypad)
#
# Node name must be stmpe_gpio and should be child node of stmpe node to which it
# belongs.
#
# Example:
# 	stmpe_gpio {
# 		compatible = "st,stmpe-gpio";
# 		st,norequest-mask = <0x20>;	//gpio 5 can't be used
# 	};
```

## Documentation/devicetree/bindings/gpio/gpio-vf610.yaml
```yaml
%YAML 1.2
---
version: 1

id: gpio-vf610

title: Freescale VF610 PORT/GPIO module

maintainer:
    -   name: Stefan Agner <stefan@agner.ch>

description: >
    TODO

inherits:
    -   id: %ids%

properties:
    -   name: "compatible"
        constraint: |
            "fsl,vf610-gpio"
            "fsl,mpc8572-gpio"
            "fsl,mpc8379-gpio" && "fsl,mpc8349-gpio"
            "fsl,mpc8378-gpio" && "fsl,mpc8349-gpio"
            "fsl,mpc8377-gpio" && "fsl,mpc8349-gpio"
            "fsl,mpc8349-gpio"
            "fsl,mpc8308-gpio" && "fsl,mpc8349-gpio"
            "fsl,mpc5200b-gpio" && "fsl,mpc5200-gpio"
            "fsl,mpc5125-gpio"
            "fsl,mpc5121-gpio"
            "fsl,imx7d-gpio" && "fsl,imx35-gpio"
            "fsl,imx6ul-gpio" && "fsl,imx35-gpio"
            "fsl,imx6sx-gpio" && "fsl,imx35-gpio"
            "fsl,imx6sl-gpio" && "fsl,imx35-gpio"
            "fsl,imx6q-gpio" && "fsl,imx35-gpio"
            "fsl,imx53-gpio" && "fsl,imx35-gpio"
            "fsl,imx51-gpio" && "fsl,imx35-gpio"
            "fsl,imx50-gpio" && "fsl,imx35-gpio"
            "fsl,imx35-gpio" && "fsl,imx31-gpio"
            "fsl,imx28-gpio" && "fsl,mxs-gpio"
            "fsl,imx27-gpio" && "fsl,imx21-gpio"
            "fsl,imx25-gpio" && "fsl,imx35-gpio"
            "fsl,imx23-gpio" && "fsl,mxs-gpio"
            "fsl,imx1-gpio"

    #gpio-cells:
    gpio-controller:
    #interrupt-cells:
    interrupt-controller:
    interrupts:
    reg:

...

# * Freescale VF610 PORT/GPIO module
#
# The Freescale PORT/GPIO modules are two adjacent modules providing GPIO
# functionality. Each pair serves 32 GPIOs. The VF610 has 5 instances of
# each, and each PORT module has its own interrupt.
#
# Required properties for GPIO node:
# - compatible : Should be "fsl,<soc>-gpio", currently "fsl,vf610-gpio"
# - reg : The first reg tuple represents the PORT module, the second tuple
#   the GPIO module.
# - interrupts : Should be the port interrupt shared by all 32 pins.
# - gpio-controller : Marks the device node as a gpio controller.
# - #gpio-cells : Should be two. The first cell is the pin number and
#   the second cell is used to specify the gpio polarity:
#       0 = active high
#       1 = active low
# - interrupt-controller: Marks the device node as an interrupt controller.
# - #interrupt-cells : Should be 2.  The first cell is the GPIO number.
#   The second cell bits[3:0] is used to specify trigger type and level flags:
#       1 = low-to-high edge triggered.
#       2 = high-to-low edge triggered.
#       4 = active high level-sensitive.
#       8 = active low level-sensitive.
#
# Note: Each GPIO port should have an alias correctly numbered in "aliases"
# node.
#
# Examples:
#
# aliases {
# 	gpio0 = &gpio1;
# 	gpio1 = &gpio2;
# };
#
# gpio1: gpio@40049000 {
# 	compatible = "fsl,vf610-gpio";
# 	reg = <0x40049000 0x1000 0x400ff000 0x40>;
# 	interrupts = <0 107 IRQ_TYPE_LEVEL_HIGH>;
# 	gpio-controller;
# 	#gpio-cells = <2>;
# 	interrupt-controller;
# 	#interrupt-cells = <2>;
# 	gpio-ranges = <&iomuxc 0 0 32>;
# };
#
# gpio2: gpio@4004a000 {
# 	compatible = "fsl,vf610-gpio";
# 	reg = <0x4004a000 0x1000 0x400ff040 0x40>;
# 	interrupts = <0 108 IRQ_TYPE_LEVEL_HIGH>;
# 	gpio-controller;
# 	#gpio-cells = <2>;
# 	interrupt-controller;
# 	#interrupt-cells = <2>;
# 	gpio-ranges = <&iomuxc 0 32 32>;
# };
```
