## Documentation/devicetree/bindings/clock/mvebu-corediv-clock.yaml
```yaml
%YAML 1.2
---
version: 1

id: mvebu-corediv-clock

title: Core Divider Clock bindings for Marvell MVEBU SoCs

maintainer:
    -   name: Ezequiel Garcia <ezequiel.garcia@free-electrons.com>

description: >
    TODO

inherits:
    -   id: %ids%

properties:
    -   name: "compatible"
        constraint: |
            "marvell,armada-390-corediv-clock" && "marvell,armada-380-corediv-clock"
            "marvell,armada-380-corediv-clock"
            "marvell,armada-375-corediv-clock"
            "marvell,armada-370-corediv-clock"

    #clock-cells:
    clock-output-names:
    clocks:
    reg:

...

# * Core Divider Clock bindings for Marvell MVEBU SoCs
#
# The following is a list of provided IDs and clock names on Armada 370/XP:
#  0 = nand (NAND clock)
#
# Required properties:
# - compatible : must be "marvell,armada-370-corediv-clock",
# 		       "marvell,armada-375-corediv-clock",
# 		       "marvell,armada-380-corediv-clock",
#
# - reg : must be the register address of Core Divider control register
# - #clock-cells : from common clock binding; shall be set to 1
# - clocks : must be set to the parent's phandle
#
# Example:
#
# corediv_clk: corediv-clocks@18740 {
# 	compatible = "marvell,armada-370-corediv-clock";
# 	reg = <0x18740 0xc>;
# 	#clock-cells = <1>;
# 	clocks = <&pll>;
# };
```

## Documentation/devicetree/bindings/clock/nspire-clock.yaml
```yaml
%YAML 1.2
---
version: 1

id: nspire-clock

title: TI-NSPIRE Clocks

maintainer:
    -   name: Daniel Tang <dt.tangr@gmail.com>

description: >
    TODO

inherits:
    -   id: %ids%

properties:
    -   name: "compatible"
        constraint: |
            "lsi,nspire-cx-clock"
            "lsi,nspire-cx-ahb-divider"
            "lsi,nspire-classic-clock"
            "lsi,nspire-classic-ahb-divider"

    #clock-cells:
    clocks:
    reg:

...

# TI-NSPIRE Clocks
#
# Required properties:
# - compatible: Valid compatible properties include:
# 	"lsi,nspire-cx-ahb-divider" for the AHB divider in the CX model
# 	"lsi,nspire-classic-ahb-divider" for the AHB divider in the older model
# 	"lsi,nspire-cx-clock" for the base clock in the CX model
# 	"lsi,nspire-classic-clock" for the base clock in the older model
#
# - reg: Physical base address of the controller and length of memory mapped
# 	region.
#
# Optional:
# - clocks: For the "nspire-*-ahb-divider" compatible clocks, this is the parent
# 	clock where it divides the rate from.
#
# Example:
#
# ahb_clk {
# 	#clock-cells = <0>;
# 	compatible = "lsi,nspire-cx-clock";
# 	reg = <0x900B0000 0x4>;
# 	clocks = <&base_clk>;
# };
```

## Documentation/devicetree/bindings/clock/qcom,a53-pll.txt
```
A53 PLL Binding
---------------
The A53 PLL is the main CPU PLL used for frequencies above 1GHz.

Required properties :
- compatible : Shall contain only one of the following:

		"qcom,a53-pll"

- reg : shall contain base register location and length

Example:

	a53pll: a53pll@0b016000 {
		compatible = "qcom,a53-pll";
		reg = <0x0b016000 0x40>;
	};
```

## Documentation/devicetree/bindings/clock/qcom,a53cc.txt
```
Qualcomm A53 CPU Clock Controller Binding
------------------------------------------------
The A53 CPU Clock Controller is hardware, which provides a combined
mux and divider functionality for the CPU clocks. It can choose between
a fixed rate clock and the dedicated A53 PLL.

Required properties :
- compatible : shall contain:

			"qcom,a53cc"

- reg : shall contain base register location and length
	of the APCS region
- #clock-cells : shall contain 1

Example:

	apcs: syscon@b011000 {
		compatible = "qcom,a53cc", "syscon";
		reg = <0x0b011000 0x1000>;
		#clock-cells = <1>;
	};
```

## Documentation/devicetree/bindings/clock/qcom,kryocc.txt
```
Qualcomm CPUSS clock controller for Kryo CPUs
----------------------------------------------------

Required properties :
- compatible : shall contain only one of the following:

			"qcom,apcc-msm8996"

- reg : shall contain base register location and length
- #clock-cells : shall contain 1

Example:
	kryocc: clock-controller@6400000 {
		compatible = "qcom,apcc-msm8996";
		reg = <0x6400000 0x90000>;
		#clock-cells = <1>;
	};
```

## Documentation/devicetree/bindings/cris/boards.yaml
```yaml
%YAML 1.2
---
version: 1

id: boards

title: Boards based on the CRIS SoCs:

maintainer:
    -   name: Jesper Nilsson <jespern@axis.com>

description: >
    TODO

inherits:
    -   id: %ids%

properties:
    -   name: "compatible"
        constraint: |
            "axis,dev88"


...

# Boards based on the CRIS SoCs:
#
# Required root node properties:
#     - compatible = should be one or more of the following:
# 	- "axis,dev88"	- for Axis devboard 88 with ETRAX FS
#
# Optional:
#
```

## Documentation/devicetree/bindings/cris/interrupts.yaml
```yaml
%YAML 1.2
---
version: 1

id: interrupts

title: CRISv32 Interrupt Controller

maintainer:
    -   name: Jesper Nilsson <jespern@axis.com>

description: >
    TODO

inherits:
    -   id: %ids%

properties:
    -   name: "compatible"
        constraint: |
            "axis,crisv32-intc"


...

# * CRISv32 Interrupt Controller
#
# Interrupt controller for the CRISv32 SoCs.
#
# Main node required properties:
#
# - compatible : should be:
# 	"axis,crisv32-intc"
# - interrupt-controller : Identifies the node as an interrupt controller
# - #interrupt-cells : Specifies the number of cells needed to encode an
#   interrupt source. The type shall be a <u32> and the value shall be 1.
# - reg: physical base address and size of the intc registers map.
#
# Example:
#
# 	intc: interrupt-controller {
# 		compatible = "axis,crisv32-intc";
# 		reg = <0xb001c000 0x1000>;
# 		interrupt-controller;
# 		#interrupt-cells = <1>;
# 	};
#
#
```

## Documentation/devicetree/bindings/crypto/atmel-crypto.yaml
```yaml
%YAML 1.2
---
version: 1

id: atmel-crypto

title: Atmel HW cryptographic accelerators

maintainer:
    -   name: Nicolas Ferre <nicolas.ferre@atmel.com>

description: >
    TODO

inherits:
    -   id: %ids%

properties:
    -   name: "compatible"
        constraint: |
            "atmel,at91sam9g46-tdes"
            "atmel,at91sam9g46-sha"
            "atmel,at91sam9g46-aes"

    clock-names:
    clocks:
    dma-names:
    dmas:
    interrupts:
    reg:
    status:

...

# * Atmel HW cryptographic accelerators
#
# These are the HW cryptographic accelerators found on some Atmel products.
#
# * Advanced Encryption Standard (AES)
#
# Required properties:
# - compatible : Should be "atmel,at91sam9g46-aes".
# - reg: Should contain AES registers location and length.
# - interrupts: Should contain the IRQ line for the AES.
# - dmas: List of two DMA specifiers as described in
#         atmel-dma.txt and dma.txt files.
# - dma-names: Contains one identifier string for each DMA specifier
#              in the dmas property.
#
# Example:
# aes@f8038000 {
# 	compatible = "atmel,at91sam9g46-aes";
# 	reg = <0xf8038000 0x100>;
# 	interrupts = <43 4 0>;
# 	dmas = <&dma1 2 18>,
# 	       <&dma1 2 19>;
# 	dma-names = "tx", "rx";
#
# * Triple Data Encryption Standard (Triple DES)
#
# Required properties:
# - compatible : Should be "atmel,at91sam9g46-tdes".
# - reg: Should contain TDES registers location and length.
# - interrupts: Should contain the IRQ line for the TDES.
#
# Optional properties:
# - dmas: List of two DMA specifiers as described in
#         atmel-dma.txt and dma.txt files.
# - dma-names: Contains one identifier string for each DMA specifier
#              in the dmas property.
#
# Example:
# tdes@f803c000 {
# 	compatible = "atmel,at91sam9g46-tdes";
# 	reg = <0xf803c000 0x100>;
# 	interrupts = <44 4 0>;
# 	dmas = <&dma1 2 20>,
# 	       <&dma1 2 21>;
# 	dma-names = "tx", "rx";
# };
#
# * Secure Hash Algorithm (SHA)
#
# Required properties:
# - compatible : Should be "atmel,at91sam9g46-sha".
# - reg: Should contain SHA registers location and length.
# - interrupts: Should contain the IRQ line for the SHA.
#
# Optional properties:
# - dmas: One DMA specifiers as described in
#         atmel-dma.txt and dma.txt files.
# - dma-names: Contains one identifier string for each DMA specifier
#              in the dmas property. Only one "tx" string needed.
#
# Example:
# sha@f8034000 {
# 	compatible = "atmel,at91sam9g46-sha";
# 	reg = <0xf8034000 0x100>;
# 	interrupts = <42 4 0>;
# 	dmas = <&dma1 2 17>;
# 	dma-names = "tx";
# };
```

## Documentation/devicetree/bindings/crypto/fsl-imx-sahara.yaml
```yaml
%YAML 1.2
---
version: 1

id: fsl-imx-sahara

title: Freescale SAHARA Cryptographic Accelerator included in some i.MX chips.

maintainer:
    -   name: Javier Martin <javier.martin@vista-silicon.com>

description: >
    TODO

inherits:
    -   id: %ids%

properties:
    -   name: "compatible"
        constraint: |
            "fsl,imx53-sahara"
            "fsl,imx27-sahara"

    clock-names:
    clocks:
    interrupts:
    reg:

...

# Freescale SAHARA Cryptographic Accelerator included in some i.MX chips.
# Currently only i.MX27 and i.MX53 are supported.
#
# Required properties:
# - compatible : Should be "fsl,<soc>-sahara"
# - reg : Should contain SAHARA registers location and length
# - interrupts : Should contain SAHARA interrupt number
#
# Example:
#
# sah@10025000 {
# 	compatible = "fsl,imx27-sahara";
# 	reg = <	0x10025000 0x800>;
# 	interrupts = <75>;
# };
```

## Documentation/devicetree/bindings/crypto/picochip-spacc.yaml
```yaml
%YAML 1.2
---
version: 1

id: picochip-spacc

title: Picochip picoXcell SPAcc (Security Protocol Accelerator) bindings

maintainer:
    -   name: Jamie Iles <jamie@jamieiles.com>

description: >
    TODO

inherits:
    -   id: %ids%

properties:
    -   name: "compatible"
        constraint: |
            "picochip,spacc-l2"
            "picochip,spacc-ipsec"

    interrupt-parent:
    interrupts:
    ref-clock:
    reg:

...

# Picochip picoXcell SPAcc (Security Protocol Accelerator) bindings
#
# Picochip picoXcell devices contain crypto offload engines that may be used for
# IPSEC and femtocell layer 2 ciphering.
#
# Required properties:
#   - compatible : "picochip,spacc-ipsec" for the IPSEC offload engine
#     "picochip,spacc-l2" for the femtocell layer 2 ciphering engine.
#   - reg : Offset and length of the register set for this device
#   - interrupt-parent : The interrupt controller that controls the SPAcc
#     interrupt.
#   - interrupts : The interrupt line from the SPAcc.
#   - ref-clock : The input clock that drives the SPAcc.
#
# Example SPAcc node:
#
# spacc@10000 {
# 	compatible = "picochip,spacc-ipsec";
# 	reg = <0x100000 0x10000>;
# 	interrupt-parent = <&vic0>;
# 	interrupts = <24>;
# 	ref-clock = <&ipsec_clk>, "ref";
# };
```

## Documentation/devicetree/bindings/display/msm/gpu.txt
```
Qualcomm adreno/snapdragon GPU

Required properties:
- compatible: "qcom,adreno-XYZ.W", "qcom,adreno"
    for example: "qcom,adreno-306.0", "qcom,adreno"
  Note that you need to list the less specific "qcom,adreno" (since this
  is what the device is matched on), in addition to the more specific
  with the chip-id.
- reg: Physical base address and length of the controller's registers.
- interrupts: The interrupt signal from the gpu.
- clocks: device clocks
  See ../clocks/clock-bindings.txt for details.
- clock-names: the following clocks are required:
  * "core"
  * "iface"
  * "mem_iface"

Subnodes:
- zap-shader:	Defines the memory region used by the zap shader
		to load the firmware via the PIL loader. This is required
		for adreno-5xx targets and newer unless the secure mode
		is specifically disabled on a target.

Required properties for zap-shader:
- memory-region: Phandle to the PIL reserved memory region.

Example:

/ {
	...

	gpu: qcom,kgsl-3d0@4300000 {
		compatible = "qcom,adreno-320.2", "qcom,adreno";
		reg = <0x04300000 0x20000>;
		reg-names = "kgsl_3d0_reg_memory";
		interrupts = <GIC_SPI 80 0>;
		interrupt-names = "kgsl_3d0_irq";
		clock-names =
		    "core",
		    "iface",
		    "mem_iface";
		clocks =
		    <&mmcc GFX3D_CLK>,
		    <&mmcc GFX3D_AHB_CLK>,
		    <&mmcc MMSS_IMEM_AHB_CLK>;

		zap-shader {
			memory-region = <&peripheral_reserved>;
		};
	};
};
```

## Documentation/devicetree/bindings/dma/apple,admac.yaml
```yaml
# SPDX-License-Identifier: GPL-2.0-only OR BSD-2-Clause
%YAML 1.2
---
$id: http://devicetree.org/schemas/dma/apple,admac.yaml#
$schema: http://devicetree.org/meta-schemas/core.yaml#

title: Apple Audio DMA Controller (ADMAC)

description: |
  The Audio DMA Controller (ADMAC) is used to load and store audio
  samples from/to system memory. It is present on Apple SoCs
  from the "Apple Silicon" family.

maintainers:
  - Martin Povišer <povik@protonmail.com>

allOf:
  - $ref: "dma-controller.yaml#"

properties:
  compatible:
    items:
      - const: apple,t8103-admac
      - const: apple,admac

  reg:
    maxItems: 1

  '#dma-cells':
    const: 1

  interrupts:
    maxItems: 1

required:
  - compatible
  - reg
  - interrupts
  - '#dma-cells'
  - dma-channels

additionalProperties: false

examples:
  - |
    dart_sio: iommu@235004000 {
      compatible = "apple,t8103-dart", "apple,dart";
      reg = <0x2 0x35004000 0x0 0x4000>;
      interrupt-parent = <&aic>;
      interrupts = <AIC_IRQ 635 IRQ_TYPE_LEVEL_HIGH>;
      #iommu-cells = <1>;
    };

    admac: dma-controller@238200000 {
      compatible = "apple,t8103-admac", "apple,admac";
      reg = <0x2 0x38200000 0x0 0x34000>;
      dma-channels = <12>;
      interrupt-parent = <&aic>;
      interrupts = <AIC_IRQ 626 IRQ_TYPE_LEVEL_HIGH>;
      #dma-cells = <1>;
      iommus = <&dart_sio 2>;
    };
```
