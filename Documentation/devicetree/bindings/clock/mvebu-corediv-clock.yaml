## Documentation/devicetree/bindings/gpio/gpio-zevio.yaml
```yaml
%YAML 1.2
---
version: 1

id: gpio-zevio

title: Zevio GPIO controller

maintainer:
    -   name: Fabian Vogt <fabian@ritter-vogt.de>

description: >
    TODO

inherits:
    -   id: %ids%

properties:
    -   name: "compatible"
        constraint: |
            "lsi,zevio-gpio"

    #gpio-cells:
    gpio-controller:
    interrupts:
    reg:

...

# Zevio GPIO controller
#
# Required properties:
# - compatible: Should be "lsi,zevio-gpio"
# - reg: Address and length of the register set for the device
# - #gpio-cells: Should be two. The first cell is the pin number and the
#   second cell is used to specify optional parameters (currently unused).
# - gpio-controller: Marks the device node as a GPIO controller.
#
# Example:
# 	gpio: gpio@90000000 {
# 		compatible = "lsi,zevio-gpio";
# 		reg = <0x90000000 0x1000>;
# 		gpio-controller;
# 		#gpio-cells = <2>;
# 	};
```

## Documentation/devicetree/bindings/gpio/gpio_atmel.yaml
```yaml
%YAML 1.2
---
version: 1

id: gpio_atmel

title: Atmel GPIO controller (PIO)

maintainer:
    -   name: Nicolas Ferre <nicolas.ferre@atmel.com>

description: >
    TODO

inherits:
    -   id: %ids%

properties:
    -   name: "compatible"
        constraint: |
            "atmel,at91sam9x5-gpio" && "atmel,at91rm9200-gpio"
            "atmel,at91rm9200-gpio"

    clocks:
    #gpio-cells:
    gpio-controller:
    #interrupt-cells:
    interrupt-controller:
    interrupts:
    reg:

...

# * Atmel GPIO controller (PIO)
#
# Required properties:
# - compatible: "atmel,<chip>-gpio", where <chip> is at91rm9200 or at91sam9x5.
# - reg: Should contain GPIO controller registers location and length
# - interrupts: Should be the port interrupt shared by all the pins.
# - #gpio-cells: Should be two.  The first cell is the pin number and
#   the second cell is used to specify optional parameters (currently
#   unused).
# - gpio-controller: Marks the device node as a GPIO controller.
#
# optional properties:
# - #gpio-lines: Number of gpio if absent 32.
#
#
# Example:
# 	pioA: gpio@fffff200 {
# 		compatible = "atmel,at91rm9200-gpio";
# 		reg = <0xfffff200 0x100>;
# 		interrupts = <2 4>;
# 		#gpio-cells = <2>;
# 		gpio-controller;
# 		#gpio-lines = <19>;
# 	};
#
```

## Documentation/devicetree/bindings/gpio/moxa,moxart-gpio.yaml
```yaml
%YAML 1.2
---
version: 1

id: moxa,moxart-gpio

title: MOXA ART GPIO Controller

maintainer:
    -   name: Jonas Jensen <jonas.jensen@gmail.com>

description: >
    TODO

inherits:
    -   id: %ids%

properties:
    -   name: "compatible"
        constraint: |
            "moxa,moxart-gpio"

    #gpio-cells:
    gpio-controller:
    reg:

...

# MOXA ART GPIO Controller
#
# Required properties:
#
# - #gpio-cells : Should be 2, The first cell is the pin number,
# 		the second cell is used to specify polarity:
# 			0 = active high
# 			1 = active low
# - compatible : Must be "moxa,moxart-gpio"
# - reg : Should contain registers location and length
#
# Example:
#
# 	gpio: gpio@98700000 {
# 		gpio-controller;
# 		#gpio-cells = <2>;
# 		compatible = "moxa,moxart-gpio";
# 		reg =	<0x98700000 0xC>;
# 	};
```

## Documentation/devicetree/bindings/gpio/pl061-gpio.yaml
```yaml
%YAML 1.2
---
version: 1

id: pl061-gpio

title: ARM PL061 GPIO controller

maintainer:
    -   name: Rob Herring <rob.herring@calxeda.com>

description: >
    TODO

inherits:
    -   id: %ids%

properties:
    -   name: "compatible"
        constraint: |
            "arm,pl061" && "arm,primecell"

    clock-names:
    clocks:
    #gpio-cells:
    gpio-controller:
    gpio-ranges:
    #interrupt-cells:
    interrupt-controller:
    interrupt-parent:
    interrupts:
    reg:
    status:

...

# ARM PL061 GPIO controller
#
# Required properties:
# - compatible : "arm,pl061", "arm,primecell"
# - #gpio-cells : Should be two. The first cell is the pin number and the
#   second cell is used to specify optional parameters:
#   - bit 0 specifies polarity (0 for normal, 1 for inverted)
# - gpio-controller : Marks the device node as a GPIO controller.
# - interrupts : Interrupt mapping for GPIO IRQ.
# - gpio-ranges : Interaction with the PINCTRL subsystem.
```

## Documentation/devicetree/bindings/h8300/cpu.yaml
```yaml
%YAML 1.2
---
version: 1

id: cpu

title: H8/300 CPU bindings

maintainer:
    -   name: Yoshinori Sato <ysato@users.sourceforge.jp>

description: >
    TODO

inherits:
    -   id: %ids%

properties:
    -   name: "compatible"
        constraint: |
            "renesas,h8300"


...

# * H8/300 CPU bindings
#
# Required properties:
#
# - compatible: Compatible property value should be "renesas,h8300".
# - clock-frequency: Contains the clock frequency for CPU, in Hz.
#
# Example:
#
# 		cpu@0 {
# 			compatible = "renesas,h8300";
# 			clock-frequency = <20000000>;
# 		};
```
